/dts-v1/;

/ {
	model = "Ingres based on Qualcomm Technologies, Inc SM8450";
	compatible = "qcom,waipio-mtp\0qcom,waipio\0qcom,mtp";
	qcom,msm-id = <0x1e2 0x20000 0x1c9 0x10000 0x1c9 0x20000 0x228 0x10000 0x1e2 0x10000>;
	qcom,board-id = <0x3010008 0x03>;
	xiaomi,miboard-id = <0x04 0x00>;

	fragment@0 {
		target = <0xffffffff>;

		__overlay__ {

			pm8008j_active {
				phandle = <0x3d>;

				mux {
					pins = "gpio11";
					function = "gpio";
				};

				config {
					pins = "gpio11";
					bias-disable;
					output-low;
					drive-strength = <0x02>;
				};
			};

			cirrus_reset_default_0 {
				phandle = <0x26>;

				mux {
					pins = "gpio120";
					function = "gpio";
				};

				config {
					pins = "gpio120";
					drive-strength = <0x10>;
					bias-disable;
					output-high;
				};
			};

			cirrus_reset_default_1 {
				phandle = <0x28>;

				mux {
					pins = "gpio9";
					function = "gpio";
				};

				config {
					pins = "gpio9";
					drive-strength = <0x10>;
					bias-disable;
					output-high;
				};
			};

			cirrus_reset_default_2 {
				phandle = <0x2a>;

				mux {
					pins = "gpio3";
					function = "gpio";
				};

				config {
					pins = "gpio3";
					drive-strength = <0x10>;
					bias-disable;
					output-high;
				};
			};

			cirrus_reset_default_3 {
				phandle = <0x2c>;

				mux {
					pins = "gpio1";
					function = "gpio";
				};

				config {
					pins = "gpio1";
					drive-strength = <0x10>;
					bias-disable;
					output-high;
				};
			};

			md_mode_ctrl_irq {

				ant4_ctrl_irq {
					phandle = <0x39>;

					mux {
						pins = "gpio150";
						function = "gpio";
					};

					config {
						pins = "gpio150";
						drive-strength = <0x02>;
						bias-disable;
						input-enable;
					};
				};

				ant10_ctrl_irq {
					phandle = <0x3a>;

					mux {
						pins = "gpio154";
						function = "gpio";
					};

					config {
						pins = "gpio154";
						drive-strength = <0x02>;
						bias-disable;
						input-enable;
					};
				};
			};

			cirrus_irq_default {

				cirrus_irq_default_0 {
					phandle = <0x27>;

					mux {
						pins = "gpio117";
						function = "gpio";
					};

					config {
						pins = "gpio117";
						drive-strength = <0x02>;
						input-enable;
						bias-pull-up;
					};
				};

				cirrus_irq_default_1 {
					phandle = <0x29>;

					mux {
						pins = "gpio118";
						function = "gpio";
					};

					config {
						pins = "gpio118";
						drive-strength = <0x02>;
						input-enable;
						bias-pull-up;
					};
				};

				cirrus_irq_default_2 {
					phandle = <0x2b>;

					mux {
						pins = "gpio63";
						function = "gpio";
					};

					config {
						pins = "gpio63";
						drive-strength = <0x02>;
						input-enable;
						bias-pull-up;
					};
				};

				cirrus_irq_default_3 {
					phandle = <0x2d>;

					mux {
						pins = "gpio88";
						function = "gpio";
					};

					config {
						pins = "gpio88";
						drive-strength = <0x02>;
						input-enable;
						bias-pull-up;
					};
				};
			};
		};
	};

	fragment@1 {
		target = <0xffffffff>;

		__overlay__ {
			#address-cells = <0x02>;
			#size-cells = <0x00>;
			interrupt-controller;
			#interrupt-cells = <0x04>;

			qcom,pmk8350@0 {
				compatible = "qcom,spmi-pmic";
				reg = <0x00 0x00>;
				#address-cells = <0x01>;
				#size-cells = <0x00>;
				phandle = <0x3e>;

				pon_hlos@1300 {
					compatible = "qcom,pm8998-pon";
					reg = <0x1300 0x800>;
					reg-names = "pon_hlos\0pon_pbs";
					qcom,log-kpd-event;
					phandle = <0x3f>;

					pwrkey {
						compatible = "qcom,pmk8350-pwrkey";
						interrupts = <0x00 0x13 0x07 0x03>;
						linux,code = <0x74>;
					};

					resin {
						compatible = "qcom,pmk8350-resin";
						interrupts = <0x00 0x13 0x06 0x03>;
						linux,code = <0x72>;
					};

					pwrkey-bark {
						compatible = "qcom,pmk8350-pwrkey-bark";
						interrupts = <0x00 0x13 0x00 0x03>;
						linux,code = <0x74>;
					};

					pwrkey-resin-bark {
						compatible = "qcom,pmk8350-pwrkey-resin-bark";
						interrupts = <0x00 0x13 0x02 0x03>;
						linux,code = <0x74>;
					};
				};

				vadc@3100 {
					compatible = "qcom,spmi-adc7";
					reg = <0x3100>;
					#address-cells = <0x01>;
					#size-cells = <0x00>;
					interrupts = <0x00 0x31 0x00 0x01>;
					interrupt-names = "eoc-int-en-set";
					#io-channel-cells = <0x01>;
					io-channel-ranges;
					pinctrl-names = "default";
					pinctrl-0 = <0x01>;
					phandle = <0x02>;

					pmk8350_ref_gnd {
						reg = <0x00>;
						label = "pmk8350_ref_gnd";
						qcom,pre-scaling = <0x01 0x01>;
					};

					pmk8350_vref_1p25 {
						reg = <0x01>;
						label = "pmk8350_vref_1p25";
						qcom,pre-scaling = <0x01 0x01>;
					};

					pmk8350_die_temp {
						reg = <0x03>;
						label = "pmk8350_die_temp";
						qcom,pre-scaling = <0x01 0x01>;
					};

					pm8350_ref_gnd {
						reg = <0x100>;
						label = "pm8350_ref_gnd";
						qcom,pre-scaling = <0x01 0x01>;
					};

					pm8350_vref_1p25 {
						reg = <0x101>;
						label = "pm8350_vref_1p25";
						qcom,pre-scaling = <0x01 0x01>;
					};

					pm8350_die_temp {
						reg = <0x103>;
						label = "pm8350_die_temp";
						qcom,pre-scaling = <0x01 0x01>;
					};

					pm8350_vph_pwr {
						reg = <0x18e>;
						label = "pm8350_vph_pwr";
						qcom,pre-scaling = <0x01 0x03>;
					};

					pm8350b_ref_gnd {
						reg = <0x300>;
						label = "pm8350b_ref_gnd";
						qcom,pre-scaling = <0x01 0x01>;
					};

					pm8350b_vref_1p25 {
						reg = <0x301>;
						label = "pm8350b_vref_1p25";
						qcom,pre-scaling = <0x01 0x01>;
					};

					pm8350b_die_temp {
						reg = <0x303>;
						label = "pm8350b_die_temp";
						qcom,pre-scaling = <0x01 0x01>;
					};

					pm8350b_vph_pwr {
						reg = <0x38e>;
						label = "pm8350b_vph_pwr";
						qcom,pre-scaling = <0x01 0x03>;
					};

					pm8350b_vbat_sns {
						reg = <0x38f>;
						label = "pm8350b_vbat_sns";
						qcom,pre-scaling = <0x01 0x03>;
					};

					pmr735a_ref_gnd {
						reg = <0x400>;
						label = "pmr735a_ref_gnd";
						qcom,pre-scaling = <0x01 0x01>;
					};

					pmr735a_vref_1p25 {
						reg = <0x401>;
						label = "pmr735a_vref_1p25";
						qcom,pre-scaling = <0x01 0x01>;
					};

					pmr735a_die_temp {
						reg = <0x403>;
						label = "pmr735a_die_temp";
						qcom,pre-scaling = <0x01 0x01>;
					};

					pmr735b_ref_gnd {
						reg = <0x500>;
						label = "pmr735b_ref_gnd";
						qcom,pre-scaling = <0x01 0x01>;
					};

					pmr735b_vref_1p25 {
						reg = <0x501>;
						label = "pmr735b_vref_1p25";
						qcom,pre-scaling = <0x01 0x01>;
					};

					pmr735b_die_temp {
						reg = <0x503>;
						label = "pmr735b_die_temp";
						qcom,pre-scaling = <0x01 0x01>;
					};

					pm8350b_chg_temp {
						reg = <0x310>;
						label = "pm8350b_chg_temp";
						qcom,pre-scaling = <0x01 0x01>;
					};

					pm8350b_iin_fb {
						reg = <0x317>;
						label = "pm8350b_iin_fb";
						qcom,pre-scaling = <0x20 0x64>;
					};

					pm8350b_ichg_fb {
						reg = <0x3a1>;
						label = "pm8350b_ichg_fb";
						qcom,pre-scaling = <0x3e8 0x4a821>;
					};

					pm8350b_usb_in_v_div_16 {
						reg = <0x311>;
						label = "pm8350b_usb_in_v_div_16";
						qcom,pre-scaling = <0x01 0x10>;
					};

					smb139x_1_smb_temp {
						reg = <0x906>;
						label = "smb139x_1_smb_temp";
						qcom,hw-settle-time = <0xc8>;
					};

					smb139x_1_ichg_smb {
						reg = <0x918>;
						label = "smb139x_1_ichg_smb";
						qcom,hw-settle-time = <0xc8>;
					};

					smb139x_1_iin_smb {
						reg = <0x919>;
						label = "smb139x_1_iin_smb";
						qcom,hw-settle-time = <0xc8>;
					};

					smb139x_2_smb_temp {
						reg = <0xb06>;
						label = "smb139x_2_smb_temp";
						qcom,hw-settle-time = <0xc8>;
					};

					smb139x_2_ichg_smb {
						reg = <0xb18>;
						label = "smb139x_2_ichg_smb";
						qcom,hw-settle-time = <0xc8>;
					};

					smb139x_2_iin_smb {
						reg = <0xb19>;
						label = "smb139x_2_iin_smb";
						qcom,hw-settle-time = <0xc8>;
					};

					pm8350_msm_therm {
						reg = <0x144>;
						label = "pm8350_msm_therm";
						qcom,ratiometric;
						qcom,hw-settle-time = <0xc8>;
						qcom,pre-scaling = <0x01 0x01>;
					};

					pm8350_flash_therm {
						reg = <0x145>;
						label = "pm8350_flash_therm";
						qcom,ratiometric;
						qcom,hw-settle-time = <0xc8>;
						qcom,pre-scaling = <0x01 0x01>;
					};

					pm8350_hot_pocket_therm {
						reg = <0x146>;
						label = "pm8350_hot_pocket_therm";
						qcom,ratiometric;
						qcom,hw-settle-time = <0xc8>;
						qcom,pre-scaling = <0x01 0x01>;
					};

					pm8350_charger2_therm {
						reg = <0x147>;
						label = "pm8350_charger2_therm";
						qcom,ratiometric;
						qcom,hw-settle-time = <0xc8>;
						qcom,pre-scaling = <0x01 0x01>;
					};

					pm8350_charger1_therm {
						reg = <0x148>;
						label = "pm8350_charger1_therm";
						qcom,ratiometric;
						qcom,hw-settle-time = <0xc8>;
						qcom,pre-scaling = <0x01 0x01>;
					};

					pa_therm0 {
						reg = <0x44a>;
						label = "pa_therm0";
						qcom,ratiometric;
						qcom,hw-settle-time = <0xc8>;
						qcom,pre-scaling = <0x01 0x01>;
					};

					pa_therm1 {
						reg = <0x44b>;
						label = "pa_therm1";
						qcom,ratiometric;
						qcom,hw-settle-time = <0xc8>;
						qcom,pre-scaling = <0x01 0x01>;
					};

					wifi_therm {
						reg = <0x44c>;
						label = "wifi_therm";
						qcom,ratiometric;
						qcom,hw-settle-time = <0xc8>;
						qcom,pre-scaling = <0x01 0x01>;
					};

					pm8350b_usb_conn_therm {
						reg = <0x347>;
						label = "pm8350b_usb_conn_therm";
						qcom,ratiometric;
						qcom,hw-settle-time = <0xc8>;
						qcom,pre-scaling = <0x01 0x01>;
					};
				};

				adc_tm@3400 {
					compatible = "qcom,adc-tm7";
					reg = <0x3400>;
					interrupts = <0x00 0x34 0x00 0x01>;
					interrupt-names = "threshold";
					#address-cells = <0x01>;
					#size-cells = <0x00>;
					#thermal-sensor-cells = <0x01>;
					io-channels = <0x02 0x144 0x02 0x145 0x02 0x146 0x02 0x147 0x02 0x148 0x02 0x44a 0x02 0x44b 0x02 0x44c>;
					phandle = <0x3b>;

					pm8350_msm_therm {
						reg = <0x144>;
						qcom,ratiometric;
						qcom,hw-settle-time = <0xc8>;
					};

					pm8350_flash_therm {
						reg = <0x145>;
						qcom,ratiometric;
						qcom,hw-settle-time = <0xc8>;
					};

					pm8350_hot_pocket_therm {
						reg = <0x146>;
						qcom,ratiometric;
						qcom,hw-settle-time = <0xc8>;
					};

					pm8350_charger2_therm {
						reg = <0x147>;
						qcom,ratiometric;
						qcom,hw-settle-time = <0xc8>;
					};

					pm8350_charger1_therm {
						reg = <0x148>;
						qcom,ratiometric;
						qcom,hw-settle-time = <0xc8>;
					};

					pa_therm0 {
						reg = <0x44a>;
						qcom,ratiometric;
						qcom,hw-settle-time = <0xc8>;
					};

					pa_therm1 {
						reg = <0x44b>;
						qcom,ratiometric;
						qcom,hw-settle-time = <0xc8>;
					};

					wifi_therm {
						reg = <0x44c>;
						qcom,ratiometric;
						qcom,hw-settle-time = <0xc8>;
					};
				};

				sdam@7000 {
					compatible = "qcom,spmi-sdam";
					reg = <0x7000>;
					#address-cells = <0x01>;
					#size-cells = <0x01>;
					phandle = <0x40>;
				};

				sdam@7100 {
					compatible = "qcom,spmi-sdam";
					reg = <0x7100>;
					#address-cells = <0x01>;
					#size-cells = <0x01>;
					phandle = <0x41>;

					restart@48 {
						reg = <0x48 0x01>;
						bits = <0x01 0x07>;
						phandle = <0x14>;
					};

					cl_brake@7c {
						reg = <0x7c 0x01>;
						bits = <0x00 0x08>;
						phandle = <0x09>;
					};
				};

				sdam@7400 {
					compatible = "qcom,spmi-sdam";
					reg = <0x7400>;
					phandle = <0x15>;
				};

				sdam@7c00 {
					compatible = "qcom,spmi-sdam";
					reg = <0x7c00>;
					phandle = <0x0c>;
				};

				sdam@7d00 {
					compatible = "qcom,spmi-sdam";
					reg = <0x7d00>;
					phandle = <0x0d>;
				};

				sdam@8400 {
					compatible = "qcom,spmi-sdam";
					reg = <0x8400>;
					phandle = <0x04>;
				};

				sdam@8500 {
					compatible = "qcom,spmi-sdam";
					reg = <0x8500>;
					phandle = <0x05>;
				};

				sdam@8600 {
					compatible = "qcom,spmi-sdam";
					reg = <0x8600>;
					#address-cells = <0x01>;
					#size-cells = <0x01>;
					phandle = <0x42>;
				};

				sdam@9800 {
					compatible = "qcom,spmi-sdam";
					reg = <0x9800>;
					phandle = <0x0e>;
				};

				sdam@9d00 {
					compatible = "qcom,spmi-sdam";
					reg = <0x9d00>;
					phandle = <0x0a>;
				};

				pinctrl@b000 {
					compatible = "qcom,pmk8350-gpio";
					reg = <0xb000>;
					gpio-controller;
					#gpio-cells = <0x02>;
					interrupt-controller;
					#interrupt-cells = <0x02>;
					phandle = <0x43>;
				};

				rtc@6100 {
					compatible = "qcom,pmk8350-rtc";
					reg = <0x6100 0x6200>;
					reg-names = "rtc\0alarm";
					interrupts = <0x00 0x62 0x01 0x01>;
					phandle = <0x44>;
				};

				adc_tm_e {
					compatible = "qcom,adc-tm7-iio";
					reg = <0x3400>;
					#thermal-sensor-cells = <0x01>;
					#address-cells = <0x01>;
					#size-cells = <0x00>;
					io-channels = <0x02 0x347>;
					phandle = <0x3c>;

					pm8350b_usb_conn_therm {
						reg = <0x347>;
						qcom,ratiometric;
						qcom,hw-settle-time = <0xc8>;
					};
				};
			};
		};
	};

	fragment@2 {
		target = <0xffffffff>;

		__overlay__ {
			#address-cells = <0x02>;
			#size-cells = <0x00>;
			interrupt-controller;
			#interrupt-cells = <0x04>;

			qcom,pm8350@1 {
				compatible = "qcom,spmi-pmic";
				reg = <0x01 0x00>;
				#address-cells = <0x01>;
				#size-cells = <0x00>;

				qcom,temp-alarm@a00 {
					compatible = "qcom,spmi-temp-alarm";
					reg = <0xa00>;
					interrupts = <0x01 0x0a 0x00 0x03>;
					#thermal-sensor-cells = <0x00>;
					io-channels = <0x02 0x103>;
					io-channel-names = "thermal";
					phandle = <0x03>;
				};

				pinctrl@8800 {
					compatible = "qcom,pm8350-gpio";
					reg = <0x8800>;
					gpio-controller;
					#gpio-cells = <0x02>;
					interrupt-controller;
					#interrupt-cells = <0x02>;
					phandle = <0x20>;

					pm8350_rear_tof_therm {

						pm8350_rear_tof_therm_default {
							pins = "gpio1";
							bias-high-impedance;
							phandle = <0x01>;
						};
					};

					key_vol_up {

						key_vol_up_default {
							pins = "gpio6";
							function = "normal";
							input-enable;
							bias-pull-up;
							power-source = <0x01>;
							phandle = <0x1f>;
						};
					};
				};
			};
		};
	};

	fragment@3 {
		target = <0xffffffff>;

		__overlay__ {

			pm8350_tz {
				polling-delay-passive = <0x64>;
				polling-delay = <0x00>;
				thermal-governor = "step_wise";
				thermal-sensors = <0x03>;
				phandle = <0x45>;

				trips {

					trip0 {
						temperature = <0x17318>;
						hysteresis = <0x00>;
						type = "passive";
						phandle = <0x1d>;
					};

					trip1 {
						temperature = <0x1c138>;
						hysteresis = <0x00>;
						type = "passive";
						phandle = <0x46>;
					};

					trip2 {
						temperature = <0x23668>;
						hysteresis = <0x00>;
						type = "passive";
						phandle = <0x47>;
					};
				};
			};
		};
	};

	fragment@4 {
		target = <0xffffffff>;

		__overlay__ {
			#address-cells = <0x02>;
			#size-cells = <0x00>;
			interrupt-controller;
			#interrupt-cells = <0x04>;

			qcom,pm8350c@2 {
				compatible = "qcom,spmi-pmic";
				reg = <0x02 0x00>;
				#address-cells = <0x01>;
				#size-cells = <0x00>;

				qcom,temp-alarm@a00 {
					compatible = "qcom,spmi-temp-alarm";
					reg = <0xa00>;
					interrupts = <0x02 0x0a 0x00 0x03>;
					#thermal-sensor-cells = <0x00>;
					phandle = <0x07>;
				};

				pinctrl@8800 {
					compatible = "qcom,pm8350c-gpio";
					reg = <0x8800>;
					gpio-controller;
					#gpio-cells = <0x02>;
					interrupt-controller;
					#interrupt-cells = <0x02>;
					phandle = <0x48>;

					lcd_backlight_ctrl {

						lcd_backlight_ctrl_default {
							pins = "gpio8";
							function = "func1";
							input-disable;
							output-enable;
							bias-disable;
							power-source = <0x01>;
							qcom,drive-strength = <0x02>;
							phandle = <0x49>;
						};
					};
				};

				pwms@e800 {
					compatible = "qcom,pwm-lpg";
					reg = <0xe800>;
					reg-names = "lpg-base";
					#pwm-cells = <0x02>;
					qcom,num-lpg-channels = <0x03>;
					nvmem = <0x04 0x05>;
					nvmem-names = "lpg_chan_sdam\0lut_sdam";
					qcom,lut-sdam-base = <0x45>;
					qcom,lut-patterns = <0x00 0x0a 0x14 0x1e 0x28 0x32 0x3c 0x46 0x50 0x5a 0x64 0x5a 0x50 0x46 0x3c 0x32 0x28 0x1e 0x14 0x0a 0x00>;
					qcom,tick-duration-us = <0x1f40>;
					phandle = <0x06>;

					lpg@1 {
						qcom,lpg-chan-id = <0x01>;
						qcom,ramp-step-ms = <0x64>;
						qcom,ramp-low-index = <0x00>;
						qcom,ramp-high-index = <0x13>;
						qcom,ramp-pattern-repeat;
						qcom,lpg-sdam-base = <0x48>;
					};

					lpg@2 {
						qcom,lpg-chan-id = <0x02>;
						qcom,ramp-step-ms = <0x64>;
						qcom,ramp-low-index = <0x00>;
						qcom,ramp-high-index = <0x13>;
						qcom,ramp-pattern-repeat;
						qcom,lpg-sdam-base = <0x56>;
					};

					lpg@3 {
						qcom,lpg-chan-id = <0x03>;
						qcom,ramp-step-ms = <0x64>;
						qcom,ramp-low-index = <0x00>;
						qcom,ramp-high-index = <0x13>;
						qcom,ramp-pattern-repeat;
						qcom,lpg-sdam-base = <0x64>;
					};
				};

				pwms@eb00 {
					compatible = "qcom,pwm-lpg";
					reg = <0xeb00>;
					reg-names = "lpg-base";
					#pwm-cells = <0x02>;
					qcom,num-lpg-channels = <0x01>;
					phandle = <0x4a>;
				};

				qcom,leds@ef00 {
					compatible = "qcom,tri-led";
					reg = <0xef00>;
					phandle = <0x4b>;

					red {
						label = "red";
						pwms = <0x06 0x00 0xf4240>;
						led-sources = <0x00>;
						linux,default-trigger = "timer";
					};

					green {
						label = "green";
						pwms = <0x06 0x01 0xf4240>;
						led-sources = <0x01>;
						linux,default-trigger = "timer";
					};

					blue {
						label = "blue";
						pwms = <0x06 0x02 0xf4240>;
						led-sources = <0x02>;
						linux,default-trigger = "timer";
					};
				};

				bcl@4700 {
					compatible = "qcom,bcl-v5";
					reg = <0x4700 0x100>;
					interrupts = <0x02 0x47 0x00 0x00 0x02 0x47 0x01 0x00 0x02 0x47 0x02 0x00>;
					interrupt-names = "bcl-lvl0\0bcl-lvl1\0bcl-lvl2";
					qcom,pmic7-threshold;
					#thermal-sensor-cells = <0x01>;
					phandle = <0x08>;
				};

				qcom,flash_led@ee00 {
					compatible = "qcom,pm8350c-flash-led";
					reg = <0xee00>;
					interrupts = <0x02 0xee 0x00 0x01 0x02 0xee 0x03 0x01 0x02 0xee 0x04 0x01>;
					interrupt-names = "led-fault-irq\0all-ramp-down-done-irq\0all-ramp-up-done-irq";
					qcom,thermal-derate-current = <0xc8 0x1f4>;
					status = "ok";
					phandle = <0x4c>;

					qcom,flash_0 {
						label = "flash";
						qcom,led-name = "led:flash_0";
						qcom,max-current-ma = <0x5dc>;
						qcom,default-led-trigger = "flash0_trigger";
						qcom,id = <0x00>;
						qcom,duration-ms = <0x500>;
						qcom,ires-ua = <0x30d4>;
						phandle = <0x4d>;
					};

					qcom,flash_1 {
						label = "flash";
						qcom,led-name = "led:flash_1";
						qcom,max-current-ma = <0x5dc>;
						qcom,default-led-trigger = "flash1_trigger";
						qcom,id = <0x01>;
						qcom,duration-ms = <0x500>;
						qcom,ires-ua = <0x30d4>;
						phandle = <0x4e>;
					};

					qcom,flash_2 {
						label = "flash";
						qcom,led-name = "led:flash_2";
						qcom,max-current-ma = <0x5dc>;
						qcom,default-led-trigger = "flash2_trigger";
						qcom,id = <0x02>;
						qcom,duration-ms = <0x500>;
						qcom,ires-ua = <0x30d4>;
						phandle = <0x4f>;
					};

					qcom,flash_3 {
						label = "flash";
						qcom,led-name = "led:flash_3";
						qcom,max-current-ma = <0x5dc>;
						qcom,default-led-trigger = "flash3_trigger";
						qcom,id = <0x03>;
						qcom,duration-ms = <0x500>;
						qcom,ires-ua = <0x30d4>;
						phandle = <0x50>;
					};

					qcom,torch_0 {
						label = "torch";
						qcom,led-name = "led:torch_0";
						qcom,max-current-ma = <0x1f4>;
						qcom,default-led-trigger = "torch0_trigger";
						qcom,id = <0x00>;
						qcom,ires-ua = <0x30d4>;
						phandle = <0x51>;
					};

					qcom,torch_1 {
						label = "torch";
						qcom,led-name = "led:torch_1";
						qcom,max-current-ma = <0x1f4>;
						qcom,default-led-trigger = "torch1_trigger";
						qcom,id = <0x01>;
						qcom,ires-ua = <0x30d4>;
						phandle = <0x52>;
					};

					qcom,torch_2 {
						label = "torch";
						qcom,led-name = "led:torch_2";
						qcom,max-current-ma = <0x1f4>;
						qcom,default-led-trigger = "torch2_trigger";
						qcom,id = <0x02>;
						qcom,ires-ua = <0x30d4>;
						phandle = <0x53>;
					};

					qcom,torch_3 {
						label = "torch";
						qcom,led-name = "led:torch_3";
						qcom,max-current-ma = <0x1f4>;
						qcom,default-led-trigger = "torch3_trigger";
						qcom,id = <0x03>;
						qcom,ires-ua = <0x30d4>;
						phandle = <0x54>;
					};

					qcom,led_switch_0 {
						label = "switch";
						qcom,led-name = "led:switch_0";
						qcom,default-led-trigger = "switch0_trigger";
						qcom,led-mask = <0x09>;
						qcom,symmetry-en;
						phandle = <0x55>;
					};

					qcom,led_switch_1 {
						label = "switch";
						qcom,led-name = "led:switch_1";
						qcom,default-led-trigger = "switch1_trigger";
						qcom,led-mask = <0x06>;
						qcom,symmetry-en;
						phandle = <0x56>;
					};

					qcom,led_switch_2 {
						label = "switch";
						qcom,led-name = "led:switch_2";
						qcom,default-led-trigger = "switch2_trigger";
						qcom,led-mask = <0x0f>;
						qcom,symmetry-en;
						phandle = <0x57>;
					};
				};
			};
		};
	};

	fragment@5 {
		target = <0xffffffff>;

		__overlay__ {

			pm8350c_tz {
				polling-delay-passive = <0x64>;
				polling-delay = <0x00>;
				thermal-governor = "step_wise";
				thermal-sensors = <0x07>;
				phandle = <0x58>;

				trips {

					trip0 {
						temperature = <0x17318>;
						hysteresis = <0x00>;
						type = "passive";
						phandle = <0x1e>;
					};

					trip1 {
						temperature = <0x1c138>;
						hysteresis = <0x00>;
						type = "passive";
						phandle = <0x59>;
					};

					trip2 {
						temperature = <0x23668>;
						hysteresis = <0x00>;
						type = "passive";
						phandle = <0x5a>;
					};
				};
			};

			pm8350c-bcl-lvl0 {
				polling-delay-passive = <0x64>;
				polling-delay = <0x00>;
				thermal-governor = "step_wise";
				thermal-sensors = <0x08 0x05>;

				trips {

					c-bcl-lvl0 {
						temperature = <0x01>;
						hysteresis = <0x01>;
						type = "passive";
						phandle = <0x19>;
					};
				};
			};

			pm8350c-bcl-lvl1 {
				polling-delay-passive = <0x64>;
				polling-delay = <0x00>;
				thermal-governor = "step_wise";
				thermal-sensors = <0x08 0x06>;

				trips {

					c-bcl-lvl1 {
						temperature = <0x01>;
						hysteresis = <0x01>;
						type = "passive";
						phandle = <0x1a>;
					};
				};
			};

			pm8350c-bcl-lvl2 {
				polling-delay-passive = <0x64>;
				polling-delay = <0x00>;
				thermal-governor = "step_wise";
				thermal-sensors = <0x08 0x07>;

				trips {

					c-bcl-lvl2 {
						temperature = <0x01>;
						hysteresis = <0x01>;
						type = "passive";
						phandle = <0x1b>;
					};
				};
			};
		};
	};

	fragment@6 {
		target = <0xffffffff>;

		__overlay__ {
			#address-cells = <0x02>;
			#size-cells = <0x00>;
			interrupt-controller;
			#interrupt-cells = <0x04>;

			qcom,pm8350b@3 {
				compatible = "qcom,spmi-pmic";
				reg = <0x03 0x00>;
				#address-cells = <0x01>;
				#size-cells = <0x00>;

				qcom,temp-alarm@a00 {
					compatible = "qcom,spmi-temp-alarm";
					reg = <0xa00>;
					interrupts = <0x03 0x0a 0x00 0x03>;
					#thermal-sensor-cells = <0x00>;
					io-channels = <0x02 0x303>;
					io-channel-names = "thermal";
					phandle = <0x0f>;
				};

				qcom,pbs@1900 {
					compatible = "qcom,qpnp-pbs";
					reg = <0x1900>;
					phandle = <0x0b>;
				};

				pinctrl@8800 {
					compatible = "qcom,pm8350b-gpio";
					reg = <0x8800>;
					gpio-controller;
					#gpio-cells = <0x02>;
					interrupt-controller;
					#interrupt-cells = <0x02>;
					phandle = <0x5b>;

					pm8350b_rear_tof_therm {

						pm8350b_rear_tof_therm_default {
							pins = "gpio2";
							bias-high-impedance;
							phandle = <0x5c>;
						};
					};
				};

				bcl@4700 {
					compatible = "qcom,bcl-v5";
					reg = <0x4700 0x100>;
					interrupts = <0x03 0x47 0x00 0x00 0x03 0x47 0x01 0x00 0x03 0x47 0x02 0x00>;
					interrupt-names = "bcl-lvl0\0bcl-lvl1\0bcl-lvl2";
					qcom,pmic7-threshold;
					#thermal-sensor-cells = <0x01>;
					phandle = <0x10>;
				};

				bcl-soc {
					compatible = "qcom,msm-bcl-soc";
					#thermal-sensor-cells = <0x00>;
					status = "disabled";
					phandle = <0x5d>;
				};

				qcom,hv-haptics@f000 {
					compatible = "qcom,hv-haptics";
					reg = <0xf000 0xf100 0xf200>;
					interrupts = <0x03 0xf0 0x01 0x01>;
					interrupt-names = "fifo-empty";
					qcom,vmax-mv = <0xa8c>;
					qcom,brake-mode = <0x01>;
					qcom,brake-pattern = [ff 3f 1f];
					qcom,lra-period-us = <0x13ee>;
					qcom,drv-sig-shape = <0x01>;
					qcom,brake-sig-shape = <0x01>;
					status = "ok";
					nvmem-cell-names = "hap_cl_brake";
					nvmem-cells = <0x09>;
					nvmem-names = "hap_cfg_sdam";
					nvmem = <0x0a>;
					qcom,pbs-client = <0x0b>;
					phandle = <0x5e>;

					qcom,hap-swr-slave-reg {
						regulator-name = "hap-swr-slave-reg";
						phandle = <0x5f>;
					};

					effect_0 {
						qcom,effect-id = <0x00>;
						qcom,wf-vmax-mv = <0xe10>;
						qcom,wf-pattern-data = <0x1f 0x00 0x00 0x3f 0x00 0x00 0x5f 0x00 0x00 0x7f 0x00 0x00 0x17f 0x00 0x00 0x15f 0x00 0x00 0x13f 0x00 0x00 0x11f 0x00 0x00>;
						qcom,wf-pattern-period-us = <0x1a0b>;
						qcom,wf-brake-pattern = [00 00 00];
						qcom,wf-pattern-preload;
						qcom,wf-auto-res-disable;
					};

					effect_1 {
						qcom,effect-id = <0x01>;
						qcom,wf-vmax-mv = <0xe10>;
						qcom,wf-pattern-data = <0x1f 0x00 0x00 0x3f 0x00 0x00 0x5f 0x00 0x00 0x7f 0x00 0x00 0x17f 0x00 0x00 0x15f 0x00 0x00 0x13f 0x00 0x00 0x11f 0x00 0x00>;
						qcom,wf-pattern-period-us = <0x1a0b>;
						qcom,wf-brake-pattern = [00 00 00];
						qcom,wf-auto-res-disable;
					};

					effect_2 {
						qcom,effect-id = <0x02>;
						qcom,wf-vmax-mv = <0xe10>;
						qcom,wf-pattern-data = <0x1f 0x00 0x00 0x3f 0x00 0x00 0x5f 0x00 0x00 0x7f 0x00 0x00 0x17f 0x00 0x00 0x15f 0x00 0x00 0x13f 0x00 0x00 0x11f 0x00 0x00>;
						qcom,wf-pattern-period-us = <0x1a0b>;
						qcom,wf-brake-pattern = [00 00 00];
						qcom,wf-auto-res-disable;
					};

					effect_3 {
						qcom,effect-id = <0x03>;
						qcom,wf-vmax-mv = <0xe10>;
						qcom,wf-pattern-data = <0x1f 0x00 0x00 0x3f 0x00 0x00 0x5f 0x00 0x00 0x7f 0x00 0x00 0x17f 0x00 0x00 0x15f 0x00 0x00 0x13f 0x00 0x00 0x11f 0x00 0x00>;
						qcom,wf-pattern-period-us = <0x1a0b>;
						qcom,wf-brake-pattern = [00 00 00];
						qcom,wf-auto-res-disable;
					};

					effect_4 {
						qcom,effect-id = <0x04>;
						qcom,wf-vmax-mv = <0xe10>;
						qcom,wf-pattern-data = <0x1f 0x00 0x00 0x3f 0x00 0x00 0x5f 0x00 0x00 0x7f 0x00 0x00 0x17f 0x00 0x00 0x15f 0x00 0x00 0x13f 0x00 0x00 0x11f 0x00 0x00>;
						qcom,wf-pattern-period-us = <0x1a0b>;
						qcom,wf-brake-pattern = [00 00 00];
						qcom,wf-auto-res-disable;
					};

					effect_5 {
						qcom,effect-id = <0x05>;
						qcom,wf-vmax-mv = <0xe10>;
						qcom,wf-pattern-data = <0x1f 0x00 0x00 0x3f 0x00 0x00 0x5f 0x00 0x00 0x7f 0x00 0x00 0x17f 0x00 0x00 0x15f 0x00 0x00 0x13f 0x00 0x00 0x11f 0x00 0x00>;
						qcom,wf-pattern-period-us = <0x1a0b>;
						qcom,wf-brake-pattern = [00 00 00];
						qcom,wf-auto-res-disable;
					};
				};

				qcom,amoled {
					compatible = "qcom,qpnp-amoled-regulator";
					#address-cells = <0x01>;
					#size-cells = <0x00>;
					phandle = <0x60>;

					oledb@fa00 {
						reg = <0xfa00>;
						reg-names = "oledb_base";
						regulator-name = "oledb";
						regulator-min-microvolt = <0x4c4b40>;
						regulator-max-microvolt = <0x7a1200>;
						qcom,swire-control;
						phandle = <0x61>;
					};

					ab@f900 {
						reg = <0xf900>;
						reg-names = "ab_base";
						regulator-name = "ab";
						regulator-min-microvolt = <0x4630c0>;
						regulator-max-microvolt = <0x4f5880>;
						qcom,swire-control;
						phandle = <0x62>;
					};

					ibb@f800 {
						reg = <0xf800>;
						reg-names = "ibb_base";
						regulator-name = "ibb";
						regulator-min-microvolt = <0x155cc0>;
						regulator-max-microvolt = <0x64b540>;
						qcom,swire-control;
						regulator-allow-set-load;
						phandle = <0x63>;
					};
				};

				qcom,amoled-ecm@f900 {
					compatible = "qcom,amoled-ecm";
					reg = <0xf900>;
					nvmem-names = "amoled-ecm-sdam0\0amoled-ecm-sdam1\0amoled-ecm-sdam2";
					nvmem = <0x0c 0x0d 0x0e>;
					interrupt-names = "ecm-sdam0\0ecm-sdam1\0ecm-sdam2";
					interrupts = <0x00 0x7c 0x01 0x01 0x00 0x7d 0x01 0x01 0x00 0x98 0x01 0x01>;
				};
			};
		};
	};

	fragment@7 {
		target = <0xffffffff>;

		__overlay__ {

			pm8350b_tz {
				polling-delay-passive = <0x64>;
				polling-delay = <0x00>;
				thermal-sensors = <0x0f>;
				phandle = <0x64>;

				trips {

					trip0 {
						temperature = <0x15f90>;
						hysteresis = <0x00>;
						type = "passive";
						phandle = <0x65>;
					};

					trip1 {
						temperature = <0x1c138>;
						hysteresis = <0x00>;
						type = "passive";
						phandle = <0x66>;
					};

					trip2 {
						temperature = <0x23668>;
						hysteresis = <0x00>;
						type = "passive";
						phandle = <0x67>;
					};
				};
			};

			pm8350b-ibat-lvl0 {
				polling-delay-passive = <0x00>;
				polling-delay = <0x00>;
				thermal-sensors = <0x10 0x00>;

				trips {

					ibat-lvl0 {
						temperature = <0x2328>;
						hysteresis = <0xc8>;
						type = "passive";
						phandle = <0x68>;
					};
				};
			};

			pm8350b-ibat-lvl1 {
				polling-delay-passive = <0x00>;
				polling-delay = <0x00>;
				thermal-sensors = <0x10 0x01>;

				trips {

					ibat-lvl1 {
						temperature = <0x2710>;
						hysteresis = <0xc8>;
						type = "passive";
						phandle = <0x69>;
					};
				};
			};

			pm8350b-bcl-lvl0 {
				polling-delay-passive = <0x64>;
				polling-delay = <0x00>;
				thermal-sensors = <0x10 0x05>;

				trips {

					thermal-engine-trip {
						temperature = <0x64>;
						hysteresis = <0x00>;
						type = "passive";
					};

					thermal-hal-trip {
						temperature = <0x64>;
						hysteresis = <0x00>;
						type = "passive";
					};

					b-bcl-lvl0 {
						temperature = <0x01>;
						hysteresis = <0x01>;
						type = "passive";
						phandle = <0x16>;
					};
				};
			};

			pm8350b-bcl-lvl1 {
				polling-delay-passive = <0x64>;
				polling-delay = <0x00>;
				thermal-sensors = <0x10 0x06>;

				trips {

					thermal-engine-trip {
						temperature = <0x64>;
						hysteresis = <0x00>;
						type = "passive";
					};

					thermal-hal-trip {
						temperature = <0x64>;
						hysteresis = <0x00>;
						type = "passive";
					};

					b-bcl-lvl1 {
						temperature = <0x01>;
						hysteresis = <0x01>;
						type = "passive";
						phandle = <0x17>;
					};
				};
			};

			pm8350b-bcl-lvl2 {
				polling-delay-passive = <0x64>;
				polling-delay = <0x00>;
				thermal-sensors = <0x10 0x07>;

				trips {

					thermal-engine-trip {
						temperature = <0x64>;
						hysteresis = <0x00>;
						type = "passive";
					};

					thermal-hal-trip {
						temperature = <0x64>;
						hysteresis = <0x00>;
						type = "passive";
					};

					b-bcl-lvl2 {
						temperature = <0x01>;
						hysteresis = <0x01>;
						type = "passive";
						phandle = <0x18>;
					};
				};
			};

			socd {
				polling-delay-passive = <0x64>;
				polling-delay = <0x00>;

				trips {

					thermal-engine-trip {
						temperature = <0x64>;
						hysteresis = <0x00>;
						type = "passive";
					};

					thermal-hal-trip {
						temperature = <0x64>;
						hysteresis = <0x00>;
						type = "passive";
					};

					socd-trip {
						temperature = <0x64>;
						hysteresis = <0x00>;
						type = "passive";
						phandle = <0x6a>;
					};
				};
			};
		};
	};

	fragment@8 {
		target = <0xffffffff>;

		__overlay__ {
			#address-cells = <0x02>;
			#size-cells = <0x00>;
			interrupt-controller;
			#interrupt-cells = <0x04>;

			qcom,pmr735a@4 {
				compatible = "qcom,spmi-pmic";
				reg = <0x04 0x00>;
				#address-cells = <0x01>;
				#size-cells = <0x00>;
				phandle = <0x6b>;

				qcom,temp-alarm@a00 {
					compatible = "qcom,spmi-temp-alarm";
					reg = <0xa00>;
					interrupts = <0x04 0x0a 0x00 0x03>;
					#thermal-sensor-cells = <0x00>;
					phandle = <0x11>;
				};

				pinctrl@8800 {
					compatible = "qcom,pmr735a-gpio";
					reg = <0x8800>;
					gpio-controller;
					#gpio-cells = <0x02>;
					interrupt-controller;
					#interrupt-cells = <0x02>;
					phandle = <0x6c>;
				};
			};
		};
	};

	fragment@9 {
		target = <0xffffffff>;

		__overlay__ {

			pmr735a_tz {
				polling-delay-passive = <0x64>;
				polling-delay = <0x00>;
				thermal-governor = "step_wise";
				thermal-sensors = <0x11>;
				phandle = <0x6d>;

				trips {

					trip0 {
						temperature = <0x17318>;
						hysteresis = <0x00>;
						type = "passive";
						phandle = <0x6e>;
					};

					trip1 {
						temperature = <0x1c138>;
						hysteresis = <0x00>;
						type = "passive";
						phandle = <0x6f>;
					};

					trip2 {
						temperature = <0x23668>;
						hysteresis = <0x00>;
						type = "passive";
						phandle = <0x70>;
					};
				};
			};
		};
	};

	fragment@10 {
		target = <0xffffffff>;

		__overlay__ {
			#address-cells = <0x02>;
			#size-cells = <0x00>;
			interrupt-controller;
			#interrupt-cells = <0x04>;

			qcom,pmr735b@5 {
				compatible = "qcom,spmi-pmic";
				reg = <0x05 0x00>;
				#address-cells = <0x01>;
				#size-cells = <0x00>;

				qcom,temp-alarm@a00 {
					compatible = "qcom,spmi-temp-alarm";
					reg = <0xa00>;
					interrupts = <0x05 0x0a 0x00 0x03>;
					#thermal-sensor-cells = <0x00>;
					phandle = <0x12>;
				};

				pinctrl@8800 {
					compatible = "qcom,pmr735b-gpio";
					reg = <0x8800>;
					gpio-controller;
					#gpio-cells = <0x02>;
					interrupt-controller;
					#interrupt-cells = <0x02>;
					phandle = <0x71>;
				};
			};
		};
	};

	fragment@11 {
		target = <0xffffffff>;

		__overlay__ {

			pmr735b_tz {
				polling-delay-passive = <0x64>;
				polling-delay = <0x00>;
				thermal-governor = "step_wise";
				thermal-sensors = <0x12>;
				phandle = <0x72>;

				trips {

					trip0 {
						temperature = <0x17318>;
						hysteresis = <0x00>;
						type = "passive";
						phandle = <0x73>;
					};

					trip1 {
						temperature = <0x1c138>;
						hysteresis = <0x00>;
						type = "passive";
						phandle = <0x74>;
					};

					trip2 {
						temperature = <0x23668>;
						hysteresis = <0x00>;
						type = "passive";
						phandle = <0x75>;
					};
				};
			};
		};
	};

	fragment@12 {
		target = <0xffffffff>;

		__overlay__ {
			#address-cells = <0x02>;
			#size-cells = <0x00>;
			interrupt-controller;
			#interrupt-cells = <0x04>;

			qcom,pm8450@7 {
				compatible = "qcom,spmi-pmic";
				reg = <0x07 0x00>;
				#address-cells = <0x01>;
				#size-cells = <0x00>;

				qcom,temp-alarm@a00 {
					compatible = "qcom,spmi-temp-alarm";
					reg = <0xa00>;
					interrupts = <0x07 0x0a 0x00 0x03>;
					#thermal-sensor-cells = <0x00>;
					phandle = <0x13>;
				};

				pinctrl@8800 {
					compatible = "qcom,pm8450-gpio";
					reg = <0x8800>;
					gpio-controller;
					#gpio-cells = <0x02>;
					interrupt-controller;
					#interrupt-cells = <0x02>;
					phandle = <0x76>;
				};
			};
		};
	};

	fragment@13 {
		target = <0xffffffff>;

		__overlay__ {

			pm8450_tz {
				polling-delay-passive = <0x64>;
				polling-delay = <0x00>;
				thermal-governor = "step_wise";
				thermal-sensors = <0x13>;
				phandle = <0x77>;

				trips {

					trip0 {
						temperature = <0x17318>;
						hysteresis = <0x00>;
						type = "passive";
						phandle = <0x1c>;
					};

					trip1 {
						temperature = <0x1c138>;
						hysteresis = <0x00>;
						type = "passive";
						phandle = <0x78>;
					};

					trip2 {
						temperature = <0x23668>;
						hysteresis = <0x00>;
						type = "passive";
						phandle = <0x79>;
					};
				};
			};
		};
	};

	fragment@14 {
		target = <0xffffffff>;

		__overlay__ {

			reboot_reason {
				compatible = "qcom,reboot-reason";
				nvmem-cells = <0x14>;
				nvmem-cell-names = "restart_reason";
			};

			pmic-pon-log {
				compatible = "qcom,pmic-pon-log";
				nvmem = <0x15>;
				nvmem-names = "pon_log";
			};
		};
	};

	fragment@15 {
		target = <0xffffffff>;

		__overlay__ {

			pm8350b-bcl-lvl0 {

				cooling-maps {

					vbat_lte0 {
						trip = <0x16>;
						cooling-device = <0xffffffff 0x08 0x08>;
					};

					vbat_nr0_scg {
						trip = <0x16>;
						cooling-device = <0xffffffff 0x03 0x03>;
					};

					vbat_nr0 {
						trip = <0x16>;
						cooling-device = <0xffffffff 0x06 0x06>;
					};

					vbat_cdsp0 {
						trip = <0x16>;
						cooling-device = <0xffffffff 0x02 0x02>;
					};

					vbat_cpu_5 {
						trip = <0x16>;
						cooling-device = <0xffffffff 0x01 0x01>;
					};

					vbat_gpu0 {
						trip = <0x16>;
						cooling-device = <0xffffffff 0x02 0x02>;
					};
				};
			};

			pm8350b-bcl-lvl1 {

				cooling-maps {

					vbat_lte1 {
						trip = <0x17>;
						cooling-device = <0xffffffff 0x0a 0x0a>;
					};

					vbat_nr1_scg {
						trip = <0x17>;
						cooling-device = <0xffffffff 0x0a 0x0a>;
					};

					vbat_nr1 {
						trip = <0x17>;
						cooling-device = <0xffffffff 0x09 0x09>;
					};

					vbat_cdsp1 {
						trip = <0x17>;
						cooling-device = <0xffffffff 0x04 0x04>;
					};

					vbat_cpu_6_7 {
						trip = <0x17>;
						cooling-device = <0xffffffff 0x01 0x01>;
					};

					vbat_gpu1 {
						trip = <0x17>;
						cooling-device = <0xffffffff 0x04 0x04>;
					};
				};
			};

			pm8350b-bcl-lvl2 {

				cooling-maps {

					vbat_cdsp2 {
						trip = <0x18>;
						cooling-device = <0xffffffff 0x05 0xffffffff>;
					};

					vbat_gpu2 {
						trip = <0x18>;
						cooling-device = <0xffffffff 0x07 0xffffffff>;
					};
				};
			};

			pm8350c-bcl-lvl0 {

				cooling-maps {

					vph_lte0 {
						trip = <0x19>;
						cooling-device = <0xffffffff 0x08 0x08>;
					};

					vph_nr0_scg {
						trip = <0x19>;
						cooling-device = <0xffffffff 0x03 0x03>;
					};

					vph_nr0 {
						trip = <0x19>;
						cooling-device = <0xffffffff 0x06 0x06>;
					};

					vph_cdsp0 {
						trip = <0x19>;
						cooling-device = <0xffffffff 0x02 0x02>;
					};

					vph_cpu_5 {
						trip = <0x19>;
						cooling-device = <0xffffffff 0x01 0x01>;
					};

					vph_gpu0 {
						trip = <0x19>;
						cooling-device = <0xffffffff 0x02 0x02>;
					};
				};
			};

			pm8350c-bcl-lvl1 {

				cooling-maps {

					vph_lte1 {
						trip = <0x1a>;
						cooling-device = <0xffffffff 0x0a 0x0a>;
					};

					vph_nr1_scg {
						trip = <0x1a>;
						cooling-device = <0xffffffff 0x0a 0x0a>;
					};

					vph_nr1 {
						trip = <0x1a>;
						cooling-device = <0xffffffff 0x09 0x09>;
					};

					vph_cdsp1 {
						trip = <0x1a>;
						cooling-device = <0xffffffff 0x04 0x04>;
					};

					vph_cpu_6_7 {
						trip = <0x1a>;
						cooling-device = <0xffffffff 0x01 0x01>;
					};

					vph_gpu1 {
						trip = <0x1a>;
						cooling-device = <0xffffffff 0x04 0x04>;
					};
				};
			};

			pm8350c-bcl-lvl2 {

				cooling-maps {

					vph_cdsp2 {
						trip = <0x1b>;
						cooling-device = <0xffffffff 0x05 0xffffffff>;
					};

					vph_gpu2 {
						trip = <0x1b>;
						cooling-device = <0xffffffff 0x07 0xffffffff>;
					};
				};
			};

			pm8450_tz {

				cooling-maps {

					pm8450_cpu4_freq {
						trip = <0x1c>;
						cooling-device = <0xffffffff 0x0f 0xffffffff>;
					};

					pm8450_cpu7_freq {
						trip = <0x1c>;
						cooling-device = <0xffffffff 0x0f 0xffffffff>;
					};

					pm8450_apc1 {
						trip = <0x1c>;
						cooling-device = <0xffffffff 0x01 0x01>;
					};
				};
			};

			pm8350_tz {

				cooling-maps {

					pm8350_gpu {
						trip = <0x1d>;
						cooling-device = <0xffffffff 0x07 0xffffffff>;
					};

					pm8350_cpu4_freq {
						trip = <0x1d>;
						cooling-device = <0xffffffff 0x0f 0xffffffff>;
					};

					pm8350_cpu7_freq {
						trip = <0x1d>;
						cooling-device = <0xffffffff 0x0f 0xffffffff>;
					};

					pm8350_apc1 {
						trip = <0x1d>;
						cooling-device = <0xffffffff 0x01 0x01>;
					};
				};
			};

			pm8350c_tz {

				cooling-maps {

					pm8350c_nsp {
						trip = <0x1e>;
						cooling-device = <0xffffffff 0x05 0xffffffff>;
					};

					pm8350c_lte {
						trip = <0x1e>;
						cooling-device = <0xffffffff 0xff 0xff>;
					};

					pm8350c_nr {
						trip = <0x1e>;
						cooling-device = <0xffffffff 0xff 0xff>;
					};
				};
			};
		};
	};

	fragment@16 {
		target = <0xffffffff>;

		__overlay__ {
			compatible = "qcom,ufs-phy-qmp-v4-waipio";
			vdda-phy-supply = <0xffffffff>;
			vdda-pll-supply = <0xffffffff>;
			vdda-phy-max-microamp = <0x2a3c8>;
			vdda-pll-max-microamp = <0x6144>;
			status = "ok";
		};
	};

	fragment@17 {
		target = <0xffffffff>;

		__overlay__ {
			vdd-hba-supply = <0xffffffff>;
			vcc-supply = <0xffffffff>;
			vcc-max-microamp = <0x10c8e0>;
			vccq-supply = <0xffffffff>;
			vccq-max-microamp = <0x124f80>;
			qcom,vddp-ref-clk-supply = <0xffffffff>;
			qcom,vddp-ref-clk-max-microamp = <0x64>;
			qcom,vccq-parent-supply = <0xffffffff>;
			qcom,vccq-parent-max-microamp = <0x33450>;
			status = "ok";
		};
	};

	fragment@18 {
		target = <0xffffffff>;

		__overlay__ {
			status = "disabled";
			vdd-supply = <0xffffffff>;
			qcom,vdd-voltage-level = <0x2d2a80 0x2d2a80>;
			qcom,vdd-current-level = <0x00 0xc3500>;
			vdd-io-supply = <0xffffffff>;
			qcom,vdd-io-voltage-level = <0x1b7740 0x2d2a80>;
			qcom,vdd-io-current-level = <0x00 0x55f0>;
			pinctrl-names = "default\0sleep";
			pinctrl-0 = <0xffffffff>;
			pinctrl-1 = <0xffffffff>;
			cd-gpios = <0xffffffff 0x5c 0x01>;
		};
	};

	fragment@19 {
		target = <0xffffffff>;

		__overlay__ {

			gpio_keys {
				compatible = "gpio-keys";
				label = "gpio-keys";
				pinctrl-names = "default";
				pinctrl-0 = <0x1f>;

				vol_up {
					label = "volume_up";
					gpios = <0x20 0x06 0x01>;
					linux,input-type = <0x01>;
					linux,code = <0x73>;
					gpio-key,wakeup;
					debounce-interval = <0x20>;
					linux,can-disable;
				};
			};

			mtdoops_pmsg@0xa7000000 {
				compatible = "mtdoops_pmsg";
				reg = <0xa7000000 0x400000>;
				console-size = <0x200000>;
				pmsg-size = <0x200000>;
			};

			hardwareinfo {
				compatible = "xiaomi,hardware-info";
				status = "ok";
			};
		};
	};

	fragment@20 {
		target = <0xffffffff>;

		__overlay__ {
			status = "ok";

			ir-spi@0 {
				compatible = "ir-spi";
				reg = <0x00>;
				spi-max-frequency = <0x124f800>;
				status = "ok";
			};
		};
	};

	fragment@21 {
		target = <0xffffffff>;

		__overlay__ {
			qcom,thermal-mitigation = <0x2dc6c0 0x16e360 0xf4240 0x7a120>;
			qcom,wireless-fw-name = "idt9415.bin";
		};
	};

	fragment@22 {
		target = <0xffffffff>;

		__overlay__ {
			status = "ok";
			qcom,clk-freq-out = <0xf4240>;
			#address-cells = <0x01>;
			#size-cells = <0x00>;

			nq@28 {
				compatible = "qcom,sn-nci";
				reg = <0x28>;
				qcom,sn-irq = <0xffffffff 0x2e 0x00>;
				qcom,sn-ven = <0xffffffff 0x22 0x00>;
				qcom,sn-firm = <0xffffffff 0x2d 0x00>;
				qcom,sn-clkreq = <0xffffffff 0x23 0x00>;
				qcom,sn-vdd-1p8-supply = <0xffffffff>;
				qcom,sn-vdd-1p8-voltage = <0x1b7740 0x1b7740>;
				qcom,sn-vdd-1p8-current = <0x26548>;
				interrupt-parent = <0xffffffff>;
				interrupts = <0x2e 0x00>;
				interrupt-names = "nfc_irq";
				pinctrl-names = "nfc_active\0nfc_suspend";
				pinctrl-0 = <0xffffffff 0xffffffff>;
				pinctrl-1 = <0xffffffff 0xffffffff>;
			};
		};
	};

	fragment@23 {
		target = <0xffffffff>;

		__overlay__ {
			usb-role-switch;

			dwc3@a600000 {
				usb-role-switch;
				dr_mode = "otg";
			};

			port {

				endpoint {
					remote-endpoint = <0x21>;
					phandle = <0x22>;
				};
			};

			synaptics_tcm@20 {
				compatible = "synaptics,tcm-i2c";
				reg = <0x20>;
				interrupt-parent = <0xffffffff>;
				interrupts = <0x15 0x2008>;
				pinctrl-names = "pmx_ts_active\0pmx_ts_suspend\0pmx_ts_release";
				pinctrl-0 = <0xffffffff>;
				pinctrl-1 = <0xffffffff 0xffffffff>;
				pinctrl-2 = <0xffffffff>;
				vdd-supply = <0xffffffff>;
				avdd-supply = <0xffffffff>;
				synaptics,pwr-reg-name = "avdd";
				synaptics,bus-reg-name = "vdd";
				synaptics,irq-gpio = <0xffffffff 0x15 0x2008>;
				synaptics,irq-on-state = <0x00>;
				synaptics,reset-gpio = <0xffffffff 0x14 0x00>;
				synaptics,reset-on-state = <0x00>;
				synaptics,reset-active-ms = <0x14>;
				synaptics,reset-delay-ms = <0xc8>;
				synaptics,power-delay-ms = <0xc8>;
				synaptics,ubl-i2c-addr = <0x20>;
				synaptics,extend_report;
				synaptics,firmware-name = "synaptics_firmware.img";
			};
		};
	};

	fragment@24 {
		target = <0xffffffff>;

		__overlay__ {

			connector {

				port {

					endpoint {
						remote-endpoint = <0x22>;
						phandle = <0x21>;
					};
				};
			};
		};
	};

	fragment@25 {
		target = <0xffffffff>;

		__overlay__ {
			#address-cells = <0x02>;
			#size-cells = <0x02>;
			ranges;

			ramoops@0xa7000000 {
				compatible = "ramoops";
				reg = <0x00 0xa7000000 0x00 0x400000>;
				console-size = <0x200000>;
				pmsg-size = <0x200000>;
			};
		};
	};

	fragment@26 {
		target = <0xffffffff>;

		__overlay__ {
			#address-cells = <0x01>;
			#size-cells = <0x00>;
			clock-frequency = <0x61a80>;
			status = "ok";

			aw8697_haptic@5A {
				compatible = "awinic,awinic_haptic";
				reg = <0x5a>;
				reset-gpio = <0xffffffff 0x59 0x00>;
				irq-gpio = <0xffffffff 0x5a 0x00>;
				pinctrl-names = "awinic_reset_reset\0awinic_reset_active\0awinic_interrupt_active";
				pinctrl-0 = <0x23>;
				pinctrl-1 = <0x24>;
				pinctrl-2 = <0x25>;
				aw8697_vib_mode = <0x00>;
				aw8697_vib_f0_pre = <0x514>;
				aw8697_vib_f0_cali_percen = <0x07>;
				aw8697_vib_cont_drv_lev = <0x3c>;
				aw8697_vib_cont_drv_lvl_ov = <0x3c>;
				aw8697_vib_cont_td = <0xef>;
				aw8697_vib_cont_zc_thr = <0x8f8>;
				aw8697_vib_cont_num_brk = <0x03>;
				aw8697_vib_f0_coeff = <0x104>;
				aw8697_vib_f0_trace_parameter = <0x09 0x03 0x01 0x1f>;
				aw8697_vib_bemf_config = <0x00 0x08 0x03 0xf8>;
				aw8697_vib_sw_brake = <0x2c>;
				aw8697_vib_tset = <0x1a>;
				aw8697_vib_r_spare = <0x68>;
				aw8697_vib_bstdbg = <0x30 0xeb 0xd4 0x00 0x00 0x00>;
				aw8697_vib_trig_config = <0x00 0x01 0x00 0x01 0x02 0x00 0x01 0x00 0x01 0x02 0x00 0x01 0x00 0x01 0x02>;
				aw8697_vib_bst_vol_default = <0x0e>;
				aw8697_vib_bst_vol_ram = <0x0e>;
				aw8697_vib_bst_vol_rtp = <0x0e>;
				aw86927_vib_mode = <0x00>;
				aw86927_vib_f0_pre = <0x514>;
				aw86927_vib_f0_cali_percen = <0x07>;
				aw86927_vib_cont_drv1_lvl = <0x7f>;
				aw86927_vib_cont_drv2_lvl = <0x36>;
				aw86927_vib_cont_drv1_time = <0x04>;
				aw86927_vib_cont_drv2_time = <0x06>;
				aw86927_vib_cont_drv_width = <0x6a>;
				aw86927_vib_cont_wait_num = <0x06>;
				aw86927_vib_cont_brk_time = <0x08>;
				aw86927_vib_cont_track_margin = <0x0c>;
				aw86927_vib_brk_bst_md = <0x00>;
				aw86927_vib_cont_tset = <0x06>;
				aw86927_vib_cont_bemf_set = <0x02>;
				aw86927_vib_cont_bst_brk_gain = <0x05>;
				aw86927_vib_cont_brk_gain = <0x08>;
				aw86927_vib_d2s_gain = <0x04>;
				aw86927_vib_trig_config = <0x00 0x00 0x00 0x01 0x00 0x02 0x00 0x00 0x00 0x00 0x00 0x01 0x00 0x02 0x00 0x00 0x00 0x00 0x00 0x01 0x00 0x02 0x00 0x00>;
				aw86927_vib_bst_vol_default = <0x5f>;
				aw86927_vib_bst_vol_ram = <0x5f>;
				aw86927_vib_bst_vol_rtp = <0x5f>;
				vib_effect_id_boundary = <0x0a>;
				vib_effect_max = <0xc5>;
				vib_rtp_time = <0x14 0x14 0x14 0x14 0x14 0x14 0x14 0x14 0x4e20 0x3a98 0x3a98 0x4e20 0x61a8 0x3a98 0x7530 0x61a8 0x4e20 0x4e20 0x4e20 0x4e20 0x4e20 0x4e20 0x4e20 0x4e20 0x4e20 0x4e20 0x4e20 0x4e20 0x4e20 0x4e20 0x4e20 0x4e20 0x4e20 0x4e20 0x4e20 0x4e20 0x4e20 0x4e20 0x4e20 0x4e20 0x4e20 0x4e20 0x4e20 0x4e20 0x4e20 0x4e20 0x4e20 0x4e20 0x4e20 0x4e20 0x4e20 0x4e20 0x4e20 0x4e20 0x4e20 0x4e20 0x4e20 0x4e20 0x4e20 0x4e20 0x4e20 0x4e20 0x4e20 0x4e20 0x4e20 0x4e20 0x4e20 0x4e20 0x4e20 0x4e20 0x4e20 0x4e20 0x4e20 0x4e20 0x4e20 0x4e20 0x4e20 0x4e20 0x4e20 0x4e20 0x4e20 0x4e20 0x4e20 0x4e20 0x4e20 0x4e20 0x4e20 0x4e20 0x4e20 0x4e20 0x4e20 0x4e20 0x4e20 0x4e20 0x4e20 0x4e20 0x4e20 0x4e20 0x4e20 0x4e20 0x4e20 0x4e20 0x4e20 0x4e20 0x4e20 0x4e20 0x4e20 0x4e20 0x4e20 0x4e20 0x4e20 0x4e20 0x4e20 0x4e20 0x4e20 0x4e20 0x4e20 0x4e20 0x4e20 0x4e20 0x4e20 0x4e20 0x4e20 0x4e20 0x4e20 0x4e20 0x4e20 0x4e20 0x4e20 0x4e20 0x4e20 0x4e20 0x4e20 0x4e20 0x4e20 0x4e20 0x4e20 0x4e20 0x4e20 0x4e20 0x4e20 0x4e20 0x4e20 0x4e20 0x4e20 0x4e20 0x4e20 0x4e20 0x4e20 0x4e20 0x4e20 0x4e20 0x4e20 0x4e20 0x4e20 0x4e20 0x4e20 0x4e20 0x4e20 0x4e20 0x4e20 0x4e20 0x4e20 0x4e20 0x4e20 0x4e20 0x4e20 0x4e20 0x4e20 0x4e20 0x4e20 0x4e20 0x4e20 0x4e20 0x4e20>;
				status = "ok";

				wf_0 {
					qcom,effect-id = <0x00>;
					qcom,wf-vmax-mv = <0xe10>;
					qcom,wf-pattern = [3e 3e];
					qcom,wf-brake-pattern = <0x2010000>;
					qcom,wf-play-rate-us = <0x4e20>;
				};

				wf_1 {
					qcom,effect-id = <0x01>;
					qcom,wf-vmax-mv = <0xe10>;
					qcom,wf-pattern = [7e 3e];
					qcom,wf-brake-pattern = <0x3010000>;
					qcom,wf-play-rate-us = <0x4e20>;
				};

				wf_2 {
					qcom,effect-id = <0x02>;
					qcom,wf-vmax-mv = <0xe10>;
					qcom,wf-pattern = [7e 3e];
					qcom,wf-brake-pattern = <0x2010000>;
					qcom,wf-play-rate-us = <0x4e20>;
				};

				wf_3 {
					qcom,effect-id = <0x03>;
					qcom,wf-vmax-mv = <0xe10>;
					qcom,wf-pattern = [3e 3e];
					qcom,wf-brake-pattern = <0x2010000>;
					qcom,wf-play-rate-us = <0x4e20>;
				};

				wf_4 {
					qcom,effect-id = <0x04>;
					qcom,wf-vmax-mv = <0xe10>;
					qcom,wf-pattern = [3e 3e];
					qcom,wf-brake-pattern = <0x2010000>;
					qcom,wf-play-rate-us = <0x6d60>;
				};

				wf_5 {
					qcom,effect-id = <0x05>;
					qcom,wf-vmax-mv = <0xe10>;
					qcom,wf-pattern = [7e 7e 7e];
					qcom,wf-brake-pattern = <0x3030100>;
					qcom,wf-play-rate-us = <0x4e20>;
				};

				wf_6 {
					qcom,effect-id = <0x06>;
					qcom,wf-vmax-mv = <0xe10>;
					qcom,wf-pattern = [3e 3e];
					qcom,wf-brake-pattern = <0x2010000>;
					qcom,wf-play-rate-us = <0x4e20>;
				};

				wf_7 {
					qcom,effect-id = <0x07>;
					qcom,wf-vmax-mv = <0xe10>;
					qcom,wf-pattern = [3e 3e];
					qcom,wf-brake-pattern = <0x2010000>;
					qcom,wf-play-rate-us = <0x4e20>;
				};

				wf_8 {
					qcom,effect-id = <0x08>;
					qcom,wf-vmax-mv = <0xe10>;
					qcom,wf-pattern = [3e 3e];
					qcom,wf-brake-pattern = <0x2010000>;
					qcom,wf-play-rate-us = <0x4e20>;
				};

				wf_9 {
					qcom,effect-id = <0x09>;
					qcom,wf-vmax-mv = <0xe10>;
					qcom,wf-pattern = [3e 3e];
					qcom,wf-brake-pattern = <0x2010000>;
					qcom,wf-play-rate-us = <0x4e20>;
				};
			};
		};
	};

	fragment@27 {
		target = <0xffffffff>;

		__overlay__ {
			status = "ok";

			cs35l41@40 {
				status = "ok";
				compatible = "cirrus,cs35l41";
				reset-gpios = <0xffffffff 0x78 0x00>;
				reg = <0x40>;
				interrupt-parent = <0xffffffff>;
				interrupts = <0x75 0x2008>;
				pinctrl-names = "default";
				pinctrl-0 = <0x26 0x27>;
				cirrus,temp-warn_threshold = <0x03>;
				cirrus,boost-peak-milliamp = <0xfa0>;
				cirrus,boost-ind-nanohenry = <0x3e8>;
				cirrus,boost-cap-microfarad = <0x0f>;
				cirrus,asp-sdout-hiz = <0x03>;
				cirrus,right-channel-amp;
				sound-name-prefix = "BH";
				cirrus,fast-switch = "BH-music.txt\0BH-handfree.txt";
				phandle = <0x7a>;

				cirrus,gpio-config2 {
					cirrus,gpio-src-select = <0x04>;
					cirrus,gpio-output-enable;
				};
			};

			cs35l41@41 {
				status = "ok";
				compatible = "cirrus,cs35l41";
				reset-gpios = <0xffffffff 0x09 0x00>;
				reg = <0x41>;
				interrupt-parent = <0xffffffff>;
				interrupts = <0x76 0x2008>;
				pinctrl-names = "default";
				pinctrl-0 = <0x28 0x29>;
				cirrus,temp-warn_threshold = <0x03>;
				cirrus,boost-peak-milliamp = <0xfa0>;
				cirrus,boost-ind-nanohenry = <0x3e8>;
				cirrus,boost-cap-microfarad = <0x0f>;
				cirrus,asp-sdout-hiz = <0x03>;
				cirrus,right-channel-amp;
				sound-name-prefix = "BL";
				cirrus,fast-switch = "BL-music.txt\0BL-handfree.txt";
				phandle = <0x7b>;

				cirrus,gpio-config2 {
					cirrus,gpio-src-select = <0x04>;
					cirrus,gpio-output-enable;
				};
			};

			cs35l41@42 {
				status = "ok";
				compatible = "cirrus,cs35l41";
				reset-gpios = <0xffffffff 0x03 0x00>;
				reg = <0x42>;
				interrupt-parent = <0xffffffff>;
				interrupts = <0x3f 0x2008>;
				pinctrl-names = "default";
				pinctrl-0 = <0x2a 0x2b>;
				cirrus,temp-warn_threshold = <0x03>;
				cirrus,boost-peak-milliamp = <0xfa0>;
				cirrus,boost-ind-nanohenry = <0x3e8>;
				cirrus,boost-cap-microfarad = <0x0f>;
				cirrus,asp-sdout-hiz = <0x03>;
				sound-name-prefix = "TH";
				cirrus,fast-switch = "TH-music.txt\0TH-handfree.txt";
				phandle = <0x7c>;

				cirrus,gpio-config2 {
					cirrus,gpio-src-select = <0x04>;
					cirrus,gpio-output-enable;
				};
			};

			cs35l41@43 {
				status = "ok";
				compatible = "cirrus,cs35l41";
				reset-gpios = <0xffffffff 0x01 0x00>;
				spk-sw-gpios = <0xffffffff 0x34 0x00>;
				reg = <0x43>;
				interrupt-parent = <0xffffffff>;
				interrupts = <0x58 0x2008>;
				pinctrl-names = "default";
				pinctrl-0 = <0x2c 0x2d>;
				cirrus,temp-warn_threshold = <0x03>;
				cirrus,boost-peak-milliamp = <0xfa0>;
				cirrus,boost-ind-nanohenry = <0x3e8>;
				cirrus,boost-cap-microfarad = <0x0f>;
				cirrus,asp-sdout-hiz = <0x03>;
				sound-name-prefix = "TL";
				cirrus,fast-switch = "TL-music.txt\0TL-handset.txt\0TL-handfree.txt";
				phandle = <0x7d>;

				cirrus,gpio-config2 {
					cirrus,gpio-src-select = <0x04>;
					cirrus,gpio-output-enable;
				};
			};
		};
	};

	fragment@28 {
		target = <0xffffffff>;

		__overlay__ {
			status = "ok";

			aw22xxx_led@6a {
				compatible = "awinic,aw22xxx_led";
				reg = <0x6a>;
				reset-gpio = <0xffffffff 0x61 0x00>;
				status = "okay";

				aw22xxx,led {
					aw22xxx,name = "aw22xxx_led";
					aw22xxx,imax = <0x02>;
					aw22xxx,brightness = <0x80>;
					aw22xxx,max_brightness = <0xff>;
				};
			};
		};
	};

	fragment@29 {
		target = <0xffffffff>;

		__overlay__ {

			xiaomi_touch {
				compatible = "xiaomi-touch";
				status = "ok";
				touch,name = "xiaomi-touch";
			};

			mi_game_plaid {
				compatible = "xiaomi-gpu-plaid";
			};

			thermal-message {
				board-sensor = "VIRTUAL-SENSOR0";
				phandle = <0x7e>;
			};

			gamekey {
				compatible = "xm,gamekey";
				status = "ok";
				key_left = <0xffffffff 0xab 0x00>;
				hall_left = <0xffffffff 0x47 0x00>;
				key_right = <0xffffffff 0xac 0x00>;
				hall_right = <0xffffffff 0x3e 0x00>;
				debounce_time = <0x20>;
				gamekey_vreg-supply = <0xffffffff>;
				pinctrl-names = "gamekey_active\0gamekey_suspend";
				pinctrl-0 = <0x2e 0x2f 0x30 0x31>;
				pinctrl-1 = <0x32 0x33 0x34>;
				phandle = <0x7f>;
			};
		};
	};

	fragment@30 {
		target = <0xffffffff>;

		__overlay__ {

			mi_ts_active {
				phandle = <0x35>;

				mux {
					pins = "gpio21\0gpio20";
					function = "gpio";
				};

				config {
					pins = "gpio21\0gpio20";
					drive-strength = <0x08>;
					bias-pull-up;
				};
			};

			awinic_gpio_reset {
				phandle = <0x23>;

				mux {
					pins = "gpio89";
					unction = "gpio";
				};

				config {
					pins = "gpio89";
					drive-strength = <0x02>;
					bias-disable;
					output-low;
				};
			};

			awinic_gpio_reset_output_high {
				phandle = <0x24>;

				mux {
					pins = "gpio89";
					function = "gpio";
				};

				config {
					pins = "gpio89";
					drive-strength = <0x02>;
					bias-disable;
					output-high;
				};
			};

			awinic_gpio_int {
				phandle = <0x25>;

				mux {
					pins = "gpio90";
					function = "gpio";
				};

				config {
					pins = "gpio90";
					drive-strength = <0x02>;
					bias-pull-up;
					input-enable;
				};
			};

			gk_hall_act_left {
				phandle = <0x2e>;

				mux {
					pins = "gpio71";
					function = "gpio";
				};

				config {
					pins = "gpio71";
					input-enable;
					bias-disable;
				};
			};

			gk_hall_act_right {
				phandle = <0x2f>;

				mux {
					pins = "gpio62";
					function = "gpio";
				};

				config {
					pins = "gpio62";
					input-enable;
					bias-disable;
				};
			};

			gk_hall_sup {
				phandle = <0x32>;
			};

			gk_key_act_left {
				phandle = <0x30>;

				mux {
					pins = "gpio171";
					function = "gpio";
				};

				config {
					pins = "gpio171";
					drive-strength = <0x02>;
					bias-pull-up;
					input-enable;
				};
			};

			gk_key_act_right {
				phandle = <0x31>;

				mux {
					pins = "gpio172";
					function = "gpio";
				};

				config {
					pins = "gpio172";
					drive-strength = <0x02>;
					bias-pull-up;
					input-enable;
				};
			};

			gk_key_sup_left {
				phandle = <0x33>;

				mux {
					pins = "gpio171";
					function = "gpio";
				};

				config {
					pins = "gpio171";
					bias-disable;
				};
			};

			gk_key_sup_right {
				phandle = <0x34>;

				mux {
					pins = "gpio172";
					function = "gpio";
				};

				config {
					pins = "gpio172";
					bias-disable;
				};
			};
		};
	};

	fragment@31 {
		target = <0xffffffff>;

		__overlay__ {
			status = "disabled";
		};
	};

	fragment@32 {
		target = <0xffffffff>;

		__overlay__ {
			status = "ok";
		};
	};

	fragment@33 {
		target = <0xffffffff>;

		__overlay__ {
			status = "ok";
		};
	};

	fragment@34 {
		target = <0xffffffff>;

		__overlay__ {
			status = "ok";

			fts@0 {
				status = "ok";
				compatible = "st,spi";
				reg = <0x00>;
				interrupt-parent = <0xffffffff>;
				interrupts = <0x15 0x2008>;
				pinctrl-names = "pmx_ts_active\0pmx_ts_suspend";
				pinctrl-0 = <0x35>;
				pinctrl-1 = <0xffffffff 0xffffffff>;
				avdd-supply = <0xffffffff>;
				vdd-supply = <0xffffffff>;
				fts,pwr-reg-name = "avdd";
				fts,bus-reg-name = "vdd";
				fts,irq-gpio = <0xffffffff 0x15 0x2008>;
				fts,irq-gpio-name = "fts_irq";
				fts,reset-gpio-enable;
				fts,reset-gpio = <0xffffffff 0x14 0x00>;
				fts,reset-gpio-name = "fts_rst";
				fts,irq-flags = <0x2008>;
				fts,x-max = <0x2a30>;
				fts,y-max = <0x5dc0>;
				spi-max-frequency = <0xb71b00>;
				fts,default-fw-name = "st_fts_l10.ftb";
				fts,htp-fw-name = "st_fts_l10_thp.ftb";
				fts,non-curved-display = <0x01>;
				fts,config-array-size = <0x01>;
				fts,support-super-resolution = <0x01>;
				fts,touch-follow-performance-def = <0x03>;
				fts,touch-tap-sensitivity-def = <0x04>;
				fts,touch-aim-sensitivity-def = <0x03>;
				fts,touch-tap-stability-def = <0x03>;
				fts,cornerfilter-area-step1 = <0x64>;
				fts,cornerfilter-area-step2 = <0xaa>;
				fts,cornerfilter-area-step3 = <0xfa>;
				fts,touch-edgezone-filter-ver = <0x01 0x00 0x00 0x00 0x00 0x00 0x00 0x00 0x01 0x01 0x00 0x00 0x00 0x00 0x00 0x00 0x01 0x02 0x00 0x00 0x28 0x95f 0x00 0x00 0x01 0x03 0x40f 0x00 0x437 0x95f 0x00 0x00>;
				fts,touch-edgezone-filter-hor = <0x01 0x00 0x00 0x00 0x437 0x28 0x00 0x00 0x01 0x01 0x00 0x937 0x437 0x95f 0x00 0x00 0x01 0x02 0x00 0x00 0x28 0x95f 0x00 0x00 0x01 0x03 0x40f 0x00 0x437 0x95f 0x00 0x00>;
				fts,touch-cornerzone-filter-ver = <0x00 0x00 0x00 0x00 0x00 0x00 0x00 0x00 0x00 0x01 0x00 0x00 0x00 0x00 0x00 0x00 0x00 0x02 0x00 0x833 0x96 0x95f 0x00 0x00 0x00 0x03 0x3a1 0x833 0x437 0x95f 0x00 0x00>;
				fts,touch-cornerzone-filter-hor1 = <0x00 0x00 0x00 0x00 0x96 0x96 0x00 0x00 0x00 0x01 0x00 0x00 0x00 0x00 0x00 0x00 0x00 0x02 0x00 0x8c9 0x96 0x95f 0x00 0x00 0x00 0x03 0x00 0x00 0x00 0x00 0x00 0x00>;
				fts,touch-cornerzone-filter-hor2 = <0x00 0x00 0x00 0x00 0x00 0x00 0x00 0x00 0x00 0x01 0x3a1 0x00 0x437 0x96 0x00 0x00 0x00 0x02 0x00 0x00 0x00 0x00 0x00 0x00 0x00 0x03 0x3a1 0x8c9 0x437 0x95f 0x00 0x00>;
				fts,touch-normal-edgezone-filter-hor = <0x01 0x00 0x00 0x00 0x437 0x1e 0x00 0x00 0x01 0x01 0x00 0x941 0x437 0x95f 0x00 0x00 0x01 0x02 0x00 0x00 0x1e 0x95f 0x00 0x00 0x01 0x03 0x419 0x00 0x437 0x95f 0x00 0x00>;
				fts,touch-normal-cornerzone-filter-hor1 = <0x00 0x00 0x00 0x00 0xaa 0xaa 0x00 0x00 0x00 0x01 0x00 0x00 0x00 0x00 0x00 0x00 0x00 0x02 0x00 0x8b5 0xaa 0x95f 0x00 0x00 0x00 0x03 0x00 0x00 0x00 0x00 0x00 0x00>;
				fts,touch-normal-cornerzone-filter-hor2 = <0x00 0x00 0x00 0x00 0x00 0x00 0x00 0x00 0x00 0x01 0x38d 0x00 0x437 0xaa 0x00 0x00 0x00 0x02 0x00 0x00 0x00 0x00 0x00 0x00 0x00 0x03 0x38d 0x8b5 0x437 0x95f 0x00 0x00>;
				fts,touch-follow-performance = <0x0d 0x0f 0x01 0x0a 0x0f 0x01 0x08 0x0f 0x01 0x05 0x0f 0x01 0x02 0x0f 0x01>;
				fts,touch-tap-sensitivity = <0xa0 0x96 0x8c 0x78 0x64>;
				fts,touch-aim-sensitivity = <0x08 0x06 0x04 0x02 0x01>;
				fts,touch-tap-stability = <0x08 0x0c 0x0f 0x12 0x19>;
				fts,touch-expert-array = <0x06 0x0f 0x01 0x78 0x06 0x0f 0x02 0x0f 0x01 0x78 0x04 0x0f 0x04 0x0f 0x01 0x78 0x02 0x0f>;

				fts,cfg_0 {
					fts,tp-vendor = <0x38>;
					fts,fw-name = "st_fts_l10.ftb";
					fts,limit-name = "stm_fts_production_limits.csv";
				};
			};
		};
	};

	fragment@35 {
		target = <0xffffffff>;

		__overlay__ {
			qcom,param-override-seq = <0xa5 0x6c 0x09 0x70 0x04 0x74>;
		};
	};

	fragment@36 {
		target = <0xffffffff>;

		__overlay__ {
			mi,support-2s-charging;
			qcom,shutdown-voltage = <0x1a2c>;
		};
	};

	fragment@37 {
		target = <0xffffffff>;

		__overlay__ {
			regulator-min-microvolt = <0x325aa0>;
			regulator-max-microvolt = <0x325aa0>;
			qcom,init-voltage = <0x325aa0>;
		};
	};

	fragment@38 {
		target = <0xffffffff>;

		__overlay__ {

			fingerprint_goodix {
				compatible = "goodix,fingerprint";
				fp_vdd_vreg-supply = <0xffffffff>;
				goodix,gpio-reset = <0xffffffff 0x29 0x00>;
				goodix,gpio-irq = <0xffffffff 0x28 0x00>;
				status = "ok";
			};

			fingerprint_fpc {
				status = "ok";
				compatible = "fpc,fpc1020";
				interrupt-parent = <0xffffffff>;
				interrupts = <0x28 0x00>;
				fpc,gpio_rst = <0xffffffff 0x29 0x00>;
				fpc,gpio_irq = <0xffffffff 0x28 0x00>;
				fp_vdd_vreg-supply = <0xffffffff>;
				pinctrl-names = "fpc1020_reset_reset\0fpc1020_reset_active\0fpc1020_irq_active";
				pinctrl-0 = <0x36>;
				pinctrl-1 = <0x37>;
				pinctrl-2 = <0x38>;
			};

			xiaomi_fingerprint {
				compatible = "xiaomi-fingerprint";
				status = "ok";
				fingerprint,name = "xiaomi-fingerprint";
			};

			md_testing_mode {
				compatible = "modem,md-testing-mode";
				status-gpio = <0xffffffff 0x96 0x00 0xffffffff 0x9a 0x00>;
				debounce-time = <0x1e>;
				pinctrl-names = "default";
				pinctrl-0 = <0x39 0x3a>;
			};
		};
	};

	fragment@39 {
		target = <0xffffffff>;

		__overlay__ {

			msm_gpio_reset {
				phandle = <0x36>;

				mux {
					pins = "gpio41";
					function = "gpio";
				};

				config {
					pins = "gpio41";
					drive-strength = <0x02>;
					bias-disable;
					output-low;
				};
			};

			msm_gpio_reset_output_high {
				phandle = <0x37>;

				mux {
					pins = "gpio41";
					function = "gpio";
				};

				config {
					pins = "gpio41";
					drive-strength = <0x02>;
					bias-disable;
					output-high;
				};
			};

			msm_gpio_irq {
				phandle = <0x38>;

				mux {
					pins = "gpio40";
					function = "gpio";
				};

				config {
					pins = "gpio40";
					drive-strength = <0x02>;
					bias-pull-down;
				};
			};
		};
	};

	fragment@40 {
		target = <0xffffffff>;

		__overlay__ {

			cpu_therm {
				polling-delay-passive = <0x00>;
				polling-delay = <0x00>;
				thermal-governor = "user_space";
				thermal-sensors = <0x3b 0x144>;
				wake-capable-sensor;

				trips {

					active-config0 {
						temperature = <0x1e848>;
						hysteresis = <0x3e8>;
						type = "passive";
					};
				};
			};

			flash_therm {
				polling-delay-passive = <0x00>;
				polling-delay = <0x00>;
				thermal-governor = "user_space";
				thermal-sensors = <0x3b 0x145>;
				wake-capable-sensor;

				trips {

					active-config0 {
						temperature = <0x1e848>;
						hysteresis = <0x3e8>;
						type = "passive";
					};
				};
			};

			quiet_therm {
				polling-delay-passive = <0x00>;
				polling-delay = <0x00>;
				thermal-governor = "user_space";
				thermal-sensors = <0x3b 0x146>;
				wake-capable-sensor;

				trips {

					active-config0 {
						temperature = <0x1e848>;
						hysteresis = <0x3e8>;
						type = "passive";
					};
				};
			};

			charger_therm1 {
				polling-delay-passive = <0x00>;
				polling-delay = <0x00>;
				thermal-governor = "user_space";
				thermal-sensors = <0x3b 0x147>;
				wake-capable-sensor;

				trips {

					active-config0 {
						temperature = <0x1e848>;
						hysteresis = <0x3e8>;
						type = "passive";
					};
				};
			};

			charger_therm0 {
				polling-delay-passive = <0x00>;
				polling-delay = <0x00>;
				thermal-governor = "user_space";
				thermal-sensors = <0x3b 0x148>;
				wake-capable-sensor;

				trips {

					active-config0 {
						temperature = <0x1e848>;
						hysteresis = <0x3e8>;
						type = "passive";
					};
				};
			};

			pa_therm0 {
				polling-delay-passive = <0x00>;
				polling-delay = <0x00>;
				thermal-governor = "user_space";
				thermal-sensors = <0x3b 0x44a>;
				wake-capable-sensor;

				trips {

					active-config0 {
						temperature = <0x1e848>;
						hysteresis = <0x3e8>;
						type = "passive";
					};
				};
			};

			pa_therm1 {
				polling-delay-passive = <0x00>;
				polling-delay = <0x00>;
				thermal-governor = "user_space";
				thermal-sensors = <0x3b 0x44b>;
				wake-capable-sensor;

				trips {

					active-config0 {
						temperature = <0x1e848>;
						hysteresis = <0x3e8>;
						type = "passive";
					};
				};
			};

			wifi_therm {
				polling-delay-passive = <0x00>;
				polling-delay = <0x00>;
				thermal-governor = "user_space";
				thermal-sensors = <0x3b 0x44c>;
				wake-capable-sensor;

				trips {

					active-config0 {
						temperature = <0x1e848>;
						hysteresis = <0x3e8>;
						type = "passive";
					};
				};
			};

			conn_therm {
				polling-delay-passive = <0x00>;
				polling-delay = <0x00>;
				thermal-governor = "user_space";
				thermal-sensors = <0x3c 0x347>;
				wake-capable-sensor;

				trips {

					active-config0 {
						temperature = <0x1e848>;
						hysteresis = <0x3e8>;
						type = "passive";
					};
				};
			};
		};
	};

	fragment@41 {
		target = <0xffffffff>;

		__overlay__ {
			qcom,critical-devices = <0xffffffff>;
		};
	};

	fragment@42 {
		target = <0xffffffff>;

		__overlay__ {
			#address-cells = <0x01>;
			#size-cells = <0x00>;
			status = "ok";

			wl2866d@28 {
				compatible = "xiaomi,wl2866d";
				reg = <0x28>;
				vin1-supply = <0xffffffff>;
				vin1-voltage-level = <0x1312d0 0x1312d0>;
				vin2-supply = <0xffffffff>;
				vin2-voltage-level = <0x325aa0 0x325aa0>;
				en-gpio = <0xffffffff 0x0b 0x00>;
				status = "ok";
			};
		};
	};

	__symbols__ {
		pm8008j_active = "/fragment@0/__overlay__/pm8008j_active";
		cirrus_reset_default_0 = "/fragment@0/__overlay__/cirrus_reset_default_0";
		cirrus_reset_default_1 = "/fragment@0/__overlay__/cirrus_reset_default_1";
		cirrus_reset_default_2 = "/fragment@0/__overlay__/cirrus_reset_default_2";
		cirrus_reset_default_3 = "/fragment@0/__overlay__/cirrus_reset_default_3";
		ant4_ctrl_irq = "/fragment@0/__overlay__/md_mode_ctrl_irq/ant4_ctrl_irq";
		ant10_ctrl_irq = "/fragment@0/__overlay__/md_mode_ctrl_irq/ant10_ctrl_irq";
		cirrus_irq_default_0 = "/fragment@0/__overlay__/cirrus_irq_default/cirrus_irq_default_0";
		cirrus_irq_default_1 = "/fragment@0/__overlay__/cirrus_irq_default/cirrus_irq_default_1";
		cirrus_irq_default_2 = "/fragment@0/__overlay__/cirrus_irq_default/cirrus_irq_default_2";
		cirrus_irq_default_3 = "/fragment@0/__overlay__/cirrus_irq_default/cirrus_irq_default_3";
		pmk8350 = "/fragment@1/__overlay__/qcom,pmk8350@0";
		pmk8350_vadc = "/fragment@1/__overlay__/qcom,pmk8350@0/vadc@3100";
		pmk8350_adc_tm = "/fragment@1/__overlay__/qcom,pmk8350@0/adc_tm@3400";
		pmk8350_sdam_1 = "/fragment@1/__overlay__/qcom,pmk8350@0/sdam@7000";
		pmk8350_sdam_2 = "/fragment@1/__overlay__/qcom,pmk8350@0/sdam@7100";
		restart_reason = "/fragment@1/__overlay__/qcom,pmk8350@0/sdam@7100/restart@48";
		hap_cl_brake = "/fragment@1/__overlay__/qcom,pmk8350@0/sdam@7100/cl_brake@7c";
		pmk8350_sdam_5 = "/fragment@1/__overlay__/qcom,pmk8350@0/sdam@7400";
		pmk8350_sdam_13 = "/fragment@1/__overlay__/qcom,pmk8350@0/sdam@7c00";
		pmk8350_sdam_14 = "/fragment@1/__overlay__/qcom,pmk8350@0/sdam@7d00";
		pmk8350_sdam_21 = "/fragment@1/__overlay__/qcom,pmk8350@0/sdam@8400";
		pmk8350_sdam_22 = "/fragment@1/__overlay__/qcom,pmk8350@0/sdam@8500";
		pmk8350_sdam_23 = "/fragment@1/__overlay__/qcom,pmk8350@0/sdam@8600";
		pmk8350_sdam_41 = "/fragment@1/__overlay__/qcom,pmk8350@0/sdam@9800";
		pmk8350_sdam_46 = "/fragment@1/__overlay__/qcom,pmk8350@0/sdam@9d00";
		pmk8350_gpios = "/fragment@1/__overlay__/qcom,pmk8350@0/pinctrl@b000";
		pmk8350_rtc = "/fragment@1/__overlay__/qcom,pmk8350@0/rtc@6100";
		pm8350_adc_tm_iio = "/fragment@1/__overlay__/qcom,pmk8350@0/adc_tm_e";
		pm8350_tz = "/fragment@2/__overlay__/qcom,pm8350@1/qcom,temp-alarm@a00";
		pm8350_gpios = "/fragment@2/__overlay__/qcom,pm8350@1/pinctrl@8800";
		pm8350_rear_tof_therm_default = "/fragment@2/__overlay__/qcom,pm8350@1/pinctrl@8800/pm8350_rear_tof_therm/pm8350_rear_tof_therm_default";
		key_vol_up_default = "/fragment@2/__overlay__/qcom,pm8350@1/pinctrl@8800/key_vol_up/key_vol_up_default";
		pm8350_temp_alarm = "/fragment@3/__overlay__/pm8350_tz";
		pm8350_trip0 = "/fragment@3/__overlay__/pm8350_tz/trips/trip0";
		pm8350_trip1 = "/fragment@3/__overlay__/pm8350_tz/trips/trip1";
		pm8350_trip2 = "/fragment@3/__overlay__/pm8350_tz/trips/trip2";
		pm8350c_tz = "/fragment@4/__overlay__/qcom,pm8350c@2/qcom,temp-alarm@a00";
		pm8350c_gpios = "/fragment@4/__overlay__/qcom,pm8350c@2/pinctrl@8800";
		lcd_backlight_ctrl_default = "/fragment@4/__overlay__/qcom,pm8350c@2/pinctrl@8800/lcd_backlight_ctrl/lcd_backlight_ctrl_default";
		pm8350c_pwm_1 = "/fragment@4/__overlay__/qcom,pm8350c@2/pwms@e800";
		pm8350c_pwm_2 = "/fragment@4/__overlay__/qcom,pm8350c@2/pwms@eb00";
		pm8350c_rgb = "/fragment@4/__overlay__/qcom,pm8350c@2/qcom,leds@ef00";
		pm8350c_bcl = "/fragment@4/__overlay__/qcom,pm8350c@2/bcl@4700";
		pm8350c_flash = "/fragment@4/__overlay__/qcom,pm8350c@2/qcom,flash_led@ee00";
		pm8350c_flash0 = "/fragment@4/__overlay__/qcom,pm8350c@2/qcom,flash_led@ee00/qcom,flash_0";
		pm8350c_flash1 = "/fragment@4/__overlay__/qcom,pm8350c@2/qcom,flash_led@ee00/qcom,flash_1";
		pm8350c_flash2 = "/fragment@4/__overlay__/qcom,pm8350c@2/qcom,flash_led@ee00/qcom,flash_2";
		pm8350c_flash3 = "/fragment@4/__overlay__/qcom,pm8350c@2/qcom,flash_led@ee00/qcom,flash_3";
		pm8350c_torch0 = "/fragment@4/__overlay__/qcom,pm8350c@2/qcom,flash_led@ee00/qcom,torch_0";
		pm8350c_torch1 = "/fragment@4/__overlay__/qcom,pm8350c@2/qcom,flash_led@ee00/qcom,torch_1";
		pm8350c_torch2 = "/fragment@4/__overlay__/qcom,pm8350c@2/qcom,flash_led@ee00/qcom,torch_2";
		pm8350c_torch3 = "/fragment@4/__overlay__/qcom,pm8350c@2/qcom,flash_led@ee00/qcom,torch_3";
		pm8350c_switch0 = "/fragment@4/__overlay__/qcom,pm8350c@2/qcom,flash_led@ee00/qcom,led_switch_0";
		pm8350c_switch1 = "/fragment@4/__overlay__/qcom,pm8350c@2/qcom,flash_led@ee00/qcom,led_switch_1";
		pm8350c_switch2 = "/fragment@4/__overlay__/qcom,pm8350c@2/qcom,flash_led@ee00/qcom,led_switch_2";
		pm8350c_temp_alarm = "/fragment@5/__overlay__/pm8350c_tz";
		pm8350c_trip0 = "/fragment@5/__overlay__/pm8350c_tz/trips/trip0";
		pm8350c_trip1 = "/fragment@5/__overlay__/pm8350c_tz/trips/trip1";
		pm8350c_trip2 = "/fragment@5/__overlay__/pm8350c_tz/trips/trip2";
		c_bcl_lvl0 = "/fragment@5/__overlay__/pm8350c-bcl-lvl0/trips/c-bcl-lvl0";
		c_bcl_lvl1 = "/fragment@5/__overlay__/pm8350c-bcl-lvl1/trips/c-bcl-lvl1";
		c_bcl_lvl2 = "/fragment@5/__overlay__/pm8350c-bcl-lvl2/trips/c-bcl-lvl2";
		pm8350b_tz = "/fragment@6/__overlay__/qcom,pm8350b@3/qcom,temp-alarm@a00";
		pm8350b_pbs2 = "/fragment@6/__overlay__/qcom,pm8350b@3/qcom,pbs@1900";
		pm8350b_gpios = "/fragment@6/__overlay__/qcom,pm8350b@3/pinctrl@8800";
		pm8350b_rear_tof_therm_default = "/fragment@6/__overlay__/qcom,pm8350b@3/pinctrl@8800/pm8350b_rear_tof_therm/pm8350b_rear_tof_therm_default";
		pm8350b_bcl = "/fragment@6/__overlay__/qcom,pm8350b@3/bcl@4700";
		bcl_soc = "/fragment@6/__overlay__/qcom,pm8350b@3/bcl-soc";
		pm8350b_haptics = "/fragment@6/__overlay__/qcom,pm8350b@3/qcom,hv-haptics@f000";
		hap_swr_slave_reg = "/fragment@6/__overlay__/qcom,pm8350b@3/qcom,hv-haptics@f000/qcom,hap-swr-slave-reg";
		pm8350b_amoled = "/fragment@6/__overlay__/qcom,pm8350b@3/qcom,amoled";
		oledb_vreg = "/fragment@6/__overlay__/qcom,pm8350b@3/qcom,amoled/oledb@fa00";
		ab_vreg = "/fragment@6/__overlay__/qcom,pm8350b@3/qcom,amoled/ab@f900";
		ibb_vreg = "/fragment@6/__overlay__/qcom,pm8350b@3/qcom,amoled/ibb@f800";
		pm8350b_temp_alarm = "/fragment@7/__overlay__/pm8350b_tz";
		pm8350b_trip0 = "/fragment@7/__overlay__/pm8350b_tz/trips/trip0";
		pm8350b_trip1 = "/fragment@7/__overlay__/pm8350b_tz/trips/trip1";
		pm8350b_trip2 = "/fragment@7/__overlay__/pm8350b_tz/trips/trip2";
		ibat_lvl0 = "/fragment@7/__overlay__/pm8350b-ibat-lvl0/trips/ibat-lvl0";
		ibat_lvl1 = "/fragment@7/__overlay__/pm8350b-ibat-lvl1/trips/ibat-lvl1";
		b_bcl_lvl0 = "/fragment@7/__overlay__/pm8350b-bcl-lvl0/trips/b-bcl-lvl0";
		b_bcl_lvl1 = "/fragment@7/__overlay__/pm8350b-bcl-lvl1/trips/b-bcl-lvl1";
		b_bcl_lvl2 = "/fragment@7/__overlay__/pm8350b-bcl-lvl2/trips/b-bcl-lvl2";
		socd_trip = "/fragment@7/__overlay__/socd/trips/socd-trip";
		pmr735a_spmi = "/fragment@8/__overlay__/qcom,pmr735a@4";
		pmr735a_tz = "/fragment@8/__overlay__/qcom,pmr735a@4/qcom,temp-alarm@a00";
		pmr735a_gpios = "/fragment@8/__overlay__/qcom,pmr735a@4/pinctrl@8800";
		pmr735a_temp_alarm = "/fragment@9/__overlay__/pmr735a_tz";
		pmr735a_trip0 = "/fragment@9/__overlay__/pmr735a_tz/trips/trip0";
		pmr735a_trip1 = "/fragment@9/__overlay__/pmr735a_tz/trips/trip1";
		pmr735a_trip2 = "/fragment@9/__overlay__/pmr735a_tz/trips/trip2";
		pmr735b_tz = "/fragment@10/__overlay__/qcom,pmr735b@5/qcom,temp-alarm@a00";
		pmr735b_gpios = "/fragment@10/__overlay__/qcom,pmr735b@5/pinctrl@8800";
		pmr735b_temp_alarm = "/fragment@11/__overlay__/pmr735b_tz";
		pmr735b_trip0 = "/fragment@11/__overlay__/pmr735b_tz/trips/trip0";
		pmr735b_trip1 = "/fragment@11/__overlay__/pmr735b_tz/trips/trip1";
		pmr735b_trip2 = "/fragment@11/__overlay__/pmr735b_tz/trips/trip2";
		pm8450_tz = "/fragment@12/__overlay__/qcom,pm8450@7/qcom,temp-alarm@a00";
		pm8450_gpios = "/fragment@12/__overlay__/qcom,pm8450@7/pinctrl@8800";
		pm8450_temp_alarm = "/fragment@13/__overlay__/pm8450_tz";
		pm8450_trip0 = "/fragment@13/__overlay__/pm8450_tz/trips/trip0";
		pm8450_trip1 = "/fragment@13/__overlay__/pm8450_tz/trips/trip1";
		pm8450_trip2 = "/fragment@13/__overlay__/pm8450_tz/trips/trip2";
		usb_port0 = "/fragment@23/__overlay__/port/endpoint";
		usb_port0_connector = "/fragment@24/__overlay__/connector/port/endpoint";
		cs35l41_0 = "/fragment@27/__overlay__/cs35l41@40";
		cs35l41_1 = "/fragment@27/__overlay__/cs35l41@41";
		cs35l41_2 = "/fragment@27/__overlay__/cs35l41@42";
		cs35l41_3 = "/fragment@27/__overlay__/cs35l41@43";
		thermal_message = "/fragment@29/__overlay__/thermal-message";
		gamekey = "/fragment@29/__overlay__/gamekey";
		mi_ts_active = "/fragment@30/__overlay__/mi_ts_active";
		awinic_gpio_reset = "/fragment@30/__overlay__/awinic_gpio_reset";
		awinic_gpio_reset_output_high = "/fragment@30/__overlay__/awinic_gpio_reset_output_high";
		awinic_gpio_int = "/fragment@30/__overlay__/awinic_gpio_int";
		gk_hall_act_left = "/fragment@30/__overlay__/gk_hall_act_left";
		gk_hall_act_right = "/fragment@30/__overlay__/gk_hall_act_right";
		gk_hall_sup = "/fragment@30/__overlay__/gk_hall_sup";
		gk_key_act_left = "/fragment@30/__overlay__/gk_key_act_left";
		gk_key_act_right = "/fragment@30/__overlay__/gk_key_act_right";
		gk_key_sup_left = "/fragment@30/__overlay__/gk_key_sup_left";
		gk_key_sup_right = "/fragment@30/__overlay__/gk_key_sup_right";
		msm_gpio_reset = "/fragment@39/__overlay__/msm_gpio_reset";
		msm_gpio_reset_output_high = "/fragment@39/__overlay__/msm_gpio_reset_output_high";
		msm_gpio_irq = "/fragment@39/__overlay__/msm_gpio_irq";
	};

	__fixups__ {
		tlmm = "/fragment@0:target:0\0/fragment@18/__overlay__:cd-gpios:0\0/fragment@22/__overlay__/nq@28:qcom,sn-irq:0\0/fragment@22/__overlay__/nq@28:qcom,sn-ven:0\0/fragment@22/__overlay__/nq@28:qcom,sn-firm:0\0/fragment@22/__overlay__/nq@28:qcom,sn-clkreq:0\0/fragment@22/__overlay__/nq@28:interrupt-parent:0\0/fragment@23/__overlay__/synaptics_tcm@20:interrupt-parent:0\0/fragment@23/__overlay__/synaptics_tcm@20:synaptics,irq-gpio:0\0/fragment@23/__overlay__/synaptics_tcm@20:synaptics,reset-gpio:0\0/fragment@26/__overlay__/aw8697_haptic@5A:reset-gpio:0\0/fragment@26/__overlay__/aw8697_haptic@5A:irq-gpio:0\0/fragment@27/__overlay__/cs35l41@40:reset-gpios:0\0/fragment@27/__overlay__/cs35l41@40:interrupt-parent:0\0/fragment@27/__overlay__/cs35l41@41:reset-gpios:0\0/fragment@27/__overlay__/cs35l41@41:interrupt-parent:0\0/fragment@27/__overlay__/cs35l41@42:reset-gpios:0\0/fragment@27/__overlay__/cs35l41@42:interrupt-parent:0\0/fragment@27/__overlay__/cs35l41@43:reset-gpios:0\0/fragment@27/__overlay__/cs35l41@43:spk-sw-gpios:0\0/fragment@27/__overlay__/cs35l41@43:interrupt-parent:0\0/fragment@28/__overlay__/aw22xxx_led@6a:reset-gpio:0\0/fragment@29/__overlay__/gamekey:key_left:0\0/fragment@29/__overlay__/gamekey:hall_left:0\0/fragment@29/__overlay__/gamekey:key_right:0\0/fragment@29/__overlay__/gamekey:hall_right:0\0/fragment@30:target:0\0/fragment@34/__overlay__/fts@0:interrupt-parent:0\0/fragment@34/__overlay__/fts@0:fts,irq-gpio:0\0/fragment@34/__overlay__/fts@0:fts,reset-gpio:0\0/fragment@38/__overlay__/fingerprint_goodix:goodix,gpio-reset:0\0/fragment@38/__overlay__/fingerprint_goodix:goodix,gpio-irq:0\0/fragment@38/__overlay__/fingerprint_fpc:interrupt-parent:0\0/fragment@38/__overlay__/fingerprint_fpc:fpc,gpio_rst:0\0/fragment@38/__overlay__/fingerprint_fpc:fpc,gpio_irq:0\0/fragment@38/__overlay__/md_testing_mode:status-gpio:0\0/fragment@38/__overlay__/md_testing_mode:status-gpio:12\0/fragment@39:target:0\0/fragment@42/__overlay__/wl2866d@28:en-gpio:0";
		spmi_bus = "/fragment@1:target:0\0/fragment@2:target:0\0/fragment@4:target:0\0/fragment@6:target:0\0/fragment@8:target:0\0/fragment@10:target:0\0/fragment@12:target:0";
		thermal_zones = "/fragment@3:target:0\0/fragment@5:target:0\0/fragment@7:target:0\0/fragment@9:target:0\0/fragment@11:target:0\0/fragment@13:target:0\0/fragment@15:target:0\0/fragment@40:target:0";
		soc = "/fragment@14:target:0\0/fragment@19:target:0\0/fragment@29:target:0\0/fragment@38:target:0";
		modem_lte_dsc = "/fragment@15/__overlay__/pm8350b-bcl-lvl0/cooling-maps/vbat_lte0:cooling-device:0\0/fragment@15/__overlay__/pm8350b-bcl-lvl1/cooling-maps/vbat_lte1:cooling-device:0\0/fragment@15/__overlay__/pm8350c-bcl-lvl0/cooling-maps/vph_lte0:cooling-device:0\0/fragment@15/__overlay__/pm8350c-bcl-lvl1/cooling-maps/vph_lte1:cooling-device:0\0/fragment@15/__overlay__/pm8350c_tz/cooling-maps/pm8350c_lte:cooling-device:0";
		modem_nr_scg_dsc = "/fragment@15/__overlay__/pm8350b-bcl-lvl0/cooling-maps/vbat_nr0_scg:cooling-device:0\0/fragment@15/__overlay__/pm8350b-bcl-lvl1/cooling-maps/vbat_nr1_scg:cooling-device:0\0/fragment@15/__overlay__/pm8350c-bcl-lvl0/cooling-maps/vph_nr0_scg:cooling-device:0\0/fragment@15/__overlay__/pm8350c-bcl-lvl1/cooling-maps/vph_nr1_scg:cooling-device:0\0/fragment@15/__overlay__/pm8350c_tz/cooling-maps/pm8350c_nr:cooling-device:0";
		modem_nr_dsc = "/fragment@15/__overlay__/pm8350b-bcl-lvl0/cooling-maps/vbat_nr0:cooling-device:0\0/fragment@15/__overlay__/pm8350b-bcl-lvl1/cooling-maps/vbat_nr1:cooling-device:0\0/fragment@15/__overlay__/pm8350c-bcl-lvl0/cooling-maps/vph_nr0:cooling-device:0\0/fragment@15/__overlay__/pm8350c-bcl-lvl1/cooling-maps/vph_nr1:cooling-device:0";
		cdsp_sw = "/fragment@15/__overlay__/pm8350b-bcl-lvl0/cooling-maps/vbat_cdsp0:cooling-device:0\0/fragment@15/__overlay__/pm8350b-bcl-lvl1/cooling-maps/vbat_cdsp1:cooling-device:0\0/fragment@15/__overlay__/pm8350b-bcl-lvl2/cooling-maps/vbat_cdsp2:cooling-device:0\0/fragment@15/__overlay__/pm8350c-bcl-lvl0/cooling-maps/vph_cdsp0:cooling-device:0\0/fragment@15/__overlay__/pm8350c-bcl-lvl1/cooling-maps/vph_cdsp1:cooling-device:0\0/fragment@15/__overlay__/pm8350c-bcl-lvl2/cooling-maps/vph_cdsp2:cooling-device:0\0/fragment@15/__overlay__/pm8350c_tz/cooling-maps/pm8350c_nsp:cooling-device:0";
		cpu5_pause = "/fragment@15/__overlay__/pm8350b-bcl-lvl0/cooling-maps/vbat_cpu_5:cooling-device:0\0/fragment@15/__overlay__/pm8350c-bcl-lvl0/cooling-maps/vph_cpu_5:cooling-device:0";
		msm_gpu = "/fragment@15/__overlay__/pm8350b-bcl-lvl0/cooling-maps/vbat_gpu0:cooling-device:0\0/fragment@15/__overlay__/pm8350b-bcl-lvl1/cooling-maps/vbat_gpu1:cooling-device:0\0/fragment@15/__overlay__/pm8350b-bcl-lvl2/cooling-maps/vbat_gpu2:cooling-device:0\0/fragment@15/__overlay__/pm8350c-bcl-lvl0/cooling-maps/vph_gpu0:cooling-device:0\0/fragment@15/__overlay__/pm8350c-bcl-lvl1/cooling-maps/vph_gpu1:cooling-device:0\0/fragment@15/__overlay__/pm8350c-bcl-lvl2/cooling-maps/vph_gpu2:cooling-device:0\0/fragment@15/__overlay__/pm8350_tz/cooling-maps/pm8350_gpu:cooling-device:0";
		cpu_6_7_pause = "/fragment@15/__overlay__/pm8350b-bcl-lvl1/cooling-maps/vbat_cpu_6_7:cooling-device:0\0/fragment@15/__overlay__/pm8350c-bcl-lvl1/cooling-maps/vph_cpu_6_7:cooling-device:0";
		CPU4 = "/fragment@15/__overlay__/pm8450_tz/cooling-maps/pm8450_cpu4_freq:cooling-device:0\0/fragment@15/__overlay__/pm8350_tz/cooling-maps/pm8350_cpu4_freq:cooling-device:0";
		CPU7 = "/fragment@15/__overlay__/pm8450_tz/cooling-maps/pm8450_cpu7_freq:cooling-device:0\0/fragment@15/__overlay__/pm8350_tz/cooling-maps/pm8350_cpu7_freq:cooling-device:0";
		APC1_pause = "/fragment@15/__overlay__/pm8450_tz/cooling-maps/pm8450_apc1:cooling-device:0\0/fragment@15/__overlay__/pm8350_tz/cooling-maps/pm8350_apc1:cooling-device:0";
		ufsphy_mem = "/fragment@16:target:0";
		pm8350_l5 = "/fragment@16/__overlay__:vdda-phy-supply:0";
		pm8350_l6 = "/fragment@16/__overlay__:vdda-pll-supply:0";
		ufshc_mem = "/fragment@17:target:0";
		gcc_ufs_phy_gdsc = "/fragment@17/__overlay__:vdd-hba-supply:0";
		pm8350_l7 = "/fragment@17/__overlay__:vcc-supply:0";
		pm8350_l9 = "/fragment@17/__overlay__:vccq-supply:0\0/fragment@17/__overlay__:qcom,vddp-ref-clk-supply:0";
		pm8350_s12 = "/fragment@17/__overlay__:qcom,vccq-parent-supply:0";
		sdhc_2 = "/fragment@18:target:0";
		pm8350c_l9 = "/fragment@18/__overlay__:vdd-supply:0";
		pm8350c_l6 = "/fragment@18/__overlay__:vdd-io-supply:0";
		sdc2_on = "/fragment@18/__overlay__:pinctrl-0:0";
		sdc2_off = "/fragment@18/__overlay__:pinctrl-1:0";
		qupv3_se13_spi = "/fragment@20:target:0";
		battery_charger = "/fragment@21:target:0\0/fragment@36:target:0";
		qupv3_se9_i2c = "/fragment@22:target:0";
		S10B = "/fragment@22/__overlay__/nq@28:qcom,sn-vdd-1p8-supply:0";
		nfc_int_active = "/fragment@22/__overlay__/nq@28:pinctrl-0:0";
		nfc_enable_active = "/fragment@22/__overlay__/nq@28:pinctrl-0:4";
		nfc_int_suspend = "/fragment@22/__overlay__/nq@28:pinctrl-1:0";
		nfc_enable_suspend = "/fragment@22/__overlay__/nq@28:pinctrl-1:4";
		usb0 = "/fragment@23:target:0";
		ts_active = "/fragment@23/__overlay__/synaptics_tcm@20:pinctrl-0:0";
		ts_int_suspend = "/fragment@23/__overlay__/synaptics_tcm@20:pinctrl-1:0\0/fragment@34/__overlay__/fts@0:pinctrl-1:0";
		ts_reset_suspend = "/fragment@23/__overlay__/synaptics_tcm@20:pinctrl-1:4\0/fragment@34/__overlay__/fts@0:pinctrl-1:4";
		ts_release = "/fragment@23/__overlay__/synaptics_tcm@20:pinctrl-2:0";
		L8C = "/fragment@23/__overlay__/synaptics_tcm@20:vdd-supply:0\0/fragment@29/__overlay__/gamekey:gamekey_vreg-supply:0";
		L3C = "/fragment@23/__overlay__/synaptics_tcm@20:avdd-supply:0\0/fragment@34/__overlay__/fts@0:avdd-supply:0";
		ucsi = "/fragment@24:target:0";
		reserved_memory = "/fragment@25:target:0";
		qupv3_se16_i2c = "/fragment@26:target:0";
		qupv3_se15_i2c = "/fragment@27:target:0";
		qupv3_se19_i2c = "/fragment@28:target:0";
		fsa4480 = "/fragment@31:target:0";
		qupv3_se1_i2c = "/fragment@32:target:0";
		dio4480 = "/fragment@33:target:0";
		qupv3_se4_spi = "/fragment@34:target:0";
		L2C = "/fragment@34/__overlay__/fts@0:vdd-supply:0";
		usb2_phy0 = "/fragment@35:target:0";
		L7C = "/fragment@37:target:0\0/fragment@38/__overlay__/fingerprint_goodix:fp_vdd_vreg-supply:0\0/fragment@38/__overlay__/fingerprint_fpc:fp_vdd_vreg-supply:0";
		clock_gcc = "/fragment@41:target:0";
		qupv3_se5_i2c = "/fragment@41/__overlay__:qcom,critical-devices:0\0/fragment@42:target:0";
		S12B = "/fragment@42/__overlay__/wl2866d@28:vin1-supply:0";
		BOB = "/fragment@42/__overlay__/wl2866d@28:vin2-supply:0";
	};

	__local_fixups__ {

		fragment@1 {

			__overlay__ {

				qcom,pmk8350@0 {

					vadc@3100 {
						pinctrl-0 = <0x00>;
					};

					adc_tm@3400 {
						io-channels = <0x00 0x08 0x10 0x18 0x20 0x28 0x30 0x38>;
					};

					adc_tm_e {
						io-channels = <0x00>;
					};
				};
			};
		};

		fragment@2 {

			__overlay__ {

				qcom,pm8350@1 {

					qcom,temp-alarm@a00 {
						io-channels = <0x00>;
					};
				};
			};
		};

		fragment@3 {

			__overlay__ {

				pm8350_tz {
					thermal-sensors = <0x00>;
				};
			};
		};

		fragment@4 {

			__overlay__ {

				qcom,pm8350c@2 {

					pwms@e800 {
						nvmem = <0x00 0x04>;
					};

					qcom,leds@ef00 {

						red {
							pwms = <0x00>;
						};

						green {
							pwms = <0x00>;
						};

						blue {
							pwms = <0x00>;
						};
					};
				};
			};
		};

		fragment@5 {

			__overlay__ {

				pm8350c_tz {
					thermal-sensors = <0x00>;
				};

				pm8350c-bcl-lvl0 {
					thermal-sensors = <0x00>;
				};

				pm8350c-bcl-lvl1 {
					thermal-sensors = <0x00>;
				};

				pm8350c-bcl-lvl2 {
					thermal-sensors = <0x00>;
				};
			};
		};

		fragment@6 {

			__overlay__ {

				qcom,pm8350b@3 {

					qcom,temp-alarm@a00 {
						io-channels = <0x00>;
					};

					qcom,hv-haptics@f000 {
						nvmem-cells = <0x00>;
						nvmem = <0x00>;
						qcom,pbs-client = <0x00>;
					};

					qcom,amoled-ecm@f900 {
						nvmem = <0x00 0x04 0x08>;
					};
				};
			};
		};

		fragment@7 {

			__overlay__ {

				pm8350b_tz {
					thermal-sensors = <0x00>;
				};

				pm8350b-ibat-lvl0 {
					thermal-sensors = <0x00>;
				};

				pm8350b-ibat-lvl1 {
					thermal-sensors = <0x00>;
				};

				pm8350b-bcl-lvl0 {
					thermal-sensors = <0x00>;
				};

				pm8350b-bcl-lvl1 {
					thermal-sensors = <0x00>;
				};

				pm8350b-bcl-lvl2 {
					thermal-sensors = <0x00>;
				};
			};
		};

		fragment@9 {

			__overlay__ {

				pmr735a_tz {
					thermal-sensors = <0x00>;
				};
			};
		};

		fragment@11 {

			__overlay__ {

				pmr735b_tz {
					thermal-sensors = <0x00>;
				};
			};
		};

		fragment@13 {

			__overlay__ {

				pm8450_tz {
					thermal-sensors = <0x00>;
				};
			};
		};

		fragment@14 {

			__overlay__ {

				reboot_reason {
					nvmem-cells = <0x00>;
				};

				pmic-pon-log {
					nvmem = <0x00>;
				};
			};
		};

		fragment@15 {

			__overlay__ {

				pm8350b-bcl-lvl0 {

					cooling-maps {

						vbat_lte0 {
							trip = <0x00>;
						};

						vbat_nr0_scg {
							trip = <0x00>;
						};

						vbat_nr0 {
							trip = <0x00>;
						};

						vbat_cdsp0 {
							trip = <0x00>;
						};

						vbat_cpu_5 {
							trip = <0x00>;
						};

						vbat_gpu0 {
							trip = <0x00>;
						};
					};
				};

				pm8350b-bcl-lvl1 {

					cooling-maps {

						vbat_lte1 {
							trip = <0x00>;
						};

						vbat_nr1_scg {
							trip = <0x00>;
						};

						vbat_nr1 {
							trip = <0x00>;
						};

						vbat_cdsp1 {
							trip = <0x00>;
						};

						vbat_cpu_6_7 {
							trip = <0x00>;
						};

						vbat_gpu1 {
							trip = <0x00>;
						};
					};
				};

				pm8350b-bcl-lvl2 {

					cooling-maps {

						vbat_cdsp2 {
							trip = <0x00>;
						};

						vbat_gpu2 {
							trip = <0x00>;
						};
					};
				};

				pm8350c-bcl-lvl0 {

					cooling-maps {

						vph_lte0 {
							trip = <0x00>;
						};

						vph_nr0_scg {
							trip = <0x00>;
						};

						vph_nr0 {
							trip = <0x00>;
						};

						vph_cdsp0 {
							trip = <0x00>;
						};

						vph_cpu_5 {
							trip = <0x00>;
						};

						vph_gpu0 {
							trip = <0x00>;
						};
					};
				};

				pm8350c-bcl-lvl1 {

					cooling-maps {

						vph_lte1 {
							trip = <0x00>;
						};

						vph_nr1_scg {
							trip = <0x00>;
						};

						vph_nr1 {
							trip = <0x00>;
						};

						vph_cdsp1 {
							trip = <0x00>;
						};

						vph_cpu_6_7 {
							trip = <0x00>;
						};

						vph_gpu1 {
							trip = <0x00>;
						};
					};
				};

				pm8350c-bcl-lvl2 {

					cooling-maps {

						vph_cdsp2 {
							trip = <0x00>;
						};

						vph_gpu2 {
							trip = <0x00>;
						};
					};
				};

				pm8450_tz {

					cooling-maps {

						pm8450_cpu4_freq {
							trip = <0x00>;
						};

						pm8450_cpu7_freq {
							trip = <0x00>;
						};

						pm8450_apc1 {
							trip = <0x00>;
						};
					};
				};

				pm8350_tz {

					cooling-maps {

						pm8350_gpu {
							trip = <0x00>;
						};

						pm8350_cpu4_freq {
							trip = <0x00>;
						};

						pm8350_cpu7_freq {
							trip = <0x00>;
						};

						pm8350_apc1 {
							trip = <0x00>;
						};
					};
				};

				pm8350c_tz {

					cooling-maps {

						pm8350c_nsp {
							trip = <0x00>;
						};

						pm8350c_lte {
							trip = <0x00>;
						};

						pm8350c_nr {
							trip = <0x00>;
						};
					};
				};
			};
		};

		fragment@19 {

			__overlay__ {

				gpio_keys {
					pinctrl-0 = <0x00>;

					vol_up {
						gpios = <0x00>;
					};
				};
			};
		};

		fragment@23 {

			__overlay__ {

				port {

					endpoint {
						remote-endpoint = <0x00>;
					};
				};
			};
		};

		fragment@24 {

			__overlay__ {

				connector {

					port {

						endpoint {
							remote-endpoint = <0x00>;
						};
					};
				};
			};
		};

		fragment@26 {

			__overlay__ {

				aw8697_haptic@5A {
					pinctrl-0 = <0x00>;
					pinctrl-1 = <0x00>;
					pinctrl-2 = <0x00>;
				};
			};
		};

		fragment@27 {

			__overlay__ {

				cs35l41@40 {
					pinctrl-0 = <0x00 0x04>;
				};

				cs35l41@41 {
					pinctrl-0 = <0x00 0x04>;
				};

				cs35l41@42 {
					pinctrl-0 = <0x00 0x04>;
				};

				cs35l41@43 {
					pinctrl-0 = <0x00 0x04>;
				};
			};
		};

		fragment@29 {

			__overlay__ {

				gamekey {
					pinctrl-0 = <0x00 0x04 0x08 0x0c>;
					pinctrl-1 = <0x00 0x04 0x08>;
				};
			};
		};

		fragment@34 {

			__overlay__ {

				fts@0 {
					pinctrl-0 = <0x00>;
				};
			};
		};

		fragment@38 {

			__overlay__ {

				fingerprint_fpc {
					pinctrl-0 = <0x00>;
					pinctrl-1 = <0x00>;
					pinctrl-2 = <0x00>;
				};

				md_testing_mode {
					pinctrl-0 = <0x00 0x04>;
				};
			};
		};

		fragment@40 {

			__overlay__ {

				cpu_therm {
					thermal-sensors = <0x00>;
				};

				flash_therm {
					thermal-sensors = <0x00>;
				};

				quiet_therm {
					thermal-sensors = <0x00>;
				};

				charger_therm1 {
					thermal-sensors = <0x00>;
				};

				charger_therm0 {
					thermal-sensors = <0x00>;
				};

				pa_therm0 {
					thermal-sensors = <0x00>;
				};

				pa_therm1 {
					thermal-sensors = <0x00>;
				};

				wifi_therm {
					thermal-sensors = <0x00>;
				};

				conn_therm {
					thermal-sensors = <0x00>;
				};
			};
		};
	};
};
