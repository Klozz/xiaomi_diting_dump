/dts-v1/;

/ {
	model = "Ziyi based on Qualcomm Technologies, Inc. Diwali IDP";
	compatible = "qcom,diwali-idp\0qcom,diwali\0qcom,idp";
	qcom,msm-id = <0x234 0x10000>;
	qcom,board-id = <0x22 0x00>;
	xiaomi,miboard-id = <0x09 0x00>;
	qcom,pmic-id-size = <0x09>;
	qcom,pmic-id = <0x00 0x00 0x00 0x00 0x00 0x00 0x00 0x00 0x2e>;

	fragment@0 {
		target = <0xffffffff>;

		__overlay__ {
			#address-cells = <0x02>;
			#size-cells = <0x00>;
			interrupt-controller;
			#interrupt-cells = <0x04>;

			qcom,pmk8350@0 {
				compatible = "qcom,spmi-pmic";
				reg = <0x00 0x00>;
				#address-cells = <0x01>;
				#size-cells = <0x00>;
				phandle = <0x2b>;

				pon_hlos@1300 {
					compatible = "qcom,pm8998-pon";
					reg = <0x1300 0x800>;
					reg-names = "pon_hlos\0pon_pbs";
					qcom,log-kpd-event;
					phandle = <0x2c>;

					pwrkey {
						compatible = "qcom,pmk8350-pwrkey";
						interrupts = <0x00 0x13 0x07 0x03>;
						linux,code = <0x74>;
					};

					resin {
						compatible = "qcom,pmk8350-resin";
						interrupts = <0x00 0x13 0x06 0x03>;
						linux,code = <0x72>;
					};

					pwrkey-bark {
						compatible = "qcom,pmk8350-pwrkey-bark";
						interrupts = <0x00 0x13 0x00 0x03>;
						linux,code = <0x74>;
					};

					pwrkey-resin-bark {
						compatible = "qcom,pmk8350-pwrkey-resin-bark";
						interrupts = <0x00 0x13 0x02 0x03>;
						linux,code = <0x74>;
					};
				};

				vadc@3100 {
					compatible = "qcom,spmi-adc7";
					reg = <0x3100>;
					#address-cells = <0x01>;
					#size-cells = <0x00>;
					interrupts = <0x00 0x31 0x00 0x01>;
					interrupt-names = "eoc-int-en-set";
					#io-channel-cells = <0x01>;
					io-channel-ranges;
					pinctrl-names = "default";
					pinctrl-0 = <0x01 0x02 0x03>;
					phandle = <0x04>;

					pmk8350_ref_gnd {
						reg = <0x00>;
						label = "pmk8350_ref_gnd";
						qcom,pre-scaling = <0x01 0x01>;
					};

					pmk8350_vref_1p25 {
						reg = <0x01>;
						label = "pmk8350_vref_1p25";
						qcom,pre-scaling = <0x01 0x01>;
					};

					pmk8350_die_temp {
						reg = <0x03>;
						label = "pmk8350_die_temp";
						qcom,pre-scaling = <0x01 0x01>;
					};

					pmr735a_ref_gnd {
						reg = <0x400>;
						label = "pmr735a_ref_gnd";
						qcom,pre-scaling = <0x01 0x01>;
					};

					pmr735a_vref_1p25 {
						reg = <0x401>;
						label = "pmr735a_vref_1p25";
						qcom,pre-scaling = <0x01 0x01>;
					};

					pmr735a_die_temp {
						reg = <0x403>;
						label = "pmr735a_die_temp";
						qcom,pre-scaling = <0x01 0x01>;
					};

					pm7325_ref_gnd {
						reg = <0x100>;
						label = "pm7325_ref_gnd";
						qcom,pre-scaling = <0x01 0x01>;
					};

					pm7325_vref_1p25 {
						reg = <0x101>;
						label = "pm7325_vref_1p25";
						qcom,pre-scaling = <0x01 0x01>;
					};

					pm7325_die_temp {
						reg = <0x103>;
						label = "pm7325_die_temp";
						qcom,pre-scaling = <0x01 0x01>;
					};

					pm7325_vph_pwr {
						reg = <0x18e>;
						label = "pm7325_vph_pwr";
						qcom,pre-scaling = <0x01 0x03>;
					};

					pm7325_quiet_therm {
						reg = <0x144>;
						label = "pm7325_quiet_therm";
						qcom,ratiometric;
						qcom,hw-settle-time = <0xc8>;
						qcom,pre-scaling = <0x01 0x01>;
					};

					pm7325_cam_flash_therm {
						reg = <0x145>;
						label = "pm7325_cam_flash_therm";
						qcom,ratiometric;
						qcom,hw-settle-time = <0xc8>;
						qcom,pre-scaling = <0x01 0x01>;
					};

					pm7325_skin_msm_therm {
						reg = <0x146>;
						label = "pm7325_skin_msm_therm";
						qcom,ratiometric;
						qcom,hw-settle-time = <0xc8>;
						qcom,pre-scaling = <0x01 0x01>;
					};

					pm7325_wide_rfc_therm {
						reg = <0x147>;
						label = "pm7325_wide_rfc_therm";
						qcom,ratiometric;
						qcom,hw-settle-time = <0xc8>;
						qcom,pre-scaling = <0x01 0x01>;
					};

					pm7325_4g_pa_therm {
						reg = <0x148>;
						label = "pm7325_4g_pa_therm";
						qcom,ratiometric;
						qcom,hw-settle-time = <0xc8>;
						qcom,pre-scaling = <0x01 0x01>;
					};

					pm7325_5g_pa_therm {
						reg = <0x14c>;
						label = "pm7325_5g_pa_therm";
						qcom,ratiometric;
						qcom,hw-settle-time = <0xc8>;
						qcom,pre-scaling = <0x01 0x01>;
					};

					pmk8350_xo_therm {
						reg = <0x44>;
						label = "pmk8350_xo_therm";
						qcom,ratiometric;
						qcom,hw-settle-time = <0xc8>;
						qcom,pre-scaling = <0x01 0x01>;
					};

					pmk8350_sc8551_therm {
						reg = <0x45>;
						label = "pmk8350_sc8551_therm";
						qcom,ratiometric;
						qcom,hw-settle-time = <0xc8>;
						qcom,pre-scaling = <0x01 0x01>;
					};

					pmk8350_conn_therm {
						reg = <0x46>;
						label = "pmk8350_conn_therm";
						qcom,ratiometric;
						qcom,hw-settle-time = <0xc8>;
						qcom,pre-scaling = <0x01 0x01>;
					};

					pmk8350_led_l_therm {
						reg = <0x47>;
						label = "pmk8350_led_l_therm";
						qcom,ratiometric;
						qcom,hw-settle-time = <0xc8>;
						qcom,pre-scaling = <0x01 0x01>;
					};
				};

				adc_tm@3400 {
					compatible = "qcom,adc-tm7";
					reg = <0x3400>;
					interrupts = <0x00 0x34 0x00 0x01>;
					interrupt-names = "threshold";
					#address-cells = <0x01>;
					#size-cells = <0x00>;
					#thermal-sensor-cells = <0x01>;
					io-channels = <0x04 0x144 0x04 0x145 0x04 0x146 0x04 0x147 0x04 0x148 0x04 0x14c 0x04 0x44 0x04 0x45>;
					phandle = <0x1a>;

					pm7325_quiet_therm {
						reg = <0x144>;
						qcom,ratiometric;
						qcom,hw-settle-time = <0xc8>;
					};

					pm7325_cam_flash_therm {
						reg = <0x145>;
						qcom,ratiometric;
						qcom,hw-settle-time = <0xc8>;
					};

					pm7325_skin_msm_therm {
						reg = <0x146>;
						qcom,ratiometric;
						qcom,hw-settle-time = <0xc8>;
					};

					pm7325_wide_rfc_therm {
						reg = <0x147>;
						qcom,ratiometric;
						qcom,hw-settle-time = <0xc8>;
					};

					pm7325_4g_pa_therm {
						reg = <0x148>;
						qcom,ratiometric;
						qcom,hw-settle-time = <0xc8>;
					};

					pm7325_5g_pa_therm {
						reg = <0x14c>;
						qcom,ratiometric;
						qcom,hw-settle-time = <0xc8>;
					};

					pmk8350_xo_therm {
						reg = <0x44>;
						qcom,ratiometric;
						qcom,hw-settle-time = <0xc8>;
					};

					pmk8350_sc8551_therm {
						reg = <0x45>;
						qcom,ratiometric;
						qcom,hw-settle-time = <0xc8>;
					};
				};

				sdam@7000 {
					compatible = "qcom,spmi-sdam";
					reg = <0x7000>;
					#address-cells = <0x01>;
					#size-cells = <0x01>;
					phandle = <0x2d>;

					ufs_dev@94 {
						reg = <0x94 0x01>;
						bits = <0x00 0x00>;
						phandle = <0x19>;
					};
				};

				sdam@7100 {
					compatible = "qcom,spmi-sdam";
					reg = <0x7100>;
					#address-cells = <0x01>;
					#size-cells = <0x01>;
					phandle = <0x2e>;

					restart@48 {
						reg = <0x48 0x01>;
						bits = <0x01 0x07>;
						phandle = <0x0c>;
					};
				};

				sdam@7400 {
					compatible = "qcom,spmi-sdam";
					reg = <0x7400>;
					phandle = <0x0d>;
				};

				sdam@7c00 {
					compatible = "qcom,spmi-sdam";
					reg = <0x7c00>;
					phandle = <0x2f>;
				};

				sdam@7d00 {
					compatible = "qcom,spmi-sdam";
					reg = <0x7d00>;
					phandle = <0x30>;
				};

				sdam@8400 {
					compatible = "qcom,spmi-sdam";
					reg = <0x8400>;
					phandle = <0x05>;
				};

				sdam@8500 {
					compatible = "qcom,spmi-sdam";
					reg = <0x8500>;
					phandle = <0x06>;
				};

				sdam@8600 {
					compatible = "qcom,spmi-sdam";
					reg = <0x8600>;
					#address-cells = <0x01>;
					#size-cells = <0x01>;
					phandle = <0x31>;

					scaling@bf {
						reg = <0xbf 0x01>;
						bits = <0x00 0x02>;
						phandle = <0x32>;
					};
				};

				sdam@9800 {
					compatible = "qcom,spmi-sdam";
					reg = <0x9800>;
					phandle = <0x33>;
				};

				sdam@9d00 {
					compatible = "qcom,spmi-sdam";
					reg = <0x9d00>;
					phandle = <0x34>;
				};

				pinctrl@b000 {
					compatible = "qcom,pmk8350-gpio";
					reg = <0xb000>;
					gpio-controller;
					#gpio-cells = <0x02>;
					interrupt-controller;
					#interrupt-cells = <0x02>;
					phandle = <0x35>;

					pmk8350_sc8551_therm {

						pmk8350_sc8551_therm_default {
							pins = "gpio1";
							bias-high-impedance;
							phandle = <0x01>;
						};
					};

					pmk8350_conn_therm {

						pmk8350_conn_therm_default {
							pins = "gpio2";
							bias-high-impedance;
							phandle = <0x02>;
						};
					};

					pmk8350_led_l_therm {

						pmk8350_led_l_therm_default {
							pins = "gpio3";
							bias-high-impedance;
							phandle = <0x03>;
						};
					};
				};

				rtc@6100 {
					compatible = "qcom,pmk8350-rtc";
					reg = <0x6100 0x6200>;
					reg-names = "rtc\0alarm";
					interrupts = <0x00 0x62 0x01 0x01>;
					phandle = <0x36>;
				};

				adc_tm_e {
					compatible = "qcom,adc-tm7-iio";
					reg = <0x3400>;
					#thermal-sensor-cells = <0x01>;
					#address-cells = <0x01>;
					#size-cells = <0x00>;
					io-channels = <0x04 0x46 0x04 0x47>;
					phandle = <0x1b>;

					pmk8350_conn_therm {
						reg = <0x46>;
						qcom,ratiometric;
						qcom,hw-settle-time = <0xc8>;
					};

					pmk8350_led_l_therm {
						reg = <0x47>;
						qcom,ratiometric;
						qcom,hw-settle-time = <0xc8>;
					};
				};
			};
		};
	};

	fragment@1 {
		target = <0xffffffff>;

		__overlay__ {
			#address-cells = <0x02>;
			#size-cells = <0x00>;
			interrupt-controller;
			#interrupt-cells = <0x04>;

			qcom,pm8350c@2 {
				compatible = "qcom,spmi-pmic";
				reg = <0x02 0x00>;
				#address-cells = <0x01>;
				#size-cells = <0x00>;

				qcom,temp-alarm@a00 {
					compatible = "qcom,spmi-temp-alarm";
					reg = <0xa00>;
					interrupts = <0x02 0x0a 0x00 0x03>;
					#thermal-sensor-cells = <0x00>;
					phandle = <0x08>;
				};

				pinctrl@8800 {
					compatible = "qcom,pm8350c-gpio";
					reg = <0x8800>;
					gpio-controller;
					#gpio-cells = <0x02>;
					interrupt-controller;
					#interrupt-cells = <0x02>;
					phandle = <0x37>;

					pm8008i_reset {

						pm8008i_active {
							pins = "gpio3";
							function = "normal";
							bias-disable;
							output-high;
							power-source = <0x00>;
							phandle = <0x0e>;
						};
					};

					pm8010j_reset {

						pm8010j_active {
							pins = "gpio4";
							function = "normal";
							bias-disable;
							output-high;
							power-source = <0x00>;
							phandle = <0x10>;
						};
					};

					lcd_backlight_ctrl {

						lcd_backlight_ctrl_default {
							pins = "gpio8";
							function = "func1";
							input-disable;
							output-enable;
							bias-disable;
							power-source = <0x01>;
							qcom,drive-strength = <0x02>;
							phandle = <0x38>;
						};
					};
				};

				pwms@e800 {
					compatible = "qcom,pwm-lpg";
					reg = <0xe800>;
					reg-names = "lpg-base";
					#pwm-cells = <0x02>;
					qcom,num-lpg-channels = <0x03>;
					nvmem = <0x05 0x06>;
					nvmem-names = "lpg_chan_sdam\0lut_sdam";
					qcom,lut-sdam-base = <0x45>;
					qcom,lut-patterns = <0x00 0x0a 0x14 0x1e 0x28 0x32 0x3c 0x46 0x50 0x5a 0x64 0x5a 0x50 0x46 0x3c 0x32 0x28 0x1e 0x14 0x0a 0x00>;
					qcom,tick-duration-us = <0x1f40>;
					phandle = <0x07>;

					lpg@1 {
						qcom,lpg-chan-id = <0x01>;
						qcom,ramp-step-ms = <0x64>;
						qcom,ramp-low-index = <0x00>;
						qcom,ramp-high-index = <0x13>;
						qcom,ramp-pattern-repeat;
						qcom,lpg-sdam-base = <0x48>;
					};

					lpg@2 {
						qcom,lpg-chan-id = <0x02>;
						qcom,ramp-step-ms = <0x64>;
						qcom,ramp-low-index = <0x00>;
						qcom,ramp-high-index = <0x13>;
						qcom,ramp-pattern-repeat;
						qcom,lpg-sdam-base = <0x56>;
					};

					lpg@3 {
						qcom,lpg-chan-id = <0x03>;
						qcom,ramp-step-ms = <0x64>;
						qcom,ramp-low-index = <0x00>;
						qcom,ramp-high-index = <0x13>;
						qcom,ramp-pattern-repeat;
						qcom,lpg-sdam-base = <0x64>;
					};
				};

				pwms@eb00 {
					compatible = "qcom,pwm-lpg";
					reg = <0xeb00>;
					reg-names = "lpg-base";
					#pwm-cells = <0x02>;
					qcom,num-lpg-channels = <0x01>;
					phandle = <0x39>;
				};

				qcom,leds@ef00 {
					compatible = "qcom,tri-led";
					reg = <0xef00>;
					phandle = <0x3a>;

					red {
						label = "red";
						pwms = <0x07 0x00 0xf4240>;
						led-sources = <0x00>;
						linux,default-trigger = "timer";
					};

					green {
						label = "green";
						pwms = <0x07 0x01 0xf4240>;
						led-sources = <0x01>;
						linux,default-trigger = "timer";
					};

					blue {
						label = "blue";
						pwms = <0x07 0x02 0xf4240>;
						led-sources = <0x02>;
						linux,default-trigger = "timer";
					};
				};

				bcl@4700 {
					compatible = "qcom,bcl-v5";
					reg = <0x4700 0x100>;
					interrupts = <0x02 0x47 0x00 0x00 0x02 0x47 0x01 0x00 0x02 0x47 0x02 0x00>;
					interrupt-names = "bcl-lvl0\0bcl-lvl1\0bcl-lvl2";
					qcom,pmic7-threshold;
					#thermal-sensor-cells = <0x01>;
					phandle = <0x09>;
				};

				qcom,flash_led@ee00 {
					compatible = "qcom,pm8350c-flash-led";
					reg = <0xee00>;
					interrupts = <0x02 0xee 0x00 0x01 0x02 0xee 0x03 0x01 0x02 0xee 0x04 0x01>;
					interrupt-names = "led-fault-irq\0all-ramp-down-done-irq\0all-ramp-up-done-irq";
					qcom,thermal-derate-current = <0xc8 0x1f4>;
					status = "ok";
					phandle = <0x3b>;

					qcom,flash_0 {
						label = "flash";
						qcom,led-name = "led:flash_0";
						qcom,max-current-ma = <0x5dc>;
						qcom,default-led-trigger = "flash0_trigger";
						qcom,id = <0x00>;
						qcom,duration-ms = <0x500>;
						qcom,ires-ua = <0x30d4>;
						phandle = <0x3c>;
					};

					qcom,flash_1 {
						label = "flash";
						qcom,led-name = "led:flash_1";
						qcom,max-current-ma = <0x5dc>;
						qcom,default-led-trigger = "flash1_trigger";
						qcom,id = <0x01>;
						qcom,duration-ms = <0x500>;
						qcom,ires-ua = <0x30d4>;
						phandle = <0x3d>;
					};

					qcom,flash_2 {
						label = "flash";
						qcom,led-name = "led:flash_2";
						qcom,max-current-ma = <0x5dc>;
						qcom,default-led-trigger = "flash2_trigger";
						qcom,id = <0x02>;
						qcom,duration-ms = <0x500>;
						qcom,ires-ua = <0x30d4>;
						phandle = <0x3e>;
					};

					qcom,flash_3 {
						label = "flash";
						qcom,led-name = "led:flash_3";
						qcom,max-current-ma = <0x5dc>;
						qcom,default-led-trigger = "flash3_trigger";
						qcom,id = <0x03>;
						qcom,duration-ms = <0x500>;
						qcom,ires-ua = <0x30d4>;
						phandle = <0x3f>;
					};

					qcom,torch_0 {
						label = "torch";
						qcom,led-name = "led:torch_0";
						qcom,max-current-ma = <0x1f4>;
						qcom,default-led-trigger = "torch0_trigger";
						qcom,id = <0x00>;
						qcom,ires-ua = <0x30d4>;
						phandle = <0x40>;
					};

					qcom,torch_1 {
						label = "torch";
						qcom,led-name = "led:torch_1";
						qcom,max-current-ma = <0x1f4>;
						qcom,default-led-trigger = "torch1_trigger";
						qcom,id = <0x01>;
						qcom,ires-ua = <0x30d4>;
						phandle = <0x41>;
					};

					qcom,torch_2 {
						label = "torch";
						qcom,led-name = "led:torch_2";
						qcom,max-current-ma = <0x1f4>;
						qcom,default-led-trigger = "torch2_trigger";
						qcom,id = <0x02>;
						qcom,ires-ua = <0x30d4>;
						phandle = <0x42>;
					};

					qcom,torch_3 {
						label = "torch";
						qcom,led-name = "led:torch_3";
						qcom,max-current-ma = <0x1f4>;
						qcom,default-led-trigger = "torch3_trigger";
						qcom,id = <0x03>;
						qcom,ires-ua = <0x30d4>;
						phandle = <0x43>;
					};

					qcom,led_switch_0 {
						label = "switch";
						qcom,led-name = "led:switch_0";
						qcom,default-led-trigger = "switch0_trigger";
						qcom,led-mask = <0x09>;
						qcom,symmetry-en;
						phandle = <0x44>;
					};

					qcom,led_switch_1 {
						label = "switch";
						qcom,led-name = "led:switch_1";
						qcom,default-led-trigger = "switch1_trigger";
						qcom,led-mask = <0x06>;
						qcom,symmetry-en;
						phandle = <0x45>;
					};

					qcom,led_switch_2 {
						label = "switch";
						qcom,led-name = "led:switch_2";
						qcom,default-led-trigger = "switch2_trigger";
						qcom,led-mask = <0x0f>;
						qcom,symmetry-en;
						phandle = <0x46>;
					};
				};
			};
		};
	};

	fragment@2 {
		target = <0xffffffff>;

		__overlay__ {

			pm8350c_tz {
				polling-delay-passive = <0x64>;
				polling-delay = <0x00>;
				thermal-governor = "step_wise";
				thermal-sensors = <0x08>;
				phandle = <0x47>;

				trips {

					trip0 {
						temperature = <0x17318>;
						hysteresis = <0x00>;
						type = "passive";
						phandle = <0x15>;
					};

					trip1 {
						temperature = <0x1c138>;
						hysteresis = <0x00>;
						type = "passive";
						phandle = <0x48>;
					};

					trip2 {
						temperature = <0x23668>;
						hysteresis = <0x00>;
						type = "passive";
						phandle = <0x49>;
					};
				};
			};

			pm8350c-bcl-lvl0 {
				polling-delay-passive = <0x64>;
				polling-delay = <0x00>;
				thermal-governor = "step_wise";
				thermal-sensors = <0x09 0x05>;

				trips {

					c-bcl-lvl0 {
						temperature = <0x01>;
						hysteresis = <0x01>;
						type = "passive";
						phandle = <0x12>;
					};
				};
			};

			pm8350c-bcl-lvl1 {
				polling-delay-passive = <0x64>;
				polling-delay = <0x00>;
				thermal-governor = "step_wise";
				thermal-sensors = <0x09 0x06>;

				trips {

					c-bcl-lvl1 {
						temperature = <0x01>;
						hysteresis = <0x01>;
						type = "passive";
						phandle = <0x13>;
					};
				};
			};

			pm8350c-bcl-lvl2 {
				polling-delay-passive = <0x64>;
				polling-delay = <0x00>;
				thermal-governor = "step_wise";
				thermal-sensors = <0x09 0x07>;

				trips {

					c-bcl-lvl2 {
						temperature = <0x01>;
						hysteresis = <0x01>;
						type = "passive";
						phandle = <0x14>;
					};
				};
			};
		};
	};

	fragment@3 {
		target = <0xffffffff>;

		__overlay__ {
			#address-cells = <0x02>;
			#size-cells = <0x00>;
			interrupt-controller;
			#interrupt-cells = <0x04>;

			qcom,pm7325@1 {
				compatible = "qcom,spmi-pmic";
				reg = <0x01 0x00>;
				#address-cells = <0x01>;
				#size-cells = <0x00>;

				qcom,temp-alarm@a00 {
					compatible = "qcom,spmi-temp-alarm";
					reg = <0xa00>;
					interrupts = <0x01 0x0a 0x00 0x03>;
					#thermal-sensor-cells = <0x00>;
					io-channels = <0x04 0x103>;
					io-channel-names = "thermal";
					phandle = <0x0a>;
				};

				pinctrl@8800 {
					compatible = "qcom,pm7325-gpio";
					reg = <0x8800>;
					gpio-controller;
					#gpio-cells = <0x02>;
					interrupt-controller;
					#interrupt-cells = <0x02>;
					phandle = <0x18>;

					key_vol_up {

						key_vol_up_default {
							pins = "gpio6";
							function = "normal";
							input-enable;
							bias-pull-up;
							power-source = <0x01>;
							phandle = <0x17>;
						};
					};
				};
			};
		};
	};

	fragment@4 {
		target = <0xffffffff>;

		__overlay__ {

			pm7325_tz {
				polling-delay-passive = <0x64>;
				polling-delay = <0x00>;
				thermal-governor = "step_wise";
				thermal-sensors = <0x0a>;
				phandle = <0x4a>;

				trips {

					trip0 {
						temperature = <0x17318>;
						hysteresis = <0x00>;
						type = "passive";
						phandle = <0x16>;
					};

					trip1 {
						temperature = <0x1c138>;
						hysteresis = <0x00>;
						type = "passive";
						phandle = <0x4b>;
					};

					trip2 {
						temperature = <0x23668>;
						hysteresis = <0x00>;
						type = "passive";
						phandle = <0x4c>;
					};
				};
			};
		};
	};

	fragment@5 {
		target = <0xffffffff>;

		__overlay__ {
			#address-cells = <0x02>;
			#size-cells = <0x00>;
			interrupt-controller;
			#interrupt-cells = <0x04>;

			qcom,pmr735a@4 {
				compatible = "qcom,spmi-pmic";
				reg = <0x04 0x00>;
				#address-cells = <0x01>;
				#size-cells = <0x00>;
				phandle = <0x4d>;

				qcom,temp-alarm@a00 {
					compatible = "qcom,spmi-temp-alarm";
					reg = <0xa00>;
					interrupts = <0x04 0x0a 0x00 0x03>;
					#thermal-sensor-cells = <0x00>;
					io-channels = <0x04 0x403>;
					io-channel-names = "thermal";
					phandle = <0x0b>;
				};

				pinctrl@8800 {
					compatible = "qcom,pmr735a-gpio";
					reg = <0x8800>;
					gpio-controller;
					#gpio-cells = <0x02>;
					interrupt-controller;
					#interrupt-cells = <0x02>;
					phandle = <0x4e>;
				};
			};
		};
	};

	fragment@6 {
		target = <0xffffffff>;

		__overlay__ {

			pmr735a_tz {
				polling-delay-passive = <0x64>;
				polling-delay = <0x00>;
				thermal-governor = "step_wise";
				thermal-sensors = <0x0b>;
				phandle = <0x4f>;

				trips {

					trip0 {
						temperature = <0x17318>;
						hysteresis = <0x00>;
						type = "passive";
						phandle = <0x50>;
					};

					trip1 {
						temperature = <0x1c138>;
						hysteresis = <0x00>;
						type = "passive";
						phandle = <0x51>;
					};

					trip2 {
						temperature = <0x23668>;
						hysteresis = <0x00>;
						type = "passive";
						phandle = <0x52>;
					};
				};
			};
		};
	};

	fragment@7 {
		target = <0xffffffff>;

		__overlay__ {

			reboot_reason {
				compatible = "qcom,reboot-reason";
				nvmem-cells = <0x0c>;
				nvmem-cell-names = "restart_reason";
			};

			pmic-pon-log {
				compatible = "qcom,pmic-pon-log";
				nvmem = <0x0d>;
				nvmem-names = "pon_log";
			};
		};
	};

	fragment@8 {
		target = <0xffffffff>;

		__overlay__ {
			qcom,critical-devices = <0xffffffff>;
		};
	};

	fragment@9 {
		target = <0xffffffff>;

		__overlay__ {
			#address-cells = <0x01>;
			#size-cells = <0x00>;
			status = "ok";

			pm8008i@8 {
				compatible = "qcom,i2c-pmic";
				reg = <0x08>;
				#address-cells = <0x01>;
				#size-cells = <0x00>;
				pinctrl-names = "default";
				pinctrl-0 = <0x0e>;

				pm8008-chip@900 {
					compatible = "qcom,pm8008-chip";
					reg = <0x900>;

					qcom,pm8008-chip-en {
						regulator-name = "pm8008i-chip-en";
						phandle = <0x0f>;
					};
				};

				qcom,revid@100 {
					compatible = "qcom,qpnp-revid";
					reg = <0x100>;
				};
			};

			pm8008i@9 {
				compatible = "qcom,i2c-pmic";
				reg = <0x09>;
				#address-cells = <0x01>;
				#size-cells = <0x00>;

				qcom,pm8008i-regulator {
					compatible = "qcom,pm8008-regulator";
					#address-cells = <0x01>;
					#size-cells = <0x00>;
					pm8008_en-supply = <0x0f>;
					vdd_l1_l2-supply = <0xffffffff>;
					vdd_l3_l4-supply = <0xffffffff>;
					vdd_l5-supply = <0xffffffff>;
					vdd_l6-supply = <0xffffffff>;
					vdd_l7-supply = <0xffffffff>;

					regulator@4000 {
						reg = <0x4000>;
						regulator-name = "pm8008i_l1";
						regulator-min-microvolt = <0xf4240>;
						regulator-max-microvolt = <0xf4240>;
						qcom,min-dropout-voltage = <0x1f400>;
						qcom,hpm-min-load = <0x7530>;
						phandle = <0x53>;
					};

					regulator@4100 {
						reg = <0x4100>;
						regulator-name = "pm8008i_l2";
						regulator-min-microvolt = <0xf4240>;
						regulator-max-microvolt = <0x124f80>;
						qcom,min-dropout-voltage = <0x19640>;
						qcom,hpm-min-load = <0x7530>;
						phandle = <0x54>;
					};

					regulator@4200 {
						reg = <0x4200>;
						regulator-name = "pm8008i_l3";
						regulator-min-microvolt = <0x2ab980>;
						regulator-max-microvolt = <0x2ab980>;
						qcom,min-dropout-voltage = <0x2ee00>;
						qcom,hpm-min-load = <0x00>;
						phandle = <0x55>;
					};

					regulator@4300 {
						reg = <0x4300>;
						regulator-name = "pm8008i_l4";
						regulator-min-microvolt = <0x2ab980>;
						regulator-max-microvolt = <0x2ab980>;
						qcom,min-dropout-voltage = <0x1f400>;
						qcom,hpm-min-load = <0x00>;
						phandle = <0x56>;
					};

					regulator@4400 {
						reg = <0x4400>;
						regulator-name = "pm8008i_l5";
						regulator-min-microvolt = <0x1b7740>;
						regulator-max-microvolt = <0x1b7740>;
						qcom,min-dropout-voltage = <0x00>;
						qcom,hpm-min-load = <0x00>;
						phandle = <0x57>;
					};

					regulator@4500 {
						reg = <0x4500>;
						regulator-name = "pm8008i_l6";
						regulator-min-microvolt = <0x1b7740>;
						regulator-max-microvolt = <0x1b7740>;
						qcom,min-dropout-voltage = <0x1f400>;
						qcom,hpm-min-load = <0x00>;
						phandle = <0x58>;
					};

					regulator@4600 {
						reg = <0x4600>;
						regulator-name = "pm8008i_l7";
						regulator-min-microvolt = <0x2932e0>;
						regulator-max-microvolt = <0x2dc6c0>;
						qcom,min-dropout-voltage = <0x3e800>;
						qcom,hpm-min-load = <0x00>;
						phandle = <0x59>;
					};
				};
			};

			pm8010j@c {
				compatible = "qcom,i2c-pmic";
				reg = <0x0c>;
				#address-cells = <0x01>;
				#size-cells = <0x00>;
				pinctrl-names = "default";
				pinctrl-0 = <0x10>;

				pm8010-chip@900 {
					compatible = "qcom,pm8008-chip";
					reg = <0x900>;

					qcom,pm8008-chip-en {
						regulator-name = "pm8010j-chip-en";
						phandle = <0x11>;
					};
				};

				qcom,revid@100 {
					compatible = "qcom,qpnp-revid";
					reg = <0x100>;
				};
			};

			pm8010j@d {
				compatible = "qcom,i2c-pmic";
				reg = <0x0d>;
				#address-cells = <0x01>;
				#size-cells = <0x00>;

				qcom,pm8010j-regulator {
					compatible = "qcom,pm8010-regulator";
					#address-cells = <0x01>;
					#size-cells = <0x00>;
					pm8008_en-supply = <0x11>;
					vdd_l1_l2-supply = <0xffffffff>;
					vdd_l3_l4-supply = <0xffffffff>;
					vdd_l5-supply = <0xffffffff>;
					vdd_l6-supply = <0xffffffff>;
					vdd_l7-supply = <0xffffffff>;

					regulator@4000 {
						reg = <0x4000>;
						regulator-name = "pm8010j_l1";
						regulator-min-microvolt = <0x4baf0>;
						regulator-max-microvolt = <0x118c30>;
						qcom,min-dropout-voltage = <0x11940>;
						qcom,hpm-min-load = <0x7530>;
						phandle = <0x5a>;
					};

					regulator@4100 {
						reg = <0x4100>;
						regulator-name = "pm8010j_l2";
						regulator-min-microvolt = <0x57670>;
						regulator-max-microvolt = <0x16acb0>;
						qcom,min-dropout-voltage = <0x5dc0>;
						qcom,hpm-min-load = <0x7530>;
						phandle = <0x5b>;
					};

					regulator@4200 {
						reg = <0x4200>;
						regulator-name = "pm8010j_l3";
						regulator-min-microvolt = <0x18d760>;
						regulator-max-microvolt = <0x1dc130>;
						qcom,min-dropout-voltage = <0x11940>;
						qcom,hpm-min-load = <0x00>;
						phandle = <0x5c>;
					};

					regulator@4300 {
						reg = <0x4300>;
						regulator-name = "pm8010j_l4";
						regulator-min-microvolt = <0x179ee0>;
						regulator-max-microvolt = <0x1ccf00>;
						qcom,min-dropout-voltage = <0x251c0>;
						qcom,hpm-min-load = <0x00>;
						phandle = <0x5d>;
					};

					regulator@4400 {
						reg = <0x4400>;
						regulator-name = "pm8010j_l5";
						regulator-min-microvolt = <0x16f300>;
						regulator-max-microvolt = <0x3613c0>;
						qcom,min-dropout-voltage = <0x00>;
						qcom,hpm-min-load = <0x00>;
						phandle = <0x5e>;
					};

					regulator@4500 {
						reg = <0x4500>;
						regulator-name = "pm8010j_l6";
						regulator-min-microvolt = <0x2932e0>;
						regulator-max-microvolt = <0x2c4020>;
						qcom,min-dropout-voltage = <0x1f400>;
						qcom,hpm-min-load = <0x00>;
						phandle = <0x5f>;
					};

					regulator@4600 {
						reg = <0x4600>;
						regulator-name = "pm8010j_l7";
						regulator-min-microvolt = <0x16f300>;
						regulator-max-microvolt = <0x3613c0>;
						qcom,min-dropout-voltage = <0x00>;
						qcom,hpm-min-load = <0x00>;
						phandle = <0x60>;
					};
				};
			};
		};
	};

	fragment@10 {
		target = <0xffffffff>;

		__overlay__ {

			pm8350c-bcl-lvl0 {

				cooling-maps {

					vph_lte0 {
						trip = <0x12>;
						cooling-device = <0xffffffff 0x08 0x08>;
					};

					vph_nr0_scg {
						trip = <0x12>;
						cooling-device = <0xffffffff 0x03 0x03>;
					};

					vph_nr0 {
						trip = <0x12>;
						cooling-device = <0xffffffff 0x06 0x06>;
					};

					vph_cdsp0 {
						trip = <0x12>;
						cooling-device = <0xffffffff 0x02 0x02>;
					};

					vph_cpu_5 {
						trip = <0x12>;
						cooling-device = <0xffffffff 0x01 0x01>;
					};

					vph_gpu0 {
						trip = <0x12>;
						cooling-device = <0xffffffff 0x01 0x01>;
					};
				};
			};

			pm8350c-bcl-lvl1 {

				cooling-maps {

					vph_lte1 {
						trip = <0x13>;
						cooling-device = <0xffffffff 0x0a 0x0a>;
					};

					vph_nr1_scg {
						trip = <0x13>;
						cooling-device = <0xffffffff 0x0a 0x0a>;
					};

					vph_nr1 {
						trip = <0x13>;
						cooling-device = <0xffffffff 0x09 0x09>;
					};

					vph_cdsp1 {
						trip = <0x13>;
						cooling-device = <0xffffffff 0x04 0x04>;
					};

					vph_cpu_6_7 {
						trip = <0x13>;
						cooling-device = <0xffffffff 0x01 0x01>;
					};

					vph_gpu1 {
						trip = <0x13>;
						cooling-device = <0xffffffff 0x02 0x02>;
					};
				};
			};

			pm8350c-bcl-lvl2 {

				cooling-maps {

					vph_cdsp2 {
						trip = <0x14>;
						cooling-device = <0xffffffff 0x05 0xffffffff>;
					};

					vph_gpu2 {
						trip = <0x14>;
						cooling-device = <0xffffffff 0x03 0xffffffff>;
					};
				};
			};

			pm8350c_tz {

				cooling-maps {

					pm8350c_lte {
						trip = <0x15>;
						cooling-device = <0xffffffff 0xff 0xff>;
					};

					pm8350c_nr {
						trip = <0x15>;
						cooling-device = <0xffffffff 0xff 0xff>;
					};

					pm8350c_gpu {
						trip = <0x15>;
						cooling-device = <0xffffffff 0x03 0xffffffff>;
					};
				};
			};

			pm7325_tz {

				cooling-maps {

					pm7325_cpu4_freq {
						trip = <0x16>;
						cooling-device = <0xffffffff 0x0a 0xffffffff>;
					};

					pm7325_cpu7_freq {
						trip = <0x16>;
						cooling-device = <0xffffffff 0x0c 0xffffffff>;
					};

					pm7325_apc1 {
						trip = <0x16>;
						cooling-device = <0xffffffff 0x01 0x01>;
					};
				};
			};
		};
	};

	fragment@11 {
		target = <0xffffffff>;

		__overlay__ {

			gpio_keys {
				compatible = "gpio-keys";
				label = "gpio-keys";
				pinctrl-names = "default";
				pinctrl-0 = <0x17>;

				vol_up {
					label = "volume_up";
					gpios = <0x18 0x06 0x01>;
					linux,input-type = <0x01>;
					linux,code = <0x73>;
					gpio-key,wakeup;
					debounce-interval = <0x0f>;
					linux,can-disable;
				};
			};
		};
	};

	fragment@12 {
		target = <0xffffffff>;

		__overlay__ {
			status = "disabled";
		};
	};

	fragment@13 {
		target = <0xffffffff>;

		__overlay__ {
			status = "ok";
			qcom,clk-freq-out = <0xf4240>;
			#address-cells = <0x01>;
			#size-cells = <0x00>;

			nq@28 {
				compatible = "qcom,sn-nci";
				reg = <0x28>;
				qcom,sn-irq = <0xffffffff 0x29 0x00>;
				qcom,sn-ven = <0xffffffff 0x26 0x00>;
				qcom,sn-firm = <0xffffffff 0x28 0x00>;
				qcom,sn-clkreq = <0xffffffff 0x27 0x00>;
				qcom,sn-vdd-1p8-supply = <0xffffffff>;
				qcom,sn-vdd-1p8-voltage = <0x1b7740 0x1b7740>;
				qcom,sn-vdd-1p8-current = <0x26548>;
				interrupt-parent = <0xffffffff>;
				interrupts = <0x29 0x00>;
				interrupt-names = "nfc_irq";
				pinctrl-names = "nfc_active\0nfc_suspend";
				pinctrl-0 = <0xffffffff 0xffffffff>;
				pinctrl-1 = <0xffffffff 0xffffffff>;
			};
		};
	};

	fragment@14 {
		target = <0xffffffff>;

		__overlay__ {
			status = "disabled";
		};
	};

	fragment@15 {
		target = <0xffffffff>;

		__overlay__ {
			compatible = "qcom,ufs-phy-qmp-v4-diwali";
			vdda-phy-supply = <0xffffffff>;
			vdda-pll-supply = <0xffffffff>;
			vdda-phy-max-microamp = <0x15824>;
			vdda-pll-max-microamp = <0x477c>;
			status = "ok";
		};
	};

	fragment@16 {
		target = <0xffffffff>;

		__overlay__ {
			vdd-hba-supply = <0xffffffff>;
			vcc-supply = <0xffffffff>;
			vcc-max-microamp = <0x10c8e0>;
			vccq-supply = <0xffffffff>;
			vccq-max-microamp = <0x124f80>;
			vccq2-supply = <0xffffffff>;
			vccq2-max-microamp = "\0\f5";
			qcom,vddp-ref-clk-supply = <0xffffffff>;
			qcom,vddp-ref-clk-max-microamp = <0x64>;
			ufs-dev-types = <0x02>;
			nvmem-cells = <0x19>;
			nvmem-cell-names = "ufs_dev";
			status = "ok";
		};
	};

	fragment@17 {
		target = <0xffffffff>;

		__overlay__ {

			mtdoops_pmsg@0xa7000000 {
				compatible = "mtdoops_pmsg";
				reg = <0xa7000000 0x400000>;
				console-size = <0x200000>;
				pmsg-size = <0x200000>;
			};
		};
	};

	fragment@18 {
		target = <0xffffffff>;

		__overlay__ {
			#address-cells = <0x02>;
			#size-cells = <0x02>;
			ranges;

			ramoops@0xa7000000 {
				compatible = "ramoops";
				reg = <0x00 0xa7000000 0x00 0x400000>;
				console-size = <0x200000>;
				pmsg-size = <0x200000>;
			};
		};
	};

	fragment@19 {
		target = <0xffffffff>;

		__overlay__ {
			wlan-en-gpio = <0x19>;
		};
	};

	fragment@20 {
		target = <0xffffffff>;

		__overlay__ {

			quiet_therm {
				polling-delay-passive = <0x00>;
				polling-delay = <0x00>;
				thermal-governor = "user_space";
				thermal-sensors = <0x1a 0x144>;
				wake-capable-sensor;

				trips {

					active-config0 {
						temperature = <0x1e848>;
						hysteresis = <0x3e8>;
						type = "passive";
					};
				};
			};

			flash_therm {
				polling-delay-passive = <0x00>;
				polling-delay = <0x00>;
				thermal-governor = "user_space";
				thermal-sensors = <0x1a 0x145>;
				wake-capable-sensor;

				trips {

					active-config0 {
						temperature = <0x1e848>;
						hysteresis = <0x3e8>;
						type = "passive";
					};
				};
			};

			cpu_therm {
				polling-delay-passive = <0x00>;
				polling-delay = <0x00>;
				thermal-governor = "user_space";
				thermal-sensors = <0x1a 0x146>;
				wake-capable-sensor;

				trips {

					active-config0 {
						temperature = <0x1e848>;
						hysteresis = <0x3e8>;
						type = "passive";
					};
				};
			};

			wifi_therm {
				polling-delay-passive = <0x00>;
				polling-delay = <0x00>;
				thermal-governor = "user_space";
				thermal-sensors = <0x1a 0x147>;
				wake-capable-sensor;

				trips {

					active-config0 {
						temperature = <0x1e848>;
						hysteresis = <0x3e8>;
						type = "passive";
					};
				};
			};

			pa_4gtherm {
				polling-delay-passive = <0x00>;
				polling-delay = <0x00>;
				thermal-governor = "user_space";
				thermal-sensors = <0x1a 0x148>;
				wake-capable-sensor;

				trips {

					active-config0 {
						temperature = <0x1e848>;
						hysteresis = <0x3e8>;
						type = "passive";
					};
				};
			};

			modem1_pa0 {
				polling-delay-passive = <0x00>;
				polling-delay = <0x00>;
				thermal-governor = "user_space";
				thermal-sensors = <0x1a 0x14c>;
				wake-capable-sensor;

				trips {

					active-config0 {
						temperature = <0x1e848>;
						hysteresis = <0x3e8>;
						type = "passive";
					};
				};
			};

			xo_therm {
				polling-delay-passive = <0x00>;
				polling-delay = <0x00>;
				thermal-governor = "user_space";
				thermal-sensors = <0x1a 0x44>;
				wake-capable-sensor;

				trips {

					active-config0 {
						temperature = <0x1e848>;
						hysteresis = <0x3e8>;
						type = "passive";
					};
				};
			};

			charger_therm0 {
				polling-delay-passive = <0x00>;
				polling-delay = <0x00>;
				thermal-governor = "user_space";
				thermal-sensors = <0x1a 0x45>;
				wake-capable-sensor;

				trips {

					active-config0 {
						temperature = <0x1e848>;
						hysteresis = <0x3e8>;
						type = "passive";
					};
				};
			};

			conn_therm {
				polling-delay-passive = <0x00>;
				polling-delay = <0x00>;
				thermal-governor = "user_space";
				thermal-sensors = <0x1b 0x46>;
				wake-capable-sensor;

				trips {

					active-config0 {
						temperature = <0x1e848>;
						hysteresis = <0x3e8>;
						type = "passive";
					};
				};
			};

			led_l_therm {
				polling-delay-passive = <0x00>;
				polling-delay = <0x00>;
				thermal-governor = "user_space";
				thermal-sensors = <0x1b 0x47>;
				wake-capable-sensor;

				trips {

					active-config0 {
						temperature = <0x1e848>;
						hysteresis = <0x3e8>;
						type = "passive";
					};
				};
			};
		};
	};

	fragment@21 {
		target = <0xffffffff>;

		__overlay__ {

			xiaomi_touch {
				compatible = "xiaomi-touch";
				status = "ok";
				touch,name = "xiaomi-touch";
			};
		};
	};

	fragment@22 {
		target = <0xffffffff>;

		__overlay__ {
			status = "ok";
			qcom,rt;
			pinctrl-1 = <0x1c 0x1d>;

			synaptics_tcm@0 {
				compatible = "synaptics,tcm-spi";
				reg = <0x00>;
				spi-max-frequency = <0x4c4b40>;
				interrupt-parent = <0xffffffff>;
				interrupts = <0x33 0x2808>;
				synaptics,avdd-name = "avdd";
				avdd-supply = <0xffffffff>;
				synaptics,iovdd-name = "iovdd";
				iovdd-supply = <0xffffffff>;
				synaptics,irq-gpio = <0xffffffff 0x33 0x2808>;
				synaptics,reset-gpio = <0xffffffff 0x7e 0x00>;
				synaptics,irq-on-state = <0x00>;
				synaptics,spi-mode = <0x00>;
				synaptics,byte-delay-us = <0x00>;
				synaptics,block-delay-us = <0x00>;
				synaptics,power-delay-ms = <0xc8>;
				synaptics,reset-delay-ms = <0xc8>;
				synaptics,ubl-max-freq = <0x4c4b40>;
				synaptics,ubl-byte-delay-us = <0x14>;
				pinctrl-names = "default";
				pinctrl-0 = <0x1e>;
				synaptics,game-mode-array = <0x01 0x00 0x00 0x00 0x00>;
				synaptics,active-mode-array = <0x01 0x00 0x00 0x00 0x00>;
				synaptics,up-threshold-array = <0x04 0x00 0x02 0x00 0x00>;
				synaptics,tolerance-array = <0x04 0x00 0x02 0x00 0x00>;
				synaptics,edge-filter-array = <0x03 0x00 0x02 0x02 0x02>;
				synaptics,panel-orien-array = <0x03 0x00 0x00 0x00 0x00>;
				synaptics,report-rate-array = <0x04 0x00 0x02 0x00 0x00>;
				synaptics,cornerfilter-area-step-array = <0x00 0x64 0xaa 0xfa>;
				synaptics,cornerzone-filter-hor1-array = <0x00 0x00 0x00 0x00 0xaa 0xaa 0x00 0x00 0x00 0x01 0x00 0x00 0x00 0x00 0x00 0x00 0x00 0x02 0x00 0x8b5 0xaa 0x95f 0x00 0x00 0x00 0x03 0x00 0x00 0x00 0x00 0x00 0x00>;
				synaptics,cornerzone-filter-hor2-array = <0x00 0x00 0x00 0x00 0x00 0x00 0x00 0x00 0x00 0x01 0x38d 0x00 0x437 0xaa 0x00 0x00 0x00 0x02 0x00 0x00 0x00 0x00 0x00 0x00 0x00 0x03 0x38d 0x8b5 0x437 0x95f 0x00 0x00>;
				synaptics,cornerzone-filter-ver-array = <0x00 0x00 0x00 0x00 0x00 0x00 0x00 0x00 0x00 0x01 0x00 0x00 0x00 0x00 0x00 0x00 0x00 0x02 0x00 0x833 0x96 0x95f 0x00 0x00 0x00 0x03 0x3a1 0x833 0x437 0x95f 0x00 0x00>;
				synaptics,deadzone-filter-hor-array = <0x02 0x00 0x00 0x00 0x437 0x00 0x00 0x00 0x02 0x01 0x00 0x95f 0x437 0x95f 0x00 0x00 0x02 0x02 0x00 0x00 0x00 0x00 0x00 0x00 0x02 0x03 0x00 0x00 0x00 0x00 0x00 0x00>;
				synaptics,deadzone-filter-ver-array = <0x02 0x00 0x00 0x00 0x00 0x00 0x00 0x00 0x02 0x01 0x00 0x00 0x00 0x00 0x00 0x00 0x02 0x02 0x00 0x00 0x00 0x95f 0x00 0x00 0x02 0x03 0x437 0x00 0x437 0x95f 0x00 0x00>;
				synaptics,edgezone-filter-hor-array = <0x01 0x00 0x00 0x00 0x437 0x28 0x00 0x00 0x01 0x01 0x00 0x937 0x437 0x95f 0x00 0x00 0x01 0x02 0x00 0x00 0x28 0x95f 0x00 0x00 0x01 0x03 0x40f 0x00 0x437 0x95f 0x00 0x00>;
				synaptics,edgezone-filter-ver-array = <0x01 0x00 0x00 0x00 0x00 0x00 0x00 0x00 0x01 0x01 0x00 0x00 0x00 0x00 0x00 0x00 0x01 0x02 0x00 0x00 0x28 0x95f 0x00 0x00 0x01 0x03 0x40f 0x00 0x437 0x95f 0x00 0x00>;
				synaptics,panel-display-resolution = <0x437 0x95f>;
			};
		};
	};

	fragment@23 {
		target = <0xffffffff>;

		__overlay__ {

			qupv3_se0_spi_sleep {
				phandle = <0x1c>;

				mux {
					pins = "gpio0\0gpio1\0gpio2";
					function = "gpio";
				};

				config {
					pins = "gpio0\0gpio1\0gpio2";
					drive-strength = <0x06>;
					bias-disable;
				};
			};

			qupv3_se0_spi_sleep_cs {
				phandle = <0x1d>;

				mux {
					pins = "gpio3";
					function = "gpio";
				};

				config {
					pins = "gpio3";
					drive-strength = <0x06>;
					bias-disable;
					output-high;
				};
			};

			syna_reset_gpio_default {
				phandle = <0x1e>;

				mux {
					pins = "gpio126";
					function = "gpio";
				};

				config {
					pins = "gpio126";
					drive-strength = <0x02>;
					bias-disable;
					output-low;
				};
			};
		};
	};

	fragment@24 {
		target = <0xffffffff>;

		__overlay__ {
			status = "ok";

			ir-spi@0 {
				compatible = "ir-spi";
				reg = <0x00>;
				spi-max-frequency = <0x124f800>;
				status = "ok";
			};
		};
	};

	fragment@25 {
		target = <0xffffffff>;

		__overlay__ {
			status = "ok";

			aw2033@45 {
				compatible = "awinic,aw2033_led";
				reg = <0x45>;
				status = "okay";

				aw2033,red {
					aw2033,name = "red";
					aw2033,id = <0x00>;
					aw2033,imax = <0x02>;
					aw2033,led-current = <0x03>;
					aw2033,max-brightness = <0xff>;
					aw2033,rise-time-ms = <0x06>;
					aw2033,hold-time-ms = <0x00>;
					aw2033,fall-time-ms = <0x06>;
					aw2033,off-time-ms = <0x04>;
				};

				aw2033,green {
					aw2033,name = "green";
					aw2033,id = <0x01>;
					aw2033,imax = <0x02>;
					aw2033,led-current = <0x03>;
					aw2033,max-brightness = <0xff>;
					aw2033,rise-time-ms = <0x06>;
					aw2033,hold-time-ms = <0x00>;
					aw2033,fall-time-ms = <0x06>;
					aw2033,off-time-ms = <0x04>;
				};

				aw2033,blue {
					aw2033,name = "blue";
					aw2033,id = <0x02>;
					aw2033,imax = <0x02>;
					aw2033,led-current = <0x03>;
					aw2033,max-brightness = <0xff>;
					aw2033,rise-time-ms = <0x06>;
					aw2033,hold-time-ms = <0x00>;
					aw2033,fall-time-ms = <0x06>;
					aw2033,off-time-ms = <0x04>;
				};
			};
		};
	};

	fragment@26 {
		target = <0xffffffff>;

		__overlay__ {

			fingerprint_goodix {
				status = "ok";
				compatible = "goodix,fingerprint";
				l11c_vdd-supply = <0xffffffff>;
				goodix,gpio-reset = <0xffffffff 0x8d 0x00>;
				goodix,gpio-irq = <0xffffffff 0x2b 0x00>;
			};
		};
	};

	fragment@27 {
		target = <0xffffffff>;

		__overlay__ {
			regulator-boot-on;
			regulator-always-on;
			regulator-min-microvolt = <0x30d400>;
			regulator-max-microvolt = <0x30d400>;
			qcom,init-voltage = <0x30d400>;
		};
	};

	fragment@28 {
		target = <0xffffffff>;

		__overlay__ {
			size = <0x00 0x3000000>;
		};
	};

	fragment@29 {
		target = <0xffffffff>;

		__overlay__ {
			size = <0x00 0x2000000>;
		};
	};

	fragment@30 {
		target = <0xffffffff>;

		__overlay__ {

			ln8000_int_default {
				phandle = <0x1f>;

				mux {
					pins = "gpio122";
					function = "gpio";
				};

				config {
					pins = "gpio122";
					drive-strength = <0x02>;
					bias-pull-up;
				};
			};

			ln8000_int2_default {
				phandle = <0x20>;

				mux {
					pins = "gpio125";
					function = "gpio";
				};

				config {
					pins = "gpio125";
					drive-strength = <0x02>;
					bias-pull-up;
				};
			};
		};
	};

	fragment@31 {
		target = <0xffffffff>;

		__overlay__ {
			status = "ok";
			#address-cells = <0x01>;
			#size-cells = <0x00>;

			ln8000-charger@51 {
				#io-channel-cells = <0x01>;
				compatible = "lionsemi,ln8000-master";
				reg = <0x51>;
				interrupt-parent = <0xffffffff>;
				interrupts = <0x7a 0x00>;
				pinctrl-names = "default";
				pinctrl-0 = <0x1f>;
				ln8000_charger,bat-ovp-threshold = <0x1266>;
				ln8000_charger,bat-ovp-alarm-threshold = <0x1243>;
				ln8000_charger,bus-ovp-threshold = <0x3200>;
				ln8000_charger,bus-ovp-alarm-threshold = <0x2af8>;
				ln8000_charger,bus-ocp-threshold = <0xea6>;
				ln8000_charger,bus-ocp-alarm-threshold = <0xdac>;
				ln8000_charger,ntc-alarm-cfg = <0xe2>;
				ln8000_charger,tdie-prot-disable;
				ln8000_charger,tbus-mon-disable;
				ln8000_charger,tbat-mon-disable;
				ln8000_charger,iin-ocp-disable;
				ln8000_charger,iin-reg-disable;
				ln8000_charger,tdie-reg-disable;
				ln8000_charger,vbat-reg-disable;
				ln8000_charger,revcurr-prot-disable;
				phandle = <0x26>;
			};
		};
	};

	fragment@32 {
		target = <0xffffffff>;

		__overlay__ {
			status = "ok";
			#address-cells = <0x01>;
			#size-cells = <0x00>;

			ln8000-charger@51 {
				#io-channel-cells = <0x01>;
				compatible = "lionsemi,ln8000-slave";
				reg = <0x51>;
				interrupt-parent = <0xffffffff>;
				interrupts = <0x7d 0x00>;
				pinctrl-names = "default";
				inctrl-0 = <0x20>;
				ln8000_charger,bat-ovp-threshold = <0x1266>;
				ln8000_charger,bat-ovp-alarm-threshold = <0x1243>;
				ln8000_charger,bus-ovp-threshold = <0x3200>;
				ln8000_charger,bus-ovp-alarm-threshold = <0x2af8>;
				ln8000_charger,bus-ocp-threshold = <0xea6>;
				ln8000_charger,bus-ocp-alarm-threshold = <0xdac>;
				ln8000_charger,ntc-alarm-cfg = <0xe2>;
				ln8000_charger,tdie-prot-disable;
				ln8000_charger,tbus-mon-disable;
				ln8000_charger,tbat-mon-disable;
				ln8000_charger,iin-ocp-disable;
				ln8000_charger,iin-reg-disable;
				ln8000_charger,tdie-reg-disable;
				ln8000_charger,vbat-reg-disable;
				ln8000_charger,revcurr-prot-disable;
				phandle = <0x27>;
			};
		};
	};

	fragment@33 {
		target = <0xffffffff>;

		__overlay__ {

			rt1711h_int_n {
				phandle = <0x21>;

				mux {
					pins = "gpio81";
					function = "gpio";
				};

				config {
					pins = "gpio81";
					drive-strength = <0x02>;
					bias-pull-up;
				};
			};
		};
	};

	fragment@34 {
		target = <0xffffffff>;

		__overlay__ {
			status = "ok";
			#address-cells = <0x01>;
			#size-cells = <0x00>;

			rt1711h@4e {
				#io-channel-cells = <0x01>;
				compatible = "richtek,rt1711h";
				reg = <0x4e>;
				tcpc-dual,supported_modes = <0x00>;
				rt-tcpc,name = "type_c_port0";
				rt-tcpc,role_def = <0x05>;
				rt-tcpc,rp_level = <0x01>;
				rt-tcpc,vconn_supply = <0x01>;
				rt1711pd,intr_gpio = <0xffffffff 0x51 0x00>;
				rt1711pd,intr_gpio_num = <0x51>;
				pinctrl-names = "default";
				pinctrl-0 = <0x21>;

				pd-data {
					pd,vid = <0x29cf>;
					pd,pid = <0x1711>;
					pd,source-cap-ext = <0x171129cf 0x00 0x00 0x00 0x00 0x2000000>;
					pd,mfrs = "RichtekTCPC";
					pd,charging_policy = <0x31>;
					pd,source-pdo-size = <0x01>;
					pd,source-pdo-data = <0x19096>;
					pd,sink-pdo-size = <0x01>;
					pd,sink-pdo-data = <0x1912c>;
					pd,id-vdo-size = <0x06>;
					pd,id-vdo-data = <0xd14029cf 0x00 0x17110000 0x41800000 0x00 0x21800000>;
					bat,nr = <0x01>;
					pd,country_nr = <0x00>;

					bat-info0 {
						bat,vid = <0x29cf>;
						bat,pid = <0x1711>;
						bat,mfrs = "bat1";
						bat,design_cap = <0xbb8>;
					};
				};

				dpm_caps {
					local_dr_power;
					local_dr_data;
					local_usb_comm;
					local_no_suspend;
					local_vconn_supply;
					attemp_enter_dp_mode;
					attemp_discover_cable;
					attemp_discover_id;
					pr_check = <0x00>;
					dr_check = <0x00>;
				};

				displayport {
					1st_connection = "dfp_d";
					2nd_connection = "dfp_d";
					signal,dp_v13;
					typec,receptacle;

					ufp_d {
					};

					dfp_d {
						pin_assignment,mode_c;
						pin_assignment,mode_d;
						pin_assignment,mode_e;
					};
				};
			};
		};
	};

	fragment@35 {
		target = <0xffffffff>;

		__overlay__ {

			rt-pd-manager {
				#io-channel-cells = <0x01>;
				compatible = "richtek,rt-pd-manager";
				phandle = <0x22>;
			};
		};
	};

	fragment@36 {
		target = <0xffffffff>;

		__overlay__ {
			usb-role-switch;
			extcon = <0x22>;

			dwc3@a600000 {
				usb-role-switch;
				dr_mode = "otg";
			};
		};
	};

	fragment@37 {
		target = <0xffffffff>;

		__overlay__ {

			bq25890_int_default {
				phandle = <0x23>;

				mux {
					pins = "gpio19";
					function = "gpio";
				};

				config {
					pins = "gpio19";
					drive-strength = <0x02>;
					bias-pull-up;
				};
			};

			bq25890_otg_default {
				phandle = <0x24>;

				mux {
					pins = "gpio63";
					function = "gpio";
				};

				config {
					pins = "gpio63";
					drive-strength = <0x10>;
					slew-rate = <0x01>;
					bias-disable;
					output-low;
				};
			};

			vbus_ntc_ctrl {
				phandle = <0x25>;

				mux {
					pins = "gpio27";
					function = "gpio";
				};

				config {
					pins = "gpio27";
					drive-strength = <0x10>;
					slew-rate = <0x01>;
					bias-disable;
					output-low;
				};
			};
		};
	};

	fragment@38 {
		target = <0xffffffff>;

		__overlay__ {
			qcom,param-override-seq = <0x07 0x6c 0x0d 0x70 0x26 0x74>;
		};
	};

	fragment@39 {
		target = <0xffffffff>;

		__overlay__ {
			status = "ok";
			#address-cells = <0x01>;
			#size-cells = <0x00>;

			bq25890@6A {
				#io-channel-cells = <0x01>;
				compatible = "ti,bq2589x-charger";
				reg = <0x6a>;
				interrupt-parent = <0xffffffff>;
				interrupts = <0x13 0x00>;
				pinctrl-names = "default";
				pinctrl-0 = <0x23 0x24>;
				intr-gpio = <0xffffffff 0x13 0x00>;
				otg-gpio = <0xffffffff 0x3f 0x00>;
				ti,bq2589x,charge-voltage = <0x1202>;
				ti,bq2589x,charge-current = <0x1f4>;
				ti,bq2589x,term-current = <0x100>;
				ti,bq2589x,enable-termination;
				ti,bq2589x,use-absolute-vindpm;
				ti,bq2589x,otg_vol = <0x14b4>;
				ti,bq2589x,otg_current = <0x708>;
				dpdm-supply = <0xffffffff>;
				phandle = <0x28>;
			};
		};
	};

	fragment@40 {
		target = <0xffffffff>;

		__overlay__ {
			status = "ok";
			#address-cells = <0x01>;
			#size-cells = <0x00>;

			bq27z561@55 {
				#io-channel-cells = <0x01>;
				compatible = "ti,bq27z561";
				reg = <0x55>;
				bq,shutdown-delay-enable;
				bq,soc_decimal_rate = <0x00 0x20 0x0a 0x1e 0x14 0x1c 0x1e 0x1c 0x28 0x1c 0x32 0x1c 0x3c 0x1c 0x46 0x1c 0x50 0x1c 0x5a 0x1a 0x5f 0x0a 0x63 0x05>;
				phandle = <0x29>;
			};
		};
	};

	fragment@41 {
		target = <0xffffffff>;

		__overlay__ {

			xm_pd_mngr {
				status = "ok";
				#io-channel-cells = <0x01>;
				compatible = "xiaomi,pd_cp_manager";
				mi,pd-bat-volt-max = <0x11b2>;
				mi,pd-bat-curr-max = <0x3070>;
				mi,pd-bus-volt-max = <0x2ee0>;
				mi,pd-bus-curr-max = <0x1838>;
				mi,pd-non-ffc-bat-volt-max = <0x1180>;
				mi,pd-bus-curr-compensate = <0x00>;
				mi,step-charge-high-vol-curr-max = <0x1130>;
				mi,cell-vol-high-threshold-mv = <0x11b2>;
				mi,cell-vol-max-threshold-mv = <0x11b2>;
				mi,pd-battery-warm-th = <0x1e0>;
				mi,cp-sec-enable;
				mi,pd-power-max = <0x43>;
				mi,therm-level-threshold = <0x0d>;
			};

			xm_pd_adapter {
				status = "ok";
				#io-channel-cells = <0x01>;
				compatible = "xiaomi,pd_adapter";
				adapter_name = "pd_adapter";
				phandle = <0x2a>;
			};

			xm_battmngr {
				status = "ok";
				#io-channel-cells = <0x01>;
				compatible = "xiaomi,battmngr";
				pinctrl-names = "default";
				pinctrl-0 = <0x25>;
				vbus_ctrl_gpio = <0xffffffff 0x1b 0x00>;
				xm,fv-max-uv = <0x4657d0>;
				xm,fcc-max-ua = <0xbbaee0>;
				xm,fv-max-design-uv = <0xa7d8c0>;
				xm,icl-max-ua = <0x5e9ac0>;
				xm,step-chg-enable = <0x01>;
				xm,sw-jeita-enable = <0x01>;
				xm,ffc_ieoc_l = <0xfa000>;
				xm,ffc_ieoc_h = <0xfa000>;
				xm,non_ffc_ieoc = <0x3e800>;
				xm,non_ffc_cv = "\0D\\";
				xm,non_ffc_cc = <0x5b8d80>;
				xm,taper-fcc;
				xm,step-chg-normal-ranges = <0x2dc6c0 0x40d990 0xbbaee0 0x40dd78 0x419ce0 0x77c810 0x41a0c8 0x445c00 0x63f1f0 0x445fe8 0x451f50 0x4fcdb0>;
				xm,step-chg-high-ranges = <0x2dc6c0 0x401640 0xbbaee0 0x401a28 0x40d990 0x77c810 0x40dd78 0x445c00 0x63f1f0 0x445fe8 0x451f50 0x4fcdb0>;
				xm,cold-step-chg-ranges = <0x2dc6c0 0x401640 0xe7ef0 0x401a28 0x445c00 0x9c018>;
				xm,jeita-fcc-ranges = <0xffffff9c 0x00 0xe7ef0 0x01 0x32 0x200b20 0x33 0x64 0x2dc6c0 0x65 0x96 0x4fcdb0 0x97 0x1df 0xbbaee0 0x1e0 0x244 0x200b20>;
				xm,jeita-fv-ranges = <0xffffff9c 0x00 0x445c00 0x01 0x32 0x445c00 0x33 0x64 0x445c00 0x65 0x96 0x445c00 0x97 0x1df 0x4657d0 0x1e0 0x244 0x445c00>;
				xm,step-jeita-hysteresis = <0x14 0x14>;
				xm,jeita-too-hot = <0x244>;
				xm,jeita-too-cold = <0xffffff9c>;
				xm,thermal-mitigation-icl = <0x2ab980 0x2932e0 0x27ac40 0x249f00 0x2191c0 0x200b20 0x1e8480 0x1b7740 0x186a00 0x16e360 0x155cc0 0x13d620 0x124f80 0x10c8e0 0xe7ef0 0xb71b0>;
				xm,thermal-mitigation = <0x2dc6c0 0x2ab980 0x27ac40 0x249f00 0x2191c0 0x200b20 0x1e8480 0x1b7740 0x186a00 0x16e360 0x155cc0 0x124f80 0xf4240 0xdbba0 0xc3500 0x7a120>;
				xm,thermal-mitigation-dcp = <0x16e360 0x16e360 0x16e360 0x16e360 0x16e360 0x16e360 0x16e360 0x16e360 0x16e360 0x16e360 0x16e360 0x155cc0 0x124f80 0x10c8e0 0x10c8e0 0xf4240>;
				xm,thermal-mitigation-qc2 = <0x16e360 0x16e360 0x16e360 0x16e360 0x162010 0x155cc0 0x149970 0x13d620 0x118c30 0x10c8e0 0xf4240 0xdbba0 0xcf850 0xb71b0 0x9eb10 0x7a120>;
				xm,thermal-mitigation-pd = <0x2dc6c0 0x2ab980 0x27ac40 0x249f00 0x2191c0 0x1e8480 0x1b7740 0x186a00 0x186a00 0x155cc0 0x124f80 0x10c8e0 0x100590 0xf4240 0xe7ef0 0x7a120>;
				xm,thermal-mitigation-pd-cp = <0xbbaee0 0x970fe0 0x84c060 0x788b60 0x632ea0 0x5a06e0 0x532910 0x4b87f0 0x3c45b0 0x2d5190 0x273710 0x203230 0x1cafc0 0x169540 0x77a10 0x46cd0>;
				io-channels = <0x26 0x80 0x26 0x81 0x26 0x82 0x26 0x83 0x26 0x84 0x26 0x85 0x26 0x86 0x26 0x87 0x26 0x88 0x26 0x89 0x26 0x8a 0x26 0x8b 0x26 0x8c 0x26 0x8d 0x26 0x8e 0x26 0x90 0x27 0x80 0x27 0x81 0x27 0x82 0x27 0x83 0x27 0x84 0x27 0x85 0x27 0x86 0x27 0x87 0x27 0x88 0x27 0x89 0x27 0x8a 0x27 0x8b 0x27 0x8c 0x27 0x8d 0x27 0x8e 0x27 0x90 0x28 0xb3 0x28 0xb4 0x28 0xb5 0x28 0xb6 0x28 0xb7 0x28 0xb8 0x28 0xb9 0x28 0xba 0x28 0xbb 0x28 0xbc 0x28 0xbd 0x28 0xbe 0x28 0xbf 0x28 0xc0 0x28 0xc1 0x28 0xc2 0x28 0xc3 0x29 0x95 0x29 0x96 0x29 0x97 0x29 0x98 0x29 0x99 0x29 0x9a 0x29 0x9b 0x29 0x9c 0x29 0x9d 0x29 0x9e 0x29 0x9f 0x29 0xa0 0x29 0xa1 0x29 0xa2 0x29 0xa3 0x29 0xa4 0x29 0xa5 0x29 0xa6 0x29 0xa7 0x29 0xa8 0x29 0xa9 0x29 0xaa 0x29 0xab 0x29 0xac 0x29 0xad 0x29 0xae 0x29 0xaf 0x29 0xb0 0x29 0xb1 0x2a 0xc8 0x2a 0xc9 0x2a 0xca 0x2a 0xcb 0x2a 0xcc 0x2a 0xcd 0x2a 0xce 0x2a 0xcf 0x2a 0xd0 0x2a 0xd1 0x2a 0xd2 0x2a 0xd3 0x2a 0xd4 0x04 0x45 0x04 0x46>;
				io-channel-names = "ln_present\0ln_charging_enabled\0ln_status\0ln_battery_present\0ln_vbus_present\0ln_battery_voltage\0ln_battery_current\0ln_battery_temperature\0ln_bus_voltage\0ln_bus_current\0ln_bus_temperature\0ln_die_temperature\0ln_alarm_status\0ln_fault_status\0ln_vbus_error_status\0ln_reg_status\0ln_present_slave\0ln_charging_enabled_slave\0ln_status_slave\0ln_battery_present_slave\0ln_vbus_present_slave\0ln_battery_voltage_slave\0ln_battery_current_slave\0ln_battery_temperature_slave\0ln_bus_voltage_slave\0ln_bus_current_slave\0ln_bus_temperature_slave\0ln_die_temperature_slave\0ln_alarm_status_slave\0ln_fault_status_slave\0ln_vbus_error_status_slave\0ln_reg_status_slave\0syv_charge_present\0syv_charge_online\0syv_charge_done\0syv_chager_hz\0syv_input_current_settled\0syv_input_voltage_settled\0syv_charge_current\0syv_charger_enable\0syv_otg_enable\0syv_charger_term\0syv_batt_voltage_term\0syv_charger_status\0syv_charger_type\0syv_charger_usb_type\0syv_vbus_voltage\0syv_vbat_voltage\0syv_enable_charger_term\0bqfg_present\0bqfg_status\0bqfg_voltage_now\0bqfg_voltage_max\0bqfg_current_now\0bqfg_capacity\0bqfg_capacity_level\0bqfg_temp\0bqfg_charge_full\0bqfg_charge_full_design\0bqfg_cycle_count\0bqfg_time_to_empty_now\0bqfg_time_to_full_now\0bqfg_update_now\0bqfg_therm_curr\0bqfg_chip_ok\0bqfg_battery_auth\0bqfg_soc_decimal\0bqfg_soc_decimal_rate\0bqfg_soh\0bqfg_rsoc\0bqfg_battery_id\0bqfg_resistance_id\0bqfg_shutdown_delay\0bqfg_fastcharge_mode\0bqfg_temp_max\0bqfg_time_ot\0bqfg_reg_rsoc\0bqfg_rm\0rt_pd_active\0rt_pd_current_max\0rt_pd_voltage_min\0rt_pd_voltage_max\0rt_pd_in_hard_reset\0rt_typec_cc_orientation\0rt_typec_mode\0rt_pd_usb_suspend_supported\0rt_pd_apdo_volt_max\0rt_pd_apdo_curr_max\0rt_pd_usb_real_type\0rt_typec_accessory_mode\0rt_typec_adapter_id\0chg_pump_therm\0typec_conn_therm";
			};
		};
	};

	__symbols__ {
		pmk8350 = "/fragment@0/__overlay__/qcom,pmk8350@0";
		pmk8350_vadc = "/fragment@0/__overlay__/qcom,pmk8350@0/vadc@3100";
		pmk8350_adc_tm = "/fragment@0/__overlay__/qcom,pmk8350@0/adc_tm@3400";
		pmk8350_sdam_1 = "/fragment@0/__overlay__/qcom,pmk8350@0/sdam@7000";
		ufs_dev = "/fragment@0/__overlay__/qcom,pmk8350@0/sdam@7000/ufs_dev@94";
		pmk8350_sdam_2 = "/fragment@0/__overlay__/qcom,pmk8350@0/sdam@7100";
		restart_reason = "/fragment@0/__overlay__/qcom,pmk8350@0/sdam@7100/restart@48";
		pmk8350_sdam_5 = "/fragment@0/__overlay__/qcom,pmk8350@0/sdam@7400";
		pmk8350_sdam_13 = "/fragment@0/__overlay__/qcom,pmk8350@0/sdam@7c00";
		pmk8350_sdam_14 = "/fragment@0/__overlay__/qcom,pmk8350@0/sdam@7d00";
		pmk8350_sdam_21 = "/fragment@0/__overlay__/qcom,pmk8350@0/sdam@8400";
		pmk8350_sdam_22 = "/fragment@0/__overlay__/qcom,pmk8350@0/sdam@8500";
		pmk8350_sdam_23 = "/fragment@0/__overlay__/qcom,pmk8350@0/sdam@8600";
		adc_scaling = "/fragment@0/__overlay__/qcom,pmk8350@0/sdam@8600/scaling@bf";
		pmk8350_sdam_41 = "/fragment@0/__overlay__/qcom,pmk8350@0/sdam@9800";
		pmk8350_sdam_46 = "/fragment@0/__overlay__/qcom,pmk8350@0/sdam@9d00";
		pmk8350_gpios = "/fragment@0/__overlay__/qcom,pmk8350@0/pinctrl@b000";
		pmk8350_sc8551_therm_default = "/fragment@0/__overlay__/qcom,pmk8350@0/pinctrl@b000/pmk8350_sc8551_therm/pmk8350_sc8551_therm_default";
		pmk8350_conn_therm_default = "/fragment@0/__overlay__/qcom,pmk8350@0/pinctrl@b000/pmk8350_conn_therm/pmk8350_conn_therm_default";
		pmk8350_led_l_therm_default = "/fragment@0/__overlay__/qcom,pmk8350@0/pinctrl@b000/pmk8350_led_l_therm/pmk8350_led_l_therm_default";
		pmk8350_rtc = "/fragment@0/__overlay__/qcom,pmk8350@0/rtc@6100";
		pmk8350_adc_tm_iio = "/fragment@0/__overlay__/qcom,pmk8350@0/adc_tm_e";
		pm8350c_tz = "/fragment@1/__overlay__/qcom,pm8350c@2/qcom,temp-alarm@a00";
		pm8350c_gpios = "/fragment@1/__overlay__/qcom,pm8350c@2/pinctrl@8800";
		pm8008i_active = "/fragment@1/__overlay__/qcom,pm8350c@2/pinctrl@8800/pm8008i_reset/pm8008i_active";
		pm8010j_active = "/fragment@1/__overlay__/qcom,pm8350c@2/pinctrl@8800/pm8010j_reset/pm8010j_active";
		lcd_backlight_ctrl_default = "/fragment@1/__overlay__/qcom,pm8350c@2/pinctrl@8800/lcd_backlight_ctrl/lcd_backlight_ctrl_default";
		pm8350c_pwm_1 = "/fragment@1/__overlay__/qcom,pm8350c@2/pwms@e800";
		pm8350c_pwm_2 = "/fragment@1/__overlay__/qcom,pm8350c@2/pwms@eb00";
		pm8350c_rgb = "/fragment@1/__overlay__/qcom,pm8350c@2/qcom,leds@ef00";
		pm8350c_bcl = "/fragment@1/__overlay__/qcom,pm8350c@2/bcl@4700";
		pm8350c_flash = "/fragment@1/__overlay__/qcom,pm8350c@2/qcom,flash_led@ee00";
		pm8350c_flash0 = "/fragment@1/__overlay__/qcom,pm8350c@2/qcom,flash_led@ee00/qcom,flash_0";
		pm8350c_flash1 = "/fragment@1/__overlay__/qcom,pm8350c@2/qcom,flash_led@ee00/qcom,flash_1";
		pm8350c_flash2 = "/fragment@1/__overlay__/qcom,pm8350c@2/qcom,flash_led@ee00/qcom,flash_2";
		pm8350c_flash3 = "/fragment@1/__overlay__/qcom,pm8350c@2/qcom,flash_led@ee00/qcom,flash_3";
		pm8350c_torch0 = "/fragment@1/__overlay__/qcom,pm8350c@2/qcom,flash_led@ee00/qcom,torch_0";
		pm8350c_torch1 = "/fragment@1/__overlay__/qcom,pm8350c@2/qcom,flash_led@ee00/qcom,torch_1";
		pm8350c_torch2 = "/fragment@1/__overlay__/qcom,pm8350c@2/qcom,flash_led@ee00/qcom,torch_2";
		pm8350c_torch3 = "/fragment@1/__overlay__/qcom,pm8350c@2/qcom,flash_led@ee00/qcom,torch_3";
		pm8350c_switch0 = "/fragment@1/__overlay__/qcom,pm8350c@2/qcom,flash_led@ee00/qcom,led_switch_0";
		pm8350c_switch1 = "/fragment@1/__overlay__/qcom,pm8350c@2/qcom,flash_led@ee00/qcom,led_switch_1";
		pm8350c_switch2 = "/fragment@1/__overlay__/qcom,pm8350c@2/qcom,flash_led@ee00/qcom,led_switch_2";
		pm8350c_temp_alarm = "/fragment@2/__overlay__/pm8350c_tz";
		pm8350c_trip0 = "/fragment@2/__overlay__/pm8350c_tz/trips/trip0";
		pm8350c_trip1 = "/fragment@2/__overlay__/pm8350c_tz/trips/trip1";
		pm8350c_trip2 = "/fragment@2/__overlay__/pm8350c_tz/trips/trip2";
		c_bcl_lvl0 = "/fragment@2/__overlay__/pm8350c-bcl-lvl0/trips/c-bcl-lvl0";
		c_bcl_lvl1 = "/fragment@2/__overlay__/pm8350c-bcl-lvl1/trips/c-bcl-lvl1";
		c_bcl_lvl2 = "/fragment@2/__overlay__/pm8350c-bcl-lvl2/trips/c-bcl-lvl2";
		pm7325_tz = "/fragment@3/__overlay__/qcom,pm7325@1/qcom,temp-alarm@a00";
		pm7325_gpios = "/fragment@3/__overlay__/qcom,pm7325@1/pinctrl@8800";
		key_vol_up_default = "/fragment@3/__overlay__/qcom,pm7325@1/pinctrl@8800/key_vol_up/key_vol_up_default";
		pm7325_temp_alarm = "/fragment@4/__overlay__/pm7325_tz";
		pm7325_trip0 = "/fragment@4/__overlay__/pm7325_tz/trips/trip0";
		pm7325_trip1 = "/fragment@4/__overlay__/pm7325_tz/trips/trip1";
		pm7325_trip2 = "/fragment@4/__overlay__/pm7325_tz/trips/trip2";
		pmr735a_spmi = "/fragment@5/__overlay__/qcom,pmr735a@4";
		pmr735a_tz = "/fragment@5/__overlay__/qcom,pmr735a@4/qcom,temp-alarm@a00";
		pmr735a_gpios = "/fragment@5/__overlay__/qcom,pmr735a@4/pinctrl@8800";
		pmr735a_temp_alarm = "/fragment@6/__overlay__/pmr735a_tz";
		pmr735a_trip0 = "/fragment@6/__overlay__/pmr735a_tz/trips/trip0";
		pmr735a_trip1 = "/fragment@6/__overlay__/pmr735a_tz/trips/trip1";
		pmr735a_trip2 = "/fragment@6/__overlay__/pmr735a_tz/trips/trip2";
		PM8008I_EN = "/fragment@9/__overlay__/pm8008i@8/pm8008-chip@900/qcom,pm8008-chip-en";
		L1I = "/fragment@9/__overlay__/pm8008i@9/qcom,pm8008i-regulator/regulator@4000";
		pm8008i_l1 = "/fragment@9/__overlay__/pm8008i@9/qcom,pm8008i-regulator/regulator@4000";
		L2I = "/fragment@9/__overlay__/pm8008i@9/qcom,pm8008i-regulator/regulator@4100";
		pm8008i_l2 = "/fragment@9/__overlay__/pm8008i@9/qcom,pm8008i-regulator/regulator@4100";
		L3I = "/fragment@9/__overlay__/pm8008i@9/qcom,pm8008i-regulator/regulator@4200";
		pm8008i_l3 = "/fragment@9/__overlay__/pm8008i@9/qcom,pm8008i-regulator/regulator@4200";
		L4I = "/fragment@9/__overlay__/pm8008i@9/qcom,pm8008i-regulator/regulator@4300";
		pm8008i_l4 = "/fragment@9/__overlay__/pm8008i@9/qcom,pm8008i-regulator/regulator@4300";
		L5I = "/fragment@9/__overlay__/pm8008i@9/qcom,pm8008i-regulator/regulator@4400";
		pm8008i_l5 = "/fragment@9/__overlay__/pm8008i@9/qcom,pm8008i-regulator/regulator@4400";
		L6I = "/fragment@9/__overlay__/pm8008i@9/qcom,pm8008i-regulator/regulator@4500";
		pm8008i_l6 = "/fragment@9/__overlay__/pm8008i@9/qcom,pm8008i-regulator/regulator@4500";
		L7I = "/fragment@9/__overlay__/pm8008i@9/qcom,pm8008i-regulator/regulator@4600";
		pm8008i_l7 = "/fragment@9/__overlay__/pm8008i@9/qcom,pm8008i-regulator/regulator@4600";
		PM8010J_EN = "/fragment@9/__overlay__/pm8010j@c/pm8010-chip@900/qcom,pm8008-chip-en";
		L1J = "/fragment@9/__overlay__/pm8010j@d/qcom,pm8010j-regulator/regulator@4000";
		pm8010j_l1 = "/fragment@9/__overlay__/pm8010j@d/qcom,pm8010j-regulator/regulator@4000";
		L2J = "/fragment@9/__overlay__/pm8010j@d/qcom,pm8010j-regulator/regulator@4100";
		pm8010j_l2 = "/fragment@9/__overlay__/pm8010j@d/qcom,pm8010j-regulator/regulator@4100";
		L3J = "/fragment@9/__overlay__/pm8010j@d/qcom,pm8010j-regulator/regulator@4200";
		pm8010j_l3 = "/fragment@9/__overlay__/pm8010j@d/qcom,pm8010j-regulator/regulator@4200";
		L4J = "/fragment@9/__overlay__/pm8010j@d/qcom,pm8010j-regulator/regulator@4300";
		pm8010j_l4 = "/fragment@9/__overlay__/pm8010j@d/qcom,pm8010j-regulator/regulator@4300";
		L5J = "/fragment@9/__overlay__/pm8010j@d/qcom,pm8010j-regulator/regulator@4400";
		pm8010j_l5 = "/fragment@9/__overlay__/pm8010j@d/qcom,pm8010j-regulator/regulator@4400";
		L6J = "/fragment@9/__overlay__/pm8010j@d/qcom,pm8010j-regulator/regulator@4500";
		pm8010j_l6 = "/fragment@9/__overlay__/pm8010j@d/qcom,pm8010j-regulator/regulator@4500";
		L7J = "/fragment@9/__overlay__/pm8010j@d/qcom,pm8010j-regulator/regulator@4600";
		pm8010j_l7 = "/fragment@9/__overlay__/pm8010j@d/qcom,pm8010j-regulator/regulator@4600";
		qupv3_se0_spi_sleep = "/fragment@23/__overlay__/qupv3_se0_spi_sleep";
		qupv3_se0_spi_sleep_cs = "/fragment@23/__overlay__/qupv3_se0_spi_sleep_cs";
		syna_reset_gpio_default = "/fragment@23/__overlay__/syna_reset_gpio_default";
		ln8000_int_default = "/fragment@30/__overlay__/ln8000_int_default";
		ln8000_int2_default = "/fragment@30/__overlay__/ln8000_int2_default";
		ln8000_master = "/fragment@31/__overlay__/ln8000-charger@51";
		ln8000_slave = "/fragment@32/__overlay__/ln8000-charger@51";
		rt1711h_int_n = "/fragment@33/__overlay__/rt1711h_int_n";
		rpm = "/fragment@35/__overlay__/rt-pd-manager";
		bq25890_int_default = "/fragment@37/__overlay__/bq25890_int_default";
		bq25890_otg_default = "/fragment@37/__overlay__/bq25890_otg_default";
		vbus_ntc_ctrl = "/fragment@37/__overlay__/vbus_ntc_ctrl";
		bq25890_main = "/fragment@39/__overlay__/bq25890@6A";
		bq27z561_fg = "/fragment@40/__overlay__/bq27z561@55";
		rt17xx_pd = "/fragment@41/__overlay__/xm_pd_adapter";
	};

	__fixups__ {
		spmi_bus = "/fragment@0:target:0\0/fragment@1:target:0\0/fragment@3:target:0\0/fragment@5:target:0";
		thermal_zones = "/fragment@2:target:0\0/fragment@4:target:0\0/fragment@6:target:0\0/fragment@10:target:0\0/fragment@20:target:0";
		soc = "/fragment@7:target:0\0/fragment@11:target:0\0/fragment@17:target:0\0/fragment@21:target:0\0/fragment@26:target:0\0/fragment@35:target:0\0/fragment@41:target:0";
		gcc = "/fragment@8:target:0";
		qupv3_se2_i2c = "/fragment@8/__overlay__:qcom,critical-devices:0\0/fragment@9:target:0";
		S8B = "/fragment@9/__overlay__/pm8008i@9/qcom,pm8008i-regulator:vdd_l1_l2-supply:0\0/fragment@9/__overlay__/pm8010j@d/qcom,pm8010j-regulator:vdd_l1_l2-supply:0";
		BOB = "/fragment@9/__overlay__/pm8008i@9/qcom,pm8008i-regulator:vdd_l3_l4-supply:0\0/fragment@9/__overlay__/pm8008i@9/qcom,pm8008i-regulator:vdd_l7-supply:0\0/fragment@9/__overlay__/pm8010j@d/qcom,pm8010j-regulator:vdd_l5-supply:0\0/fragment@9/__overlay__/pm8010j@d/qcom,pm8010j-regulator:vdd_l6-supply:0\0/fragment@9/__overlay__/pm8010j@d/qcom,pm8010j-regulator:vdd_l7-supply:0";
		S1B = "/fragment@9/__overlay__/pm8008i@9/qcom,pm8008i-regulator:vdd_l5-supply:0\0/fragment@9/__overlay__/pm8008i@9/qcom,pm8008i-regulator:vdd_l6-supply:0\0/fragment@9/__overlay__/pm8010j@d/qcom,pm8010j-regulator:vdd_l3_l4-supply:0";
		modem_lte_dsc = "/fragment@10/__overlay__/pm8350c-bcl-lvl0/cooling-maps/vph_lte0:cooling-device:0\0/fragment@10/__overlay__/pm8350c-bcl-lvl1/cooling-maps/vph_lte1:cooling-device:0\0/fragment@10/__overlay__/pm8350c_tz/cooling-maps/pm8350c_lte:cooling-device:0";
		modem_nr_scg_dsc = "/fragment@10/__overlay__/pm8350c-bcl-lvl0/cooling-maps/vph_nr0_scg:cooling-device:0\0/fragment@10/__overlay__/pm8350c-bcl-lvl1/cooling-maps/vph_nr1_scg:cooling-device:0\0/fragment@10/__overlay__/pm8350c_tz/cooling-maps/pm8350c_nr:cooling-device:0";
		modem_nr_dsc = "/fragment@10/__overlay__/pm8350c-bcl-lvl0/cooling-maps/vph_nr0:cooling-device:0\0/fragment@10/__overlay__/pm8350c-bcl-lvl1/cooling-maps/vph_nr1:cooling-device:0";
		cdsp_sw = "/fragment@10/__overlay__/pm8350c-bcl-lvl0/cooling-maps/vph_cdsp0:cooling-device:0\0/fragment@10/__overlay__/pm8350c-bcl-lvl1/cooling-maps/vph_cdsp1:cooling-device:0\0/fragment@10/__overlay__/pm8350c-bcl-lvl2/cooling-maps/vph_cdsp2:cooling-device:0";
		cpu5_pause = "/fragment@10/__overlay__/pm8350c-bcl-lvl0/cooling-maps/vph_cpu_5:cooling-device:0";
		msm_gpu = "/fragment@10/__overlay__/pm8350c-bcl-lvl0/cooling-maps/vph_gpu0:cooling-device:0\0/fragment@10/__overlay__/pm8350c-bcl-lvl1/cooling-maps/vph_gpu1:cooling-device:0\0/fragment@10/__overlay__/pm8350c-bcl-lvl2/cooling-maps/vph_gpu2:cooling-device:0\0/fragment@10/__overlay__/pm8350c_tz/cooling-maps/pm8350c_gpu:cooling-device:0";
		cpu_6_7_pause = "/fragment@10/__overlay__/pm8350c-bcl-lvl1/cooling-maps/vph_cpu_6_7:cooling-device:0";
		CPU4 = "/fragment@10/__overlay__/pm7325_tz/cooling-maps/pm7325_cpu4_freq:cooling-device:0";
		CPU7 = "/fragment@10/__overlay__/pm7325_tz/cooling-maps/pm7325_cpu7_freq:cooling-device:0";
		APC1_pause = "/fragment@10/__overlay__/pm7325_tz/cooling-maps/pm7325_apc1:cooling-device:0";
		qupv3_se0_i2c = "/fragment@12:target:0";
		qupv3_se9_i2c = "/fragment@13:target:0";
		tlmm = "/fragment@13/__overlay__/nq@28:qcom,sn-irq:0\0/fragment@13/__overlay__/nq@28:qcom,sn-ven:0\0/fragment@13/__overlay__/nq@28:qcom,sn-firm:0\0/fragment@13/__overlay__/nq@28:qcom,sn-clkreq:0\0/fragment@13/__overlay__/nq@28:interrupt-parent:0\0/fragment@22/__overlay__/synaptics_tcm@0:interrupt-parent:0\0/fragment@22/__overlay__/synaptics_tcm@0:synaptics,irq-gpio:0\0/fragment@22/__overlay__/synaptics_tcm@0:synaptics,reset-gpio:0\0/fragment@23:target:0\0/fragment@26/__overlay__/fingerprint_goodix:goodix,gpio-reset:0\0/fragment@26/__overlay__/fingerprint_goodix:goodix,gpio-irq:0\0/fragment@30:target:0\0/fragment@31/__overlay__/ln8000-charger@51:interrupt-parent:0\0/fragment@32/__overlay__/ln8000-charger@51:interrupt-parent:0\0/fragment@33:target:0\0/fragment@34/__overlay__/rt1711h@4e:rt1711pd,intr_gpio:0\0/fragment@37:target:0\0/fragment@39/__overlay__/bq25890@6A:interrupt-parent:0\0/fragment@39/__overlay__/bq25890@6A:intr-gpio:0\0/fragment@39/__overlay__/bq25890@6A:otg-gpio:0\0/fragment@41/__overlay__/xm_battmngr:vbus_ctrl_gpio:0";
		L18B = "/fragment@13/__overlay__/nq@28:qcom,sn-vdd-1p8-supply:0";
		nfc_int_active = "/fragment@13/__overlay__/nq@28:pinctrl-0:0";
		nfc_enable_active = "/fragment@13/__overlay__/nq@28:pinctrl-0:4";
		nfc_int_suspend = "/fragment@13/__overlay__/nq@28:pinctrl-1:0";
		nfc_enable_suspend = "/fragment@13/__overlay__/nq@28:pinctrl-1:4";
		sdhc_2 = "/fragment@14:target:0";
		ufsphy_mem = "/fragment@15:target:0";
		L10C = "/fragment@15/__overlay__:vdda-phy-supply:0";
		L6B = "/fragment@15/__overlay__:vdda-pll-supply:0";
		ufshc_mem = "/fragment@16:target:0";
		gcc_ufs_phy_gdsc = "/fragment@16/__overlay__:vdd-hba-supply:0";
		L7B = "/fragment@16/__overlay__:vcc-supply:0";
		L9B = "/fragment@16/__overlay__:vccq-supply:0\0/fragment@16/__overlay__:qcom,vddp-ref-clk-supply:0";
		L19B = "/fragment@16/__overlay__:vccq2-supply:0";
		reserved_memory = "/fragment@18:target:0";
		icnss2 = "/fragment@19:target:0";
		qupv3_se0_spi = "/fragment@22:target:0";
		L11C = "/fragment@22/__overlay__/synaptics_tcm@0:avdd-supply:0";
		L2C = "/fragment@22/__overlay__/synaptics_tcm@0:iovdd-supply:0";
		qupv3_se11_spi = "/fragment@24:target:0";
		qupv3_se3_i2c = "/fragment@25:target:0";
		L3C = "/fragment@26/__overlay__/fingerprint_goodix:l11c_vdd-supply:0\0/fragment@27:target:0";
		qseecom_mem = "/fragment@28:target:0";
		qseecom_ta_mem = "/fragment@29:target:0";
		qupv3_se4_i2c = "/fragment@31:target:0\0/fragment@34:target:0\0/fragment@39:target:0";
		qupv3_se12_i2c = "/fragment@32:target:0\0/fragment@40:target:0";
		usb0 = "/fragment@36:target:0";
		usb2_phy0 = "/fragment@38:target:0\0/fragment@39/__overlay__/bq25890@6A:dpdm-supply:0";
	};

	__local_fixups__ {

		fragment@0 {

			__overlay__ {

				qcom,pmk8350@0 {

					vadc@3100 {
						pinctrl-0 = <0x00 0x04 0x08>;
					};

					adc_tm@3400 {
						io-channels = <0x00 0x08 0x10 0x18 0x20 0x28 0x30 0x38>;
					};

					adc_tm_e {
						io-channels = <0x00 0x08>;
					};
				};
			};
		};

		fragment@1 {

			__overlay__ {

				qcom,pm8350c@2 {

					pwms@e800 {
						nvmem = <0x00 0x04>;
					};

					qcom,leds@ef00 {

						red {
							pwms = <0x00>;
						};

						green {
							pwms = <0x00>;
						};

						blue {
							pwms = <0x00>;
						};
					};
				};
			};
		};

		fragment@2 {

			__overlay__ {

				pm8350c_tz {
					thermal-sensors = <0x00>;
				};

				pm8350c-bcl-lvl0 {
					thermal-sensors = <0x00>;
				};

				pm8350c-bcl-lvl1 {
					thermal-sensors = <0x00>;
				};

				pm8350c-bcl-lvl2 {
					thermal-sensors = <0x00>;
				};
			};
		};

		fragment@3 {

			__overlay__ {

				qcom,pm7325@1 {

					qcom,temp-alarm@a00 {
						io-channels = <0x00>;
					};
				};
			};
		};

		fragment@4 {

			__overlay__ {

				pm7325_tz {
					thermal-sensors = <0x00>;
				};
			};
		};

		fragment@5 {

			__overlay__ {

				qcom,pmr735a@4 {

					qcom,temp-alarm@a00 {
						io-channels = <0x00>;
					};
				};
			};
		};

		fragment@6 {

			__overlay__ {

				pmr735a_tz {
					thermal-sensors = <0x00>;
				};
			};
		};

		fragment@7 {

			__overlay__ {

				reboot_reason {
					nvmem-cells = <0x00>;
				};

				pmic-pon-log {
					nvmem = <0x00>;
				};
			};
		};

		fragment@9 {

			__overlay__ {

				pm8008i@8 {
					pinctrl-0 = <0x00>;
				};

				pm8008i@9 {

					qcom,pm8008i-regulator {
						pm8008_en-supply = <0x00>;
					};
				};

				pm8010j@c {
					pinctrl-0 = <0x00>;
				};

				pm8010j@d {

					qcom,pm8010j-regulator {
						pm8008_en-supply = <0x00>;
					};
				};
			};
		};

		fragment@10 {

			__overlay__ {

				pm8350c-bcl-lvl0 {

					cooling-maps {

						vph_lte0 {
							trip = <0x00>;
						};

						vph_nr0_scg {
							trip = <0x00>;
						};

						vph_nr0 {
							trip = <0x00>;
						};

						vph_cdsp0 {
							trip = <0x00>;
						};

						vph_cpu_5 {
							trip = <0x00>;
						};

						vph_gpu0 {
							trip = <0x00>;
						};
					};
				};

				pm8350c-bcl-lvl1 {

					cooling-maps {

						vph_lte1 {
							trip = <0x00>;
						};

						vph_nr1_scg {
							trip = <0x00>;
						};

						vph_nr1 {
							trip = <0x00>;
						};

						vph_cdsp1 {
							trip = <0x00>;
						};

						vph_cpu_6_7 {
							trip = <0x00>;
						};

						vph_gpu1 {
							trip = <0x00>;
						};
					};
				};

				pm8350c-bcl-lvl2 {

					cooling-maps {

						vph_cdsp2 {
							trip = <0x00>;
						};

						vph_gpu2 {
							trip = <0x00>;
						};
					};
				};

				pm8350c_tz {

					cooling-maps {

						pm8350c_lte {
							trip = <0x00>;
						};

						pm8350c_nr {
							trip = <0x00>;
						};

						pm8350c_gpu {
							trip = <0x00>;
						};
					};
				};

				pm7325_tz {

					cooling-maps {

						pm7325_cpu4_freq {
							trip = <0x00>;
						};

						pm7325_cpu7_freq {
							trip = <0x00>;
						};

						pm7325_apc1 {
							trip = <0x00>;
						};
					};
				};
			};
		};

		fragment@11 {

			__overlay__ {

				gpio_keys {
					pinctrl-0 = <0x00>;

					vol_up {
						gpios = <0x00>;
					};
				};
			};
		};

		fragment@16 {

			__overlay__ {
				nvmem-cells = <0x00>;
			};
		};

		fragment@20 {

			__overlay__ {

				quiet_therm {
					thermal-sensors = <0x00>;
				};

				flash_therm {
					thermal-sensors = <0x00>;
				};

				cpu_therm {
					thermal-sensors = <0x00>;
				};

				wifi_therm {
					thermal-sensors = <0x00>;
				};

				pa_4gtherm {
					thermal-sensors = <0x00>;
				};

				modem1_pa0 {
					thermal-sensors = <0x00>;
				};

				xo_therm {
					thermal-sensors = <0x00>;
				};

				charger_therm0 {
					thermal-sensors = <0x00>;
				};

				conn_therm {
					thermal-sensors = <0x00>;
				};

				led_l_therm {
					thermal-sensors = <0x00>;
				};
			};
		};

		fragment@22 {

			__overlay__ {
				pinctrl-1 = <0x00 0x04>;

				synaptics_tcm@0 {
					pinctrl-0 = <0x00>;
				};
			};
		};

		fragment@31 {

			__overlay__ {

				ln8000-charger@51 {
					pinctrl-0 = <0x00>;
				};
			};
		};

		fragment@32 {

			__overlay__ {

				ln8000-charger@51 {
					inctrl-0 = <0x00>;
				};
			};
		};

		fragment@34 {

			__overlay__ {

				rt1711h@4e {
					pinctrl-0 = <0x00>;
				};
			};
		};

		fragment@36 {

			__overlay__ {
				extcon = <0x00>;
			};
		};

		fragment@39 {

			__overlay__ {

				bq25890@6A {
					pinctrl-0 = <0x00 0x04>;
				};
			};
		};

		fragment@41 {

			__overlay__ {

				xm_battmngr {
					pinctrl-0 = <0x00>;
					io-channels = <0x00 0x08 0x10 0x18 0x20 0x28 0x30 0x38 0x40 0x48 0x50 0x58 0x60 0x68 0x70 0x78 0x80 0x88 0x90 0x98 0xa0 0xa8 0xb0 0xb8 0xc0 0xc8 0xd0 0xd8 0xe0 0xe8 0xf0 0xf8 0x100 0x108 0x110 0x118 0x120 0x128 0x130 0x138 0x140 0x148 0x150 0x158 0x160 0x168 0x170 0x178 0x180 0x188 0x190 0x198 0x1a0 0x1a8 0x1b0 0x1b8 0x1c0 0x1c8 0x1d0 0x1d8 0x1e0 0x1e8 0x1f0 0x1f8 0x200 0x208 0x210 0x218 0x220 0x228 0x230 0x238 0x240 0x248 0x250 0x258 0x260 0x268 0x270 0x278 0x280 0x288 0x290 0x298 0x2a0 0x2a8 0x2b0 0x2b8 0x2c0 0x2c8 0x2d0 0x2d8 0x2e0>;
				};
			};
		};
	};
};
