/dts-v1/;

/ {
	qcom,pmic-id = <0x2f 0x00 0x00 0x00 0x00 0x00 0x00 0x00 0x41 0x41>;
	qcom,pmic-id-size = <0x0a>;
	model = "Thor based on Qualcomm Technologies, Inc SM8450";
	compatible = "qcom,waipio-mtp\0qcom,waipio\0qcom,mtp";
	qcom,msm-id = <0x228 0x10000>;
	qcom,board-id = <0x3010008 0x03>;
	xiaomi,miboard-id = <0x06 0x00>;

	fragment@0 {
		target = <0xffffffff>;

		__overlay__ {

			cirrus_reset_default_0 {
				phandle = <0x23>;

				mux {
					pins = "gpio9";
					function = "gpio";
				};

				config {
					pins = "gpio9";
					drive-strength = <0x10>;
					bias-disable;
					output-high;
				};
			};

			cirrus_reset_default_1 {
				phandle = <0x25>;

				mux {
					pins = "gpio66";
					function = "gpio";
				};

				config {
					pins = "gpio66";
					drive-strength = <0x10>;
					bias-disable;
					output-high;
				};
			};

			cirrus_irq_default {

				cirrus_irq_default_0 {
					phandle = <0x24>;

					mux {
						pins = "gpio63";
						function = "gpio";
					};

					config {
						pins = "gpio63";
						drive-strength = <0x02>;
						input-enable;
						bias-pull-up;
					};
				};

				cirrus_irq_default_1 {
					phandle = <0x26>;

					mux {
						pins = "gpio88";
						function = "gpio";
					};

					config {
						pins = "gpio88";
						drive-strength = <0x02>;
						input-enable;
						bias-pull-up;
					};
				};
			};

			cam_sensor_mclk3_active {
				phandle = <0x30>;

				mux {
					pins = "gpio103";
					function = "cam_mclk";
				};

				config {
					pins = "gpio103";
					bias-disable;
					drive-strength = <0x02>;
				};
			};

			cam_sensor_mclk3_suspend {
				phandle = <0x31>;

				mux {
					pins = "gpio103";
					function = "cam_mclk";
				};

				config {
					pins = "gpio103";
					bias-pull-down;
					drive-strength = <0x02>;
				};
			};

			md_mode_ctrl_irq {

				ant4_ctrl_irq {
					phandle = <0x29>;

					mux {
						pins = "gpio83";
						function = "gpio";
					};

					config {
						pins = "gpio83";
						drive-strength = <0x02>;
						bias-disable;
						input-enable;
					};
				};

				ant3_ctrl_irq {
					phandle = <0x2a>;

					mux {
						pins = "gpio159";
						function = "gpio";
					};

					config {
						pins = "gpio159";
						drive-strength = <0x02>;
						bias-disable;
						input-enable;
					};
				};
			};
		};
	};

	fragment@1 {
		target = <0xffffffff>;

		__overlay__ {
			#address-cells = <0x02>;
			#size-cells = <0x00>;
			interrupt-controller;
			#interrupt-cells = <0x04>;

			qcom,pmk8350@0 {
				compatible = "qcom,spmi-pmic";
				reg = <0x00 0x00>;
				#address-cells = <0x01>;
				#size-cells = <0x00>;
				phandle = <0x3b>;

				pon_hlos@1300 {
					compatible = "qcom,pm8998-pon";
					reg = <0x1300 0x800>;
					reg-names = "pon_hlos\0pon_pbs";
					qcom,log-kpd-event;
					phandle = <0x3c>;

					pwrkey {
						compatible = "qcom,pmk8350-pwrkey";
						interrupts = <0x00 0x13 0x07 0x03>;
						linux,code = <0x74>;
					};

					resin {
						compatible = "qcom,pmk8350-resin";
						interrupts = <0x00 0x13 0x06 0x03>;
						linux,code = <0x72>;
					};

					pwrkey-bark {
						compatible = "qcom,pmk8350-pwrkey-bark";
						interrupts = <0x00 0x13 0x00 0x03>;
						linux,code = <0x74>;
					};

					pwrkey-resin-bark {
						compatible = "qcom,pmk8350-pwrkey-resin-bark";
						interrupts = <0x00 0x13 0x02 0x03>;
						linux,code = <0x74>;
					};
				};

				vadc@3100 {
					compatible = "qcom,spmi-adc7";
					reg = <0x3100>;
					#address-cells = <0x01>;
					#size-cells = <0x00>;
					interrupts = <0x00 0x31 0x00 0x01>;
					interrupt-names = "eoc-int-en-set";
					#io-channel-cells = <0x01>;
					io-channel-ranges;
					pinctrl-names = "default";
					pinctrl-0 = <0x01>;
					phandle = <0x02>;

					pmk8350_ref_gnd {
						reg = <0x00>;
						label = "pmk8350_ref_gnd";
						qcom,pre-scaling = <0x01 0x01>;
					};

					pmk8350_vref_1p25 {
						reg = <0x01>;
						label = "pmk8350_vref_1p25";
						qcom,pre-scaling = <0x01 0x01>;
					};

					pmk8350_die_temp {
						reg = <0x03>;
						label = "pmk8350_die_temp";
						qcom,pre-scaling = <0x01 0x01>;
					};

					pm8350_ref_gnd {
						reg = <0x100>;
						label = "pm8350_ref_gnd";
						qcom,pre-scaling = <0x01 0x01>;
					};

					pm8350_vref_1p25 {
						reg = <0x101>;
						label = "pm8350_vref_1p25";
						qcom,pre-scaling = <0x01 0x01>;
					};

					pm8350_die_temp {
						reg = <0x103>;
						label = "pm8350_die_temp";
						qcom,pre-scaling = <0x01 0x01>;
					};

					pm8350_vph_pwr {
						reg = <0x18e>;
						label = "pm8350_vph_pwr";
						qcom,pre-scaling = <0x01 0x03>;
					};

					pm8350b_ref_gnd {
						reg = <0x300>;
						label = "pm8350b_ref_gnd";
						qcom,pre-scaling = <0x01 0x01>;
					};

					pm8350b_vref_1p25 {
						reg = <0x301>;
						label = "pm8350b_vref_1p25";
						qcom,pre-scaling = <0x01 0x01>;
					};

					pm8350b_die_temp {
						reg = <0x303>;
						label = "pm8350b_die_temp";
						qcom,pre-scaling = <0x01 0x01>;
					};

					pm8350b_vph_pwr {
						reg = <0x38e>;
						label = "pm8350b_vph_pwr";
						qcom,pre-scaling = <0x01 0x03>;
					};

					pm8350b_vbat_sns {
						reg = <0x38f>;
						label = "pm8350b_vbat_sns";
						qcom,pre-scaling = <0x01 0x03>;
					};

					pmr735a_ref_gnd {
						reg = <0x400>;
						label = "pmr735a_ref_gnd";
						qcom,pre-scaling = <0x01 0x01>;
					};

					pmr735a_vref_1p25 {
						reg = <0x401>;
						label = "pmr735a_vref_1p25";
						qcom,pre-scaling = <0x01 0x01>;
					};

					pmr735a_die_temp {
						reg = <0x403>;
						label = "pmr735a_die_temp";
						qcom,pre-scaling = <0x01 0x01>;
					};

					pmr735b_ref_gnd {
						reg = <0x500>;
						label = "pmr735b_ref_gnd";
						qcom,pre-scaling = <0x01 0x01>;
					};

					pmr735b_vref_1p25 {
						reg = <0x501>;
						label = "pmr735b_vref_1p25";
						qcom,pre-scaling = <0x01 0x01>;
					};

					pmr735b_die_temp {
						reg = <0x503>;
						label = "pmr735b_die_temp";
						qcom,pre-scaling = <0x01 0x01>;
					};

					pm8350b_chg_temp {
						reg = <0x310>;
						label = "pm8350b_chg_temp";
						qcom,pre-scaling = <0x01 0x01>;
					};

					pm8350b_iin_fb {
						reg = <0x317>;
						label = "pm8350b_iin_fb";
						qcom,pre-scaling = <0x20 0x64>;
					};

					pm8350b_ichg_fb {
						reg = <0x3a1>;
						label = "pm8350b_ichg_fb";
						qcom,pre-scaling = <0x3e8 0x4a821>;
					};

					pm8350b_usb_in_v_div_16 {
						reg = <0x311>;
						label = "pm8350b_usb_in_v_div_16";
						qcom,pre-scaling = <0x01 0x10>;
					};

					smb139x_1_smb_temp {
						reg = <0x906>;
						label = "smb139x_1_smb_temp";
						qcom,hw-settle-time = <0xc8>;
					};

					smb139x_1_ichg_smb {
						reg = <0x918>;
						label = "smb139x_1_ichg_smb";
						qcom,hw-settle-time = <0xc8>;
					};

					smb139x_1_iin_smb {
						reg = <0x919>;
						label = "smb139x_1_iin_smb";
						qcom,hw-settle-time = <0xc8>;
					};

					smb139x_2_smb_temp {
						reg = <0xb06>;
						label = "smb139x_2_smb_temp";
						qcom,hw-settle-time = <0xc8>;
					};

					smb139x_2_ichg_smb {
						reg = <0xb18>;
						label = "smb139x_2_ichg_smb";
						qcom,hw-settle-time = <0xc8>;
					};

					smb139x_2_iin_smb {
						reg = <0xb19>;
						label = "smb139x_2_iin_smb";
						qcom,hw-settle-time = <0xc8>;
					};

					pm8350_msm_therm {
						reg = <0x144>;
						label = "pm8350_msm_therm";
						qcom,ratiometric;
						qcom,hw-settle-time = <0xc8>;
						qcom,pre-scaling = <0x01 0x01>;
					};

					pm8350_cam_flash_therm {
						reg = <0x145>;
						label = "pm8350_cam_flash_therm";
						qcom,ratiometric;
						qcom,hw-settle-time = <0xc8>;
						qcom,pre-scaling = <0x01 0x01>;
					};

					pm8350_hot_pocket_therm {
						reg = <0x146>;
						label = "pm8350_hot_pocket_therm";
						qcom,ratiometric;
						qcom,hw-settle-time = <0xc8>;
						qcom,pre-scaling = <0x01 0x01>;
					};

					pm8350_wide_rfc_therm {
						reg = <0x147>;
						label = "pm8350_wide_rfc_therm";
						qcom,ratiometric;
						qcom,hw-settle-time = <0xc8>;
						qcom,pre-scaling = <0x01 0x01>;
					};

					pm8350b_rear_tof_therm {
						reg = <0x34b>;
						label = "pm8350b_rear_tof_therm";
						qcom,ratiometric;
						qcom,hw-settle-time = <0xc8>;
						qcom,pre-scaling = <0x01 0x01>;
					};

					pm8350b_usb_conn_therm {
						reg = <0x44a>;
						label = "pm8350b_usb_conn_therm";
						qcom,ratiometric;
						qcom,hw-settle-time = <0xc8>;
						qcom,pre-scaling = <0x01 0x01>;
					};

					pm8350b_wl_chg_therm {
						reg = <0x44b>;
						label = "pm8350b_wl_chg_therm";
						qcom,ratiometric;
						qcom,hw-settle-time = <0xc8>;
						qcom,pre-scaling = <0x01 0x01>;
					};

					pmk8350_wifi_therm {
						reg = <0x44c>;
						label = "pmk8350_wifi_therm";
						qcom,ratiometric;
						qcom,hw-settle-time = <0xc8>;
						qcom,pre-scaling = <0x01 0x01>;
					};
				};

				adc_tm@3400 {
					compatible = "qcom,adc-tm7";
					reg = <0x3400>;
					interrupts = <0x00 0x34 0x00 0x01>;
					interrupt-names = "threshold";
					#address-cells = <0x01>;
					#size-cells = <0x00>;
					#thermal-sensor-cells = <0x01>;
					io-channels = <0x02 0x144 0x02 0x145 0x02 0x146 0x02 0x147 0x02 0x34b 0x02 0x44a 0x02 0x44b 0x02 0x44c>;
					phandle = <0x36>;

					pm8350_msm_therm {
						reg = <0x144>;
						qcom,ratiometric;
						qcom,hw-settle-time = <0xc8>;
					};

					pm8350_cam_flash_therm {
						reg = <0x145>;
						qcom,ratiometric;
						qcom,hw-settle-time = <0xc8>;
					};

					pm8350_hot_pocket_therm {
						reg = <0x146>;
						qcom,ratiometric;
						qcom,hw-settle-time = <0xc8>;
					};

					pm8350_wide_rfc_therm {
						reg = <0x147>;
						qcom,ratiometric;
						qcom,hw-settle-time = <0xc8>;
					};

					pm8350b_rear_tof_therm {
						reg = <0x34b>;
						qcom,ratiometric;
						qcom,hw-settle-time = <0xc8>;
					};

					pm8350b_usb_conn_therm {
						reg = <0x44a>;
						qcom,ratiometric;
						qcom,hw-settle-time = <0xc8>;
					};

					pm8350b_wl_chg_therm {
						reg = <0x44b>;
						qcom,ratiometric;
						qcom,hw-settle-time = <0xc8>;
					};

					pmk8350_wifi_therm {
						reg = <0x44c>;
						qcom,ratiometric;
						qcom,hw-settle-time = <0xc8>;
					};
				};

				sdam@7000 {
					compatible = "qcom,spmi-sdam";
					reg = <0x7000>;
					#address-cells = <0x01>;
					#size-cells = <0x01>;
					phandle = <0x3d>;
				};

				sdam@7100 {
					compatible = "qcom,spmi-sdam";
					reg = <0x7100>;
					#address-cells = <0x01>;
					#size-cells = <0x01>;
					phandle = <0x3e>;

					restart@48 {
						reg = <0x48 0x01>;
						bits = <0x01 0x07>;
						phandle = <0x14>;
					};

					cl_brake@7c {
						reg = <0x7c 0x01>;
						bits = <0x00 0x08>;
						phandle = <0x09>;
					};
				};

				sdam@7400 {
					compatible = "qcom,spmi-sdam";
					reg = <0x7400>;
					phandle = <0x15>;
				};

				sdam@7c00 {
					compatible = "qcom,spmi-sdam";
					reg = <0x7c00>;
					phandle = <0x0c>;
				};

				sdam@7d00 {
					compatible = "qcom,spmi-sdam";
					reg = <0x7d00>;
					phandle = <0x0d>;
				};

				sdam@8400 {
					compatible = "qcom,spmi-sdam";
					reg = <0x8400>;
					phandle = <0x04>;
				};

				sdam@8500 {
					compatible = "qcom,spmi-sdam";
					reg = <0x8500>;
					phandle = <0x05>;
				};

				sdam@8600 {
					compatible = "qcom,spmi-sdam";
					reg = <0x8600>;
					#address-cells = <0x01>;
					#size-cells = <0x01>;
					phandle = <0x3f>;
				};

				sdam@9800 {
					compatible = "qcom,spmi-sdam";
					reg = <0x9800>;
					phandle = <0x0e>;
				};

				sdam@9d00 {
					compatible = "qcom,spmi-sdam";
					reg = <0x9d00>;
					phandle = <0x0a>;
				};

				pinctrl@b000 {
					compatible = "qcom,pmk8350-gpio";
					reg = <0xb000>;
					gpio-controller;
					#gpio-cells = <0x02>;
					interrupt-controller;
					#interrupt-cells = <0x02>;
					phandle = <0x40>;
				};

				rtc@6100 {
					compatible = "qcom,pmk8350-rtc";
					reg = <0x6100 0x6200>;
					reg-names = "rtc\0alarm";
					interrupts = <0x00 0x62 0x01 0x01>;
					phandle = <0x41>;
				};
			};
		};
	};

	fragment@2 {
		target = <0xffffffff>;

		__overlay__ {
			#address-cells = <0x02>;
			#size-cells = <0x00>;
			interrupt-controller;
			#interrupt-cells = <0x04>;

			qcom,pm8350@1 {
				compatible = "qcom,spmi-pmic";
				reg = <0x01 0x00>;
				#address-cells = <0x01>;
				#size-cells = <0x00>;

				qcom,temp-alarm@a00 {
					compatible = "qcom,spmi-temp-alarm";
					reg = <0xa00>;
					interrupts = <0x01 0x0a 0x00 0x03>;
					#thermal-sensor-cells = <0x00>;
					io-channels = <0x02 0x103>;
					io-channel-names = "thermal";
					phandle = <0x03>;
				};

				pinctrl@8800 {
					compatible = "qcom,pm8350-gpio";
					reg = <0x8800>;
					gpio-controller;
					#gpio-cells = <0x02>;
					interrupt-controller;
					#interrupt-cells = <0x02>;
					phandle = <0x20>;

					pm8350_rear_tof_therm {

						pm8350_rear_tof_therm_default {
							pins = "gpio1";
							bias-high-impedance;
							phandle = <0x42>;
						};
					};

					key_vol_up {

						key_vol_up_default {
							pins = "gpio6";
							function = "normal";
							input-enable;
							bias-pull-up;
							power-source = <0x01>;
							phandle = <0x1f>;
						};
					};
				};
			};
		};
	};

	fragment@3 {
		target = <0xffffffff>;

		__overlay__ {

			pm8350_tz {
				polling-delay-passive = <0x64>;
				polling-delay = <0x00>;
				thermal-governor = "step_wise";
				thermal-sensors = <0x03>;
				phandle = <0x43>;

				trips {

					trip0 {
						temperature = <0x17318>;
						hysteresis = <0x00>;
						type = "passive";
						phandle = <0x1d>;
					};

					trip1 {
						temperature = <0x1c138>;
						hysteresis = <0x00>;
						type = "passive";
						phandle = <0x44>;
					};

					trip2 {
						temperature = <0x23668>;
						hysteresis = <0x00>;
						type = "passive";
						phandle = <0x45>;
					};
				};
			};
		};
	};

	fragment@4 {
		target = <0xffffffff>;

		__overlay__ {
			#address-cells = <0x02>;
			#size-cells = <0x00>;
			interrupt-controller;
			#interrupt-cells = <0x04>;

			qcom,pm8350c@2 {
				compatible = "qcom,spmi-pmic";
				reg = <0x02 0x00>;
				#address-cells = <0x01>;
				#size-cells = <0x00>;

				qcom,temp-alarm@a00 {
					compatible = "qcom,spmi-temp-alarm";
					reg = <0xa00>;
					interrupts = <0x02 0x0a 0x00 0x03>;
					#thermal-sensor-cells = <0x00>;
					phandle = <0x07>;
				};

				pinctrl@8800 {
					compatible = "qcom,pm8350c-gpio";
					reg = <0x8800>;
					gpio-controller;
					#gpio-cells = <0x02>;
					interrupt-controller;
					#interrupt-cells = <0x02>;
					phandle = <0x46>;

					lcd_backlight_ctrl {

						lcd_backlight_ctrl_default {
							pins = "gpio8";
							function = "func1";
							input-disable;
							output-enable;
							bias-disable;
							power-source = <0x01>;
							qcom,drive-strength = <0x02>;
							phandle = <0x47>;
						};
					};
				};

				pwms@e800 {
					compatible = "qcom,pwm-lpg";
					reg = <0xe800>;
					reg-names = "lpg-base";
					#pwm-cells = <0x02>;
					qcom,num-lpg-channels = <0x03>;
					nvmem = <0x04 0x05>;
					nvmem-names = "lpg_chan_sdam\0lut_sdam";
					qcom,lut-sdam-base = <0x45>;
					qcom,lut-patterns = <0x00 0x0a 0x14 0x1e 0x28 0x32 0x3c 0x46 0x50 0x5a 0x64 0x5a 0x50 0x46 0x3c 0x32 0x28 0x1e 0x14 0x0a 0x00>;
					qcom,tick-duration-us = <0x1f40>;
					phandle = <0x06>;

					lpg@1 {
						qcom,lpg-chan-id = <0x01>;
						qcom,ramp-step-ms = <0x64>;
						qcom,ramp-low-index = <0x00>;
						qcom,ramp-high-index = <0x13>;
						qcom,ramp-pattern-repeat;
						qcom,lpg-sdam-base = <0x48>;
					};

					lpg@2 {
						qcom,lpg-chan-id = <0x02>;
						qcom,ramp-step-ms = <0x64>;
						qcom,ramp-low-index = <0x00>;
						qcom,ramp-high-index = <0x13>;
						qcom,ramp-pattern-repeat;
						qcom,lpg-sdam-base = <0x56>;
					};

					lpg@3 {
						qcom,lpg-chan-id = <0x03>;
						qcom,ramp-step-ms = <0x64>;
						qcom,ramp-low-index = <0x00>;
						qcom,ramp-high-index = <0x13>;
						qcom,ramp-pattern-repeat;
						qcom,lpg-sdam-base = <0x64>;
					};
				};

				pwms@eb00 {
					compatible = "qcom,pwm-lpg";
					reg = <0xeb00>;
					reg-names = "lpg-base";
					#pwm-cells = <0x02>;
					qcom,num-lpg-channels = <0x01>;
					phandle = <0x48>;
				};

				qcom,leds@ef00 {
					compatible = "qcom,tri-led";
					reg = <0xef00>;
					phandle = <0x49>;

					red {
						label = "red";
						pwms = <0x06 0x00 0xf4240>;
						led-sources = <0x00>;
						linux,default-trigger = "timer";
					};

					green {
						label = "green";
						pwms = <0x06 0x01 0xf4240>;
						led-sources = <0x01>;
						linux,default-trigger = "timer";
					};

					blue {
						label = "blue";
						pwms = <0x06 0x02 0xf4240>;
						led-sources = <0x02>;
						linux,default-trigger = "timer";
					};
				};

				bcl@4700 {
					compatible = "qcom,bcl-v5";
					reg = <0x4700 0x100>;
					interrupts = <0x02 0x47 0x00 0x00 0x02 0x47 0x01 0x00 0x02 0x47 0x02 0x00>;
					interrupt-names = "bcl-lvl0\0bcl-lvl1\0bcl-lvl2";
					qcom,pmic7-threshold;
					#thermal-sensor-cells = <0x01>;
					phandle = <0x08>;
				};

				qcom,flash_led@ee00 {
					compatible = "qcom,pm8350c-flash-led";
					reg = <0xee00>;
					interrupts = <0x02 0xee 0x00 0x01 0x02 0xee 0x03 0x01 0x02 0xee 0x04 0x01>;
					interrupt-names = "led-fault-irq\0all-ramp-down-done-irq\0all-ramp-up-done-irq";
					qcom,thermal-derate-current = <0xc8 0x1f4>;
					status = "ok";
					phandle = <0x4a>;

					qcom,flash_0 {
						label = "flash";
						qcom,led-name = "led:flash_0";
						qcom,max-current-ma = <0x5dc>;
						qcom,default-led-trigger = "flash0_trigger";
						qcom,id = <0x00>;
						qcom,duration-ms = <0x500>;
						qcom,ires-ua = <0x30d4>;
						phandle = <0x4b>;
					};

					qcom,flash_1 {
						label = "flash";
						qcom,led-name = "led:flash_1";
						qcom,max-current-ma = <0x5dc>;
						qcom,default-led-trigger = "flash1_trigger";
						qcom,id = <0x01>;
						qcom,duration-ms = <0x500>;
						qcom,ires-ua = <0x30d4>;
						phandle = <0x4c>;
					};

					qcom,flash_2 {
						label = "flash";
						qcom,led-name = "led:flash_2";
						qcom,max-current-ma = <0x5dc>;
						qcom,default-led-trigger = "flash2_trigger";
						qcom,id = <0x02>;
						qcom,duration-ms = <0x500>;
						qcom,ires-ua = <0x30d4>;
						phandle = <0x4d>;
					};

					qcom,flash_3 {
						label = "flash";
						qcom,led-name = "led:flash_3";
						qcom,max-current-ma = <0x5dc>;
						qcom,default-led-trigger = "flash3_trigger";
						qcom,id = <0x03>;
						qcom,duration-ms = <0x500>;
						qcom,ires-ua = <0x30d4>;
						phandle = <0x4e>;
					};

					qcom,torch_0 {
						label = "torch";
						qcom,led-name = "led:torch_0";
						qcom,max-current-ma = <0x1f4>;
						qcom,default-led-trigger = "torch0_trigger";
						qcom,id = <0x00>;
						qcom,ires-ua = <0x30d4>;
						phandle = <0x4f>;
					};

					qcom,torch_1 {
						label = "torch";
						qcom,led-name = "led:torch_1";
						qcom,max-current-ma = <0x1f4>;
						qcom,default-led-trigger = "torch1_trigger";
						qcom,id = <0x01>;
						qcom,ires-ua = <0x30d4>;
						phandle = <0x50>;
					};

					qcom,torch_2 {
						label = "torch";
						qcom,led-name = "led:torch_2";
						qcom,max-current-ma = <0x1f4>;
						qcom,default-led-trigger = "torch2_trigger";
						qcom,id = <0x02>;
						qcom,ires-ua = <0x30d4>;
						phandle = <0x51>;
					};

					qcom,torch_3 {
						label = "torch";
						qcom,led-name = "led:torch_3";
						qcom,max-current-ma = <0x1f4>;
						qcom,default-led-trigger = "torch3_trigger";
						qcom,id = <0x03>;
						qcom,ires-ua = <0x30d4>;
						phandle = <0x52>;
					};

					qcom,led_switch_0 {
						label = "switch";
						qcom,led-name = "led:switch_0";
						qcom,default-led-trigger = "switch0_trigger";
						qcom,led-mask = <0x01>;
						qcom,symmetry-en;
						phandle = <0x53>;
					};

					qcom,led_switch_1 {
						label = "switch";
						qcom,led-name = "led:switch_1";
						qcom,default-led-trigger = "switch1_trigger";
						qcom,led-mask = <0x02>;
						qcom,symmetry-en;
						phandle = <0x54>;
					};

					qcom,led_switch_2 {
						label = "switch";
						qcom,led-name = "led:switch_2";
						qcom,default-led-trigger = "switch2_trigger";
						qcom,led-mask = <0x03>;
						qcom,symmetry-en;
						phandle = <0x55>;
					};
				};
			};
		};
	};

	fragment@5 {
		target = <0xffffffff>;

		__overlay__ {

			pm8350c_tz {
				polling-delay-passive = <0x64>;
				polling-delay = <0x00>;
				thermal-governor = "step_wise";
				thermal-sensors = <0x07>;
				phandle = <0x56>;

				trips {

					trip0 {
						temperature = <0x17318>;
						hysteresis = <0x00>;
						type = "passive";
						phandle = <0x1e>;
					};

					trip1 {
						temperature = <0x1c138>;
						hysteresis = <0x00>;
						type = "passive";
						phandle = <0x57>;
					};

					trip2 {
						temperature = <0x23668>;
						hysteresis = <0x00>;
						type = "passive";
						phandle = <0x58>;
					};
				};
			};

			pm8350c-bcl-lvl0 {
				polling-delay-passive = <0x64>;
				polling-delay = <0x00>;
				thermal-governor = "step_wise";
				thermal-sensors = <0x08 0x05>;

				trips {

					c-bcl-lvl0 {
						temperature = <0x01>;
						hysteresis = <0x01>;
						type = "passive";
						phandle = <0x19>;
					};
				};
			};

			pm8350c-bcl-lvl1 {
				polling-delay-passive = <0x64>;
				polling-delay = <0x00>;
				thermal-governor = "step_wise";
				thermal-sensors = <0x08 0x06>;

				trips {

					c-bcl-lvl1 {
						temperature = <0x01>;
						hysteresis = <0x01>;
						type = "passive";
						phandle = <0x1a>;
					};
				};
			};

			pm8350c-bcl-lvl2 {
				polling-delay-passive = <0x64>;
				polling-delay = <0x00>;
				thermal-governor = "step_wise";
				thermal-sensors = <0x08 0x07>;

				trips {

					c-bcl-lvl2 {
						temperature = <0x01>;
						hysteresis = <0x01>;
						type = "passive";
						phandle = <0x1b>;
					};
				};
			};
		};
	};

	fragment@6 {
		target = <0xffffffff>;

		__overlay__ {
			#address-cells = <0x02>;
			#size-cells = <0x00>;
			interrupt-controller;
			#interrupt-cells = <0x04>;

			qcom,pm8350b@3 {
				compatible = "qcom,spmi-pmic";
				reg = <0x03 0x00>;
				#address-cells = <0x01>;
				#size-cells = <0x00>;

				qcom,temp-alarm@a00 {
					compatible = "qcom,spmi-temp-alarm";
					reg = <0xa00>;
					interrupts = <0x03 0x0a 0x00 0x03>;
					#thermal-sensor-cells = <0x00>;
					io-channels = <0x02 0x303>;
					io-channel-names = "thermal";
					phandle = <0x0f>;
				};

				qcom,pbs@1900 {
					compatible = "qcom,qpnp-pbs";
					reg = <0x1900>;
					phandle = <0x0b>;
				};

				pinctrl@8800 {
					compatible = "qcom,pm8350b-gpio";
					reg = <0x8800>;
					gpio-controller;
					#gpio-cells = <0x02>;
					interrupt-controller;
					#interrupt-cells = <0x02>;
					phandle = <0x59>;

					pm8350b_rear_tof_therm {

						pm8350b_rear_tof_therm_default {
							pins = "gpio2";
							bias-high-impedance;
							phandle = <0x01>;
						};
					};
				};

				bcl@4700 {
					compatible = "qcom,bcl-v5";
					reg = <0x4700 0x100>;
					interrupts = <0x03 0x47 0x00 0x00 0x03 0x47 0x01 0x00 0x03 0x47 0x02 0x00>;
					interrupt-names = "bcl-lvl0\0bcl-lvl1\0bcl-lvl2";
					qcom,pmic7-threshold;
					#thermal-sensor-cells = <0x01>;
					phandle = <0x10>;
				};

				bcl-soc {
					compatible = "qcom,msm-bcl-soc";
					#thermal-sensor-cells = <0x00>;
					phandle = <0x5a>;
				};

				qcom,hv-haptics@f000 {
					compatible = "qcom,hv-haptics";
					reg = <0xf000 0xf100 0xf200>;
					interrupts = <0x03 0xf0 0x01 0x01>;
					interrupt-names = "fifo-empty";
					qcom,vmax-mv = <0xa8c>;
					qcom,brake-mode = <0x01>;
					qcom,brake-pattern = [ff 3f 1f];
					qcom,lra-period-us = <0x13ee>;
					qcom,drv-sig-shape = <0x01>;
					qcom,brake-sig-shape = <0x01>;
					status = "ok";
					nvmem-cell-names = "hap_cl_brake";
					nvmem-cells = <0x09>;
					nvmem-names = "hap_cfg_sdam";
					nvmem = <0x0a>;
					qcom,pbs-client = <0x0b>;
					phandle = <0x5b>;

					qcom,hap-swr-slave-reg {
						regulator-name = "hap-swr-slave-reg";
						phandle = <0x5c>;
					};

					effect_0 {
						qcom,effect-id = <0x00>;
						qcom,wf-vmax-mv = <0xe10>;
						qcom,wf-pattern-data = <0x1f 0x00 0x00 0x3f 0x00 0x00 0x5f 0x00 0x00 0x7f 0x00 0x00 0x17f 0x00 0x00 0x15f 0x00 0x00 0x13f 0x00 0x00 0x11f 0x00 0x00>;
						qcom,wf-pattern-period-us = <0x1a0b>;
						qcom,wf-brake-pattern = [00 00 00];
						qcom,wf-pattern-preload;
						qcom,wf-auto-res-disable;
					};

					effect_1 {
						qcom,effect-id = <0x01>;
						qcom,wf-vmax-mv = <0xe10>;
						qcom,wf-pattern-data = <0x1f 0x00 0x00 0x3f 0x00 0x00 0x5f 0x00 0x00 0x7f 0x00 0x00 0x17f 0x00 0x00 0x15f 0x00 0x00 0x13f 0x00 0x00 0x11f 0x00 0x00>;
						qcom,wf-pattern-period-us = <0x1a0b>;
						qcom,wf-brake-pattern = [00 00 00];
						qcom,wf-auto-res-disable;
					};

					effect_2 {
						qcom,effect-id = <0x02>;
						qcom,wf-vmax-mv = <0xe10>;
						qcom,wf-pattern-data = <0x1f 0x00 0x00 0x3f 0x00 0x00 0x5f 0x00 0x00 0x7f 0x00 0x00 0x17f 0x00 0x00 0x15f 0x00 0x00 0x13f 0x00 0x00 0x11f 0x00 0x00>;
						qcom,wf-pattern-period-us = <0x1a0b>;
						qcom,wf-brake-pattern = [00 00 00];
						qcom,wf-auto-res-disable;
					};

					effect_3 {
						qcom,effect-id = <0x03>;
						qcom,wf-vmax-mv = <0xe10>;
						qcom,wf-pattern-data = <0x1f 0x00 0x00 0x3f 0x00 0x00 0x5f 0x00 0x00 0x7f 0x00 0x00 0x17f 0x00 0x00 0x15f 0x00 0x00 0x13f 0x00 0x00 0x11f 0x00 0x00>;
						qcom,wf-pattern-period-us = <0x1a0b>;
						qcom,wf-brake-pattern = [00 00 00];
						qcom,wf-auto-res-disable;
					};

					effect_4 {
						qcom,effect-id = <0x04>;
						qcom,wf-vmax-mv = <0xe10>;
						qcom,wf-pattern-data = <0x1f 0x00 0x00 0x3f 0x00 0x00 0x5f 0x00 0x00 0x7f 0x00 0x00 0x17f 0x00 0x00 0x15f 0x00 0x00 0x13f 0x00 0x00 0x11f 0x00 0x00>;
						qcom,wf-pattern-period-us = <0x1a0b>;
						qcom,wf-brake-pattern = [00 00 00];
						qcom,wf-auto-res-disable;
					};

					effect_5 {
						qcom,effect-id = <0x05>;
						qcom,wf-vmax-mv = <0xe10>;
						qcom,wf-pattern-data = <0x1f 0x00 0x00 0x3f 0x00 0x00 0x5f 0x00 0x00 0x7f 0x00 0x00 0x17f 0x00 0x00 0x15f 0x00 0x00 0x13f 0x00 0x00 0x11f 0x00 0x00>;
						qcom,wf-pattern-period-us = <0x1a0b>;
						qcom,wf-brake-pattern = [00 00 00];
						qcom,wf-auto-res-disable;
					};
				};

				qcom,amoled {
					compatible = "qcom,qpnp-amoled-regulator";
					#address-cells = <0x01>;
					#size-cells = <0x00>;
					phandle = <0x5d>;

					oledb@fa00 {
						reg = <0xfa00>;
						reg-names = "oledb_base";
						regulator-name = "oledb";
						regulator-min-microvolt = <0x4c4b40>;
						regulator-max-microvolt = <0x7a1200>;
						qcom,swire-control;
						phandle = <0x5e>;
					};

					ab@f900 {
						reg = <0xf900>;
						reg-names = "ab_base";
						regulator-name = "ab";
						regulator-min-microvolt = <0x4630c0>;
						regulator-max-microvolt = <0x4f5880>;
						qcom,swire-control;
						phandle = <0x5f>;
					};

					ibb@f800 {
						reg = <0xf800>;
						reg-names = "ibb_base";
						regulator-name = "ibb";
						regulator-min-microvolt = <0x155cc0>;
						regulator-max-microvolt = <0x64b540>;
						qcom,swire-control;
						regulator-allow-set-load;
						phandle = <0x60>;
					};
				};

				qcom,amoled-ecm@f900 {
					compatible = "qcom,amoled-ecm";
					reg = <0xf900>;
					nvmem-names = "amoled-ecm-sdam0\0amoled-ecm-sdam1\0amoled-ecm-sdam2";
					nvmem = <0x0c 0x0d 0x0e>;
					interrupt-names = "ecm-sdam0\0ecm-sdam1\0ecm-sdam2";
					interrupts = <0x00 0x7c 0x01 0x01 0x00 0x7d 0x01 0x01 0x00 0x98 0x01 0x01>;
				};
			};
		};
	};

	fragment@7 {
		target = <0xffffffff>;

		__overlay__ {

			pm8350b_tz {
				polling-delay-passive = <0x64>;
				polling-delay = <0x00>;
				thermal-sensors = <0x0f>;
				phandle = <0x61>;

				trips {

					trip0 {
						temperature = <0x15f90>;
						hysteresis = <0x00>;
						type = "passive";
						phandle = <0x62>;
					};

					trip1 {
						temperature = <0x1c138>;
						hysteresis = <0x00>;
						type = "passive";
						phandle = <0x63>;
					};

					trip2 {
						temperature = <0x23668>;
						hysteresis = <0x00>;
						type = "passive";
						phandle = <0x64>;
					};
				};
			};

			pm8350b-ibat-lvl0 {
				polling-delay-passive = <0x00>;
				polling-delay = <0x00>;
				thermal-sensors = <0x10 0x00>;

				trips {

					ibat-lvl0 {
						temperature = <0x2328>;
						hysteresis = <0xc8>;
						type = "passive";
						phandle = <0x65>;
					};
				};
			};

			pm8350b-ibat-lvl1 {
				polling-delay-passive = <0x00>;
				polling-delay = <0x00>;
				thermal-sensors = <0x10 0x01>;

				trips {

					ibat-lvl1 {
						temperature = <0x2710>;
						hysteresis = <0xc8>;
						type = "passive";
						phandle = <0x66>;
					};
				};
			};

			pm8350b-bcl-lvl0 {
				polling-delay-passive = <0x64>;
				polling-delay = <0x00>;
				thermal-sensors = <0x10 0x05>;

				trips {

					thermal-engine-trip {
						temperature = <0x64>;
						hysteresis = <0x00>;
						type = "passive";
					};

					thermal-hal-trip {
						temperature = <0x64>;
						hysteresis = <0x00>;
						type = "passive";
					};

					b-bcl-lvl0 {
						temperature = <0x01>;
						hysteresis = <0x01>;
						type = "passive";
						phandle = <0x16>;
					};
				};
			};

			pm8350b-bcl-lvl1 {
				polling-delay-passive = <0x64>;
				polling-delay = <0x00>;
				thermal-sensors = <0x10 0x06>;

				trips {

					thermal-engine-trip {
						temperature = <0x64>;
						hysteresis = <0x00>;
						type = "passive";
					};

					thermal-hal-trip {
						temperature = <0x64>;
						hysteresis = <0x00>;
						type = "passive";
					};

					b-bcl-lvl1 {
						temperature = <0x01>;
						hysteresis = <0x01>;
						type = "passive";
						phandle = <0x17>;
					};
				};
			};

			pm8350b-bcl-lvl2 {
				polling-delay-passive = <0x64>;
				polling-delay = <0x00>;
				thermal-sensors = <0x10 0x07>;

				trips {

					thermal-engine-trip {
						temperature = <0x64>;
						hysteresis = <0x00>;
						type = "passive";
					};

					thermal-hal-trip {
						temperature = <0x64>;
						hysteresis = <0x00>;
						type = "passive";
					};

					b-bcl-lvl2 {
						temperature = <0x01>;
						hysteresis = <0x01>;
						type = "passive";
						phandle = <0x18>;
					};
				};
			};

			socd {
				polling-delay-passive = <0x64>;
				polling-delay = <0x00>;

				trips {

					thermal-engine-trip {
						temperature = <0x64>;
						hysteresis = <0x00>;
						type = "passive";
					};

					thermal-hal-trip {
						temperature = <0x64>;
						hysteresis = <0x00>;
						type = "passive";
					};

					socd-trip {
						temperature = <0x64>;
						hysteresis = <0x00>;
						type = "passive";
						phandle = <0x67>;
					};
				};
			};
		};
	};

	fragment@8 {
		target = <0xffffffff>;

		__overlay__ {
			#address-cells = <0x02>;
			#size-cells = <0x00>;
			interrupt-controller;
			#interrupt-cells = <0x04>;

			qcom,pmr735a@4 {
				compatible = "qcom,spmi-pmic";
				reg = <0x04 0x00>;
				#address-cells = <0x01>;
				#size-cells = <0x00>;
				phandle = <0x68>;

				qcom,temp-alarm@a00 {
					compatible = "qcom,spmi-temp-alarm";
					reg = <0xa00>;
					interrupts = <0x04 0x0a 0x00 0x03>;
					#thermal-sensor-cells = <0x00>;
					phandle = <0x11>;
				};

				pinctrl@8800 {
					compatible = "qcom,pmr735a-gpio";
					reg = <0x8800>;
					gpio-controller;
					#gpio-cells = <0x02>;
					interrupt-controller;
					#interrupt-cells = <0x02>;
					phandle = <0x69>;
				};
			};
		};
	};

	fragment@9 {
		target = <0xffffffff>;

		__overlay__ {

			pmr735a_tz {
				polling-delay-passive = <0x64>;
				polling-delay = <0x00>;
				thermal-governor = "step_wise";
				thermal-sensors = <0x11>;
				phandle = <0x6a>;

				trips {

					trip0 {
						temperature = <0x17318>;
						hysteresis = <0x00>;
						type = "passive";
						phandle = <0x6b>;
					};

					trip1 {
						temperature = <0x1c138>;
						hysteresis = <0x00>;
						type = "passive";
						phandle = <0x6c>;
					};

					trip2 {
						temperature = <0x23668>;
						hysteresis = <0x00>;
						type = "passive";
						phandle = <0x6d>;
					};
				};
			};
		};
	};

	fragment@10 {
		target = <0xffffffff>;

		__overlay__ {
			#address-cells = <0x02>;
			#size-cells = <0x00>;
			interrupt-controller;
			#interrupt-cells = <0x04>;

			qcom,pmr735b@5 {
				compatible = "qcom,spmi-pmic";
				reg = <0x05 0x00>;
				#address-cells = <0x01>;
				#size-cells = <0x00>;

				qcom,temp-alarm@a00 {
					compatible = "qcom,spmi-temp-alarm";
					reg = <0xa00>;
					interrupts = <0x05 0x0a 0x00 0x03>;
					#thermal-sensor-cells = <0x00>;
					phandle = <0x12>;
				};

				pinctrl@8800 {
					compatible = "qcom,pmr735b-gpio";
					reg = <0x8800>;
					gpio-controller;
					#gpio-cells = <0x02>;
					interrupt-controller;
					#interrupt-cells = <0x02>;
					phandle = <0x6e>;
				};
			};
		};
	};

	fragment@11 {
		target = <0xffffffff>;

		__overlay__ {

			pmr735b_tz {
				polling-delay-passive = <0x64>;
				polling-delay = <0x00>;
				thermal-governor = "step_wise";
				thermal-sensors = <0x12>;
				phandle = <0x6f>;

				trips {

					trip0 {
						temperature = <0x17318>;
						hysteresis = <0x00>;
						type = "passive";
						phandle = <0x70>;
					};

					trip1 {
						temperature = <0x1c138>;
						hysteresis = <0x00>;
						type = "passive";
						phandle = <0x71>;
					};

					trip2 {
						temperature = <0x23668>;
						hysteresis = <0x00>;
						type = "passive";
						phandle = <0x72>;
					};
				};
			};
		};
	};

	fragment@12 {
		target = <0xffffffff>;

		__overlay__ {
			#address-cells = <0x02>;
			#size-cells = <0x00>;
			interrupt-controller;
			#interrupt-cells = <0x04>;

			qcom,pm8450@7 {
				compatible = "qcom,spmi-pmic";
				reg = <0x07 0x00>;
				#address-cells = <0x01>;
				#size-cells = <0x00>;

				qcom,temp-alarm@a00 {
					compatible = "qcom,spmi-temp-alarm";
					reg = <0xa00>;
					interrupts = <0x07 0x0a 0x00 0x03>;
					#thermal-sensor-cells = <0x00>;
					phandle = <0x13>;
				};

				pinctrl@8800 {
					compatible = "qcom,pm8450-gpio";
					reg = <0x8800>;
					gpio-controller;
					#gpio-cells = <0x02>;
					interrupt-controller;
					#interrupt-cells = <0x02>;
					phandle = <0x73>;
				};
			};
		};
	};

	fragment@13 {
		target = <0xffffffff>;

		__overlay__ {

			pm8450_tz {
				polling-delay-passive = <0x64>;
				polling-delay = <0x00>;
				thermal-governor = "step_wise";
				thermal-sensors = <0x13>;
				phandle = <0x74>;

				trips {

					trip0 {
						temperature = <0x17318>;
						hysteresis = <0x00>;
						type = "passive";
						phandle = <0x1c>;
					};

					trip1 {
						temperature = <0x1c138>;
						hysteresis = <0x00>;
						type = "passive";
						phandle = <0x75>;
					};

					trip2 {
						temperature = <0x23668>;
						hysteresis = <0x00>;
						type = "passive";
						phandle = <0x76>;
					};
				};
			};
		};
	};

	fragment@14 {
		target = <0xffffffff>;

		__overlay__ {

			reboot_reason {
				compatible = "qcom,reboot-reason";
				nvmem-cells = <0x14>;
				nvmem-cell-names = "restart_reason";
			};

			pmic-pon-log {
				compatible = "qcom,pmic-pon-log";
				nvmem = <0x15>;
				nvmem-names = "pon_log";
			};
		};
	};

	fragment@15 {
		target = <0xffffffff>;

		__overlay__ {

			pm8350b-bcl-lvl0 {

				cooling-maps {

					vbat_lte0 {
						trip = <0x16>;
						cooling-device = <0xffffffff 0x08 0x08>;
					};

					vbat_nr0_scg {
						trip = <0x16>;
						cooling-device = <0xffffffff 0x03 0x03>;
					};

					vbat_nr0 {
						trip = <0x16>;
						cooling-device = <0xffffffff 0x06 0x06>;
					};

					vbat_cdsp0 {
						trip = <0x16>;
						cooling-device = <0xffffffff 0x02 0x02>;
					};

					vbat_cpu_5 {
						trip = <0x16>;
						cooling-device = <0xffffffff 0x01 0x01>;
					};

					vbat_gpu0 {
						trip = <0x16>;
						cooling-device = <0xffffffff 0x02 0x02>;
					};
				};
			};

			pm8350b-bcl-lvl1 {

				cooling-maps {

					vbat_lte1 {
						trip = <0x17>;
						cooling-device = <0xffffffff 0x0a 0x0a>;
					};

					vbat_nr1_scg {
						trip = <0x17>;
						cooling-device = <0xffffffff 0x0a 0x0a>;
					};

					vbat_nr1 {
						trip = <0x17>;
						cooling-device = <0xffffffff 0x09 0x09>;
					};

					vbat_cdsp1 {
						trip = <0x17>;
						cooling-device = <0xffffffff 0x04 0x04>;
					};

					vbat_cpu_6_7 {
						trip = <0x17>;
						cooling-device = <0xffffffff 0x01 0x01>;
					};

					vbat_gpu1 {
						trip = <0x17>;
						cooling-device = <0xffffffff 0x04 0x04>;
					};
				};
			};

			pm8350b-bcl-lvl2 {

				cooling-maps {

					vbat_cdsp2 {
						trip = <0x18>;
						cooling-device = <0xffffffff 0x05 0xffffffff>;
					};

					vbat_gpu2 {
						trip = <0x18>;
						cooling-device = <0xffffffff 0x07 0xffffffff>;
					};
				};
			};

			pm8350c-bcl-lvl0 {

				cooling-maps {

					vph_lte0 {
						trip = <0x19>;
						cooling-device = <0xffffffff 0x08 0x08>;
					};

					vph_nr0_scg {
						trip = <0x19>;
						cooling-device = <0xffffffff 0x03 0x03>;
					};

					vph_nr0 {
						trip = <0x19>;
						cooling-device = <0xffffffff 0x06 0x06>;
					};

					vph_cdsp0 {
						trip = <0x19>;
						cooling-device = <0xffffffff 0x02 0x02>;
					};

					vph_cpu_5 {
						trip = <0x19>;
						cooling-device = <0xffffffff 0x01 0x01>;
					};

					vph_gpu0 {
						trip = <0x19>;
						cooling-device = <0xffffffff 0x02 0x02>;
					};
				};
			};

			pm8350c-bcl-lvl1 {

				cooling-maps {

					vph_lte1 {
						trip = <0x1a>;
						cooling-device = <0xffffffff 0x0a 0x0a>;
					};

					vph_nr1_scg {
						trip = <0x1a>;
						cooling-device = <0xffffffff 0x0a 0x0a>;
					};

					vph_nr1 {
						trip = <0x1a>;
						cooling-device = <0xffffffff 0x09 0x09>;
					};

					vph_cdsp1 {
						trip = <0x1a>;
						cooling-device = <0xffffffff 0x04 0x04>;
					};

					vph_cpu_6_7 {
						trip = <0x1a>;
						cooling-device = <0xffffffff 0x01 0x01>;
					};

					vph_gpu1 {
						trip = <0x1a>;
						cooling-device = <0xffffffff 0x04 0x04>;
					};
				};
			};

			pm8350c-bcl-lvl2 {

				cooling-maps {

					vph_cdsp2 {
						trip = <0x1b>;
						cooling-device = <0xffffffff 0x05 0xffffffff>;
					};

					vph_gpu2 {
						trip = <0x1b>;
						cooling-device = <0xffffffff 0x07 0xffffffff>;
					};
				};
			};

			pm8450_tz {

				cooling-maps {

					pm8450_cpu4_freq {
						trip = <0x1c>;
						cooling-device = <0xffffffff 0x0f 0xffffffff>;
					};

					pm8450_cpu7_freq {
						trip = <0x1c>;
						cooling-device = <0xffffffff 0x0f 0xffffffff>;
					};

					pm8450_apc1 {
						trip = <0x1c>;
						cooling-device = <0xffffffff 0x01 0x01>;
					};
				};
			};

			pm8350_tz {

				cooling-maps {

					pm8350_gpu {
						trip = <0x1d>;
						cooling-device = <0xffffffff 0x07 0xffffffff>;
					};

					pm8350_cpu4_freq {
						trip = <0x1d>;
						cooling-device = <0xffffffff 0x0f 0xffffffff>;
					};

					pm8350_cpu7_freq {
						trip = <0x1d>;
						cooling-device = <0xffffffff 0x0f 0xffffffff>;
					};

					pm8350_apc1 {
						trip = <0x1d>;
						cooling-device = <0xffffffff 0x01 0x01>;
					};
				};
			};

			pm8350c_tz {

				cooling-maps {

					pm8350c_nsp {
						trip = <0x1e>;
						cooling-device = <0xffffffff 0x05 0xffffffff>;
					};

					pm8350c_lte {
						trip = <0x1e>;
						cooling-device = <0xffffffff 0xff 0xff>;
					};

					pm8350c_nr {
						trip = <0x1e>;
						cooling-device = <0xffffffff 0xff 0xff>;
					};
				};
			};
		};
	};

	fragment@16 {
		target = <0xffffffff>;

		__overlay__ {
			compatible = "qcom,ufs-phy-qmp-v4-waipio";
			vdda-phy-supply = <0xffffffff>;
			vdda-pll-supply = <0xffffffff>;
			vdda-phy-max-microamp = <0x2a3c8>;
			vdda-pll-max-microamp = <0x6144>;
			status = "ok";
		};
	};

	fragment@17 {
		target = <0xffffffff>;

		__overlay__ {
			vdd-hba-supply = <0xffffffff>;
			vcc-supply = <0xffffffff>;
			vcc-max-microamp = <0x10c8e0>;
			vccq-supply = <0xffffffff>;
			vccq-max-microamp = <0x124f80>;
			qcom,vddp-ref-clk-supply = <0xffffffff>;
			qcom,vddp-ref-clk-max-microamp = <0x64>;
			qcom,vccq-parent-supply = <0xffffffff>;
			qcom,vccq-parent-max-microamp = <0x33450>;
			status = "ok";
		};
	};

	fragment@18 {
		target = <0xffffffff>;

		__overlay__ {
			status = "disabled";
			vdd-supply = <0xffffffff>;
			qcom,vdd-voltage-level = <0x2d2a80 0x2d2a80>;
			qcom,vdd-current-level = <0x00 0xc3500>;
			vdd-io-supply = <0xffffffff>;
			qcom,vdd-io-voltage-level = <0x1b7740 0x2d2a80>;
			qcom,vdd-io-current-level = <0x00 0x55f0>;
			pinctrl-names = "default\0sleep";
			pinctrl-0 = <0xffffffff>;
			pinctrl-1 = <0xffffffff>;
			cd-gpios = <0xffffffff 0x5c 0x01>;
		};
	};

	fragment@19 {
		target = <0xffffffff>;

		__overlay__ {

			gpio_keys {
				compatible = "gpio-keys";
				label = "gpio-keys";
				pinctrl-names = "default";
				pinctrl-0 = <0x1f>;

				vol_up {
					label = "volume_up";
					gpios = <0x20 0x06 0x01>;
					linux,input-type = <0x01>;
					linux,code = <0x73>;
					gpio-key,wakeup;
					debounce-interval = <0x20>;
					linux,can-disable;
				};
			};

			mtdoops_pmsg@0xa7000000 {
				compatible = "mtdoops_pmsg";
				reg = <0xa7000000 0x400000>;
				console-size = <0x200000>;
				pmsg-size = <0x200000>;
			};

			hardwareinfo {
				compatible = "xiaomi,hardware-info";
				status = "ok";
			};
		};
	};

	fragment@20 {
		target = <0xffffffff>;

		__overlay__ {
			status = "ok";

			ir-spi@0 {
				compatible = "ir-spi";
				reg = <0x00>;
				spi-max-frequency = <0x124f800>;
				status = "ok";
			};
		};
	};

	fragment@21 {
		target = <0xffffffff>;

		__overlay__ {
			qcom,thermal-mitigation = <0x2dc6c0 0x16e360 0xf4240 0x7a120>;
			qcom,wireless-fw-name = "idt9415.bin";
		};
	};

	fragment@22 {
		target = <0xffffffff>;

		__overlay__ {
			status = "ok";
			qcom,clk-freq-out = <0xf4240>;
			#address-cells = <0x01>;
			#size-cells = <0x00>;

			nq@28 {
				compatible = "qcom,sn-nci";
				reg = <0x28>;
				qcom,sn-irq = <0xffffffff 0x2e 0x00>;
				qcom,sn-ven = <0xffffffff 0x22 0x00>;
				qcom,sn-firm = <0xffffffff 0x2d 0x00>;
				qcom,sn-clkreq = <0xffffffff 0x23 0x00>;
				qcom,sn-vdd-1p8-supply = <0xffffffff>;
				qcom,sn-vdd-1p8-voltage = <0x1b7740 0x1b7740>;
				qcom,sn-vdd-1p8-current = <0x26548>;
				interrupt-parent = <0xffffffff>;
				interrupts = <0x2e 0x00>;
				interrupt-names = "nfc_irq";
				pinctrl-names = "nfc_active\0nfc_suspend";
				pinctrl-0 = <0xffffffff 0xffffffff>;
				pinctrl-1 = <0xffffffff 0xffffffff>;
			};
		};
	};

	fragment@23 {
		target = <0xffffffff>;

		__overlay__ {
			usb-role-switch;

			dwc3@a600000 {
				usb-role-switch;
				dr_mode = "otg";
			};

			port {

				endpoint {
					remote-endpoint = <0x21>;
					phandle = <0x22>;
				};
			};

			synaptics_tcm@20 {
				compatible = "synaptics,tcm-i2c";
				reg = <0x20>;
				interrupt-parent = <0xffffffff>;
				interrupts = <0x15 0x2008>;
				pinctrl-names = "pmx_ts_active\0pmx_ts_suspend\0pmx_ts_release";
				pinctrl-0 = <0xffffffff>;
				pinctrl-1 = <0xffffffff 0xffffffff>;
				pinctrl-2 = <0xffffffff>;
				vdd-supply = <0xffffffff>;
				avdd-supply = <0xffffffff>;
				synaptics,pwr-reg-name = "avdd";
				synaptics,bus-reg-name = "vdd";
				synaptics,irq-gpio = <0xffffffff 0x15 0x2008>;
				synaptics,irq-on-state = <0x00>;
				synaptics,reset-gpio = <0xffffffff 0x14 0x00>;
				synaptics,reset-on-state = <0x00>;
				synaptics,reset-active-ms = <0x14>;
				synaptics,reset-delay-ms = <0xc8>;
				synaptics,power-delay-ms = <0xc8>;
				synaptics,ubl-i2c-addr = <0x20>;
				synaptics,extend_report;
				synaptics,firmware-name = "synaptics_firmware.img";
			};
		};
	};

	fragment@24 {
		target = <0xffffffff>;

		__overlay__ {

			connector {

				port {

					endpoint {
						remote-endpoint = <0x22>;
						phandle = <0x21>;
					};
				};
			};
		};
	};

	fragment@25 {
		target = <0xffffffff>;

		__overlay__ {
			#address-cells = <0x02>;
			#size-cells = <0x02>;
			ranges;

			ramoops@0xa7000000 {
				compatible = "ramoops";
				reg = <0x00 0xa7000000 0x00 0x400000>;
				console-size = <0x200000>;
				pmsg-size = <0x200000>;
			};
		};
	};

	fragment@26 {
		target = <0xffffffff>;

		__overlay__ {

			aw8697_gpio_reset {
				phandle = <0x33>;

				mux {
					pins = "gpio89";
					unction = "gpio";
				};

				config {
					pins = "gpio89";
					drive-strength = <0x02>;
					bias-disable;
					output-low;
				};
			};

			aw8697_gpio_reset_output_high {
				phandle = <0x34>;

				mux {
					pins = "gpio89";
					function = "gpio";
				};

				config {
					pins = "gpio89";
					drive-strength = <0x02>;
					bias-disable;
					output-high;
				};
			};

			aw8697_gpio_int {
				phandle = <0x35>;

				mux {
					pins = "gpio90";
					function = "gpio";
				};

				config {
					pins = "gpio90";
					drive-strength = <0x02>;
					bias-pull-up;
					input-enable;
				};
			};

			rcv_gpio_high {
				phandle = <0x27>;

				mux {
					pins = "gpio52";
					function = "gpio";
				};

				config {
					pins = "gpio52";
					drive-strength = <0x02>;
					bias-pull-up;
					output-high;
				};
			};

			rcv_gpio_low {
				phandle = <0x28>;

				mux {
					pins = "gpio52";
					function = "gpio";
				};

				config {
					pins = "gpio52";
					drive-strength = <0x02>;
					bias-disable;
					output-low;
				};
			};
		};
	};

	fragment@27 {
		target = <0xffffffff>;

		__overlay__ {
			status = "ok";

			cs35l41@42 {
				status = "ok";
				compatible = "cirrus,cs35l41";
				reset-gpios = <0xffffffff 0x09 0x00>;
				reg = <0x42>;
				interrupt-parent = <0xffffffff>;
				interrupts = <0x3f 0x2008>;
				pinctrl-names = "default";
				pinctrl-0 = <0x23 0x24>;
				cirrus,temp-warn_threshold = <0x03>;
				cirrus,boost-peak-milliamp = <0xfa0>;
				cirrus,boost-ind-nanohenry = <0x3e8>;
				cirrus,boost-cap-microfarad = <0x0f>;
				cirrus,asp-sdout-hiz = <0x03>;
				cirrus,right-channel-amp;
				sound-name-prefix = "B";
				cirrus,fast-switch = "B-music.txt\0B-handfree.txt";
				phandle = <0x77>;

				cirrus,gpio-config2 {
					cirrus,gpio-src-select = <0x04>;
					cirrus,gpio-output-enable;
				};
			};

			cs35l41@43 {
				status = "ok";
				compatible = "cirrus,cs35l41";
				reset-gpios = <0xffffffff 0x42 0x00>;
				spk-sw-gpios = <0xffffffff 0x34 0x00>;
				reg = <0x43>;
				interrupt-parent = <0xffffffff>;
				interrupts = <0x58 0x2008>;
				pinctrl-names = "default\0rcv_gpio_high\0rcv_gpio_low";
				pinctrl-0 = <0x25 0x26>;
				pinctrl-1 = <0x27>;
				pinctrl-2 = <0x28>;
				cirrus,temp-warn_threshold = <0x03>;
				cirrus,boost-peak-milliamp = <0xfa0>;
				cirrus,boost-ind-nanohenry = <0x3e8>;
				cirrus,boost-cap-microfarad = <0x0f>;
				cirrus,asp-sdout-hiz = <0x03>;
				sound-name-prefix = "T";
				cirrus,fast-switch = "T-music.txt\0T-handset.txt\0T-handfree.txt";
				phandle = <0x78>;

				cirrus,gpio-config2 {
					cirrus,gpio-src-select = <0x04>;
					cirrus,gpio-output-enable;
				};
			};
		};
	};

	fragment@28 {
		target = <0xffffffff>;

		__overlay__ {

			xiaomi_touch {
				compatible = "xiaomi-touch";
				status = "ok";
				touch,name = "xiaomi-touch";
			};

			fingerprint_goodix {
				compatible = "goodix,fingerprint";
				l11c_vdd-supply = <0xffffffff>;
				goodix,gpio-reset = <0xffffffff 0x29 0x00>;
				goodix,gpio-irq = <0xffffffff 0x28 0x00>;
				status = "ok";
			};

			md_testing_mode {
				compatible = "modem,md-testing-mode";
				status-gpio = <0xffffffff 0x53 0x00 0xffffffff 0x9f 0x00>;
				debounce-time = <0x1e>;
				pinctrl-names = "default";
				pinctrl-0 = <0x29 0x2a>;
			};

			gpio_keys {

				hall_key {
					label = "hall_key";
					gpios = <0xffffffff 0xb6 0x01>;
					linux,input-type = <0x05>;
					linux,code = <0x00>;
					gpio-key,wakeup;
					debounce-interval = <0x0f>;
				};
			};
		};
	};

	fragment@29 {
		target = <0xffffffff>;

		__overlay__ {
			regulator-boot-on;
			regulator-always-on;
			regulator-min-microvolt = <0x2de600>;
			regulator-max-microvolt = <0x2de600>;
			qcom,init-voltage = <0x2de600>;
		};
	};

	fragment@30 {
		target = <0xffffffff>;

		__overlay__ {
			qcom,param-override-seq = <0xe7 0x6c 0x0c 0x70 0x04 0x74>;
		};
	};

	fragment@31 {
		target = <0xffffffff>;

		__overlay__ {

			mi_ts_active {
				phandle = <0x32>;

				mux {
					pins = "gpio21\0gpio20";
					function = "gpio";
				};

				config {
					pins = "gpio21\0gpio20";
					drive-strength = <0x08>;
					bias-pull-up;
				};
			};
		};
	};

	fragment@32 {
		target = <0xffffffff>;

		__overlay__ {
			regulator-max-microvolt = <0x326a40>;
			qcom,init-voltage = <0x326a40>;
		};
	};

	fragment@33 {
		target = <0xffffffff>;

		__overlay__ {
			status = "ok";

			stmvl53l5@0 {
				compatible = "st,stmvl53l5";
				reg = <0x00>;
				_1P8_power-supply = <0xffffffff>;
				_3P0_power-supply = <0xffffffff>;
				spi-max-frequency = <0x7a1200>;
				stm,firmware_name = "stmvl53l5.bin";
				status = "ok";
			};
		};
	};

	fragment@34 {
		target = <0xffffffff>;

		__overlay__ {
			regulator-min-microvolt = <0x325aa0>;
			regulator-max-microvolt = <0x325aa0>;
			qcom,init-voltage = <0x325aa0>;
		};
	};

	fragment@35 {
		target = <0xffffffff>;

		__overlay__ {
			regulator-min-microvolt = <0x1b7740>;
			regulator-max-microvolt = <0x1b7740>;
		};
	};

	fragment@36 {
		target = <0xffffffff>;

		__overlay__ {
			regulator-min-microvolt = <0x124f80>;
			regulator-max-microvolt = <0x124f80>;
		};
	};

	fragment@37 {
		target = <0xffffffff>;

		__overlay__ {

			ispv3_vdd1_ldo {
				compatible = "regulator-fixed";
				regulator-name = "ispv3_vdd1_ldo";
				regulator-min-microvolt = "\0\f5";
				regulator-max-microvolt = "\0\f5";
				regulator-enable-ramp-delay = <0x64>;
				enable-active-high;
				gpio = <0xffffffff 0x7d 0x00>;
				vin-supply = <0xffffffff>;
				phandle = <0x2c>;
			};

			ispv3_vdd2_ldo {
				compatible = "regulator-fixed";
				regulator-name = "ispv3_vdd2_ldo";
				regulator-min-microvolt = "\0\f5";
				regulator-max-microvolt = "\0\f5";
				regulator-enable-ramp-delay = <0x64>;
				enable-active-high;
				gpio = <0xffffffff 0x54 0x00>;
				vin-supply = <0xffffffff>;
				phandle = <0x2d>;
			};

			ispv3_vddr_ldo {
				compatible = "regulator-fixed";
				regulator-name = "ispv3_vddr_ldo";
				regulator-min-microvolt = "\0\f5";
				regulator-max-microvolt = "\0\f5";
				regulator-enable-ramp-delay = <0x64>;
				enable-active-high;
				gpio = <0xffffffff 0x5d 0x00>;
				vin-supply = <0xffffffff>;
				phandle = <0x2f>;
			};
		};
	};

	fragment@38 {
		target = <0xffffffff>;

		__overlay__ {
			status = "ok";
		};
	};

	fragment@39 {
		target = <0xffffffff>;

		__overlay__ {
			#address-cells = <0x05>;
			#size-cells = <0x00>;

			ispv3_pci {
				reg = <0x00 0x00 0x00 0x00 0x00>;
				qcom,iommu-group = <0x2b>;
				#address-cells = <0x01>;
				#size-cells = <0x01>;
				phandle = <0x79>;

				ispv3_pci_iommu_group {
					qcom,iommu-msi-size = <0x1000>;
					qcom,iommu-dma-addr-pool = <0x60000000 0xa0000000>;
					qcom,iommu-dma = "fastmap";
					qcom,iommu-pagetable = "coherent";
					qcom,iommu-faults = "stall-disable\0HUPCF\0no-CFRE\0non-fatal";
					phandle = <0x2b>;
				};
			};
		};
	};

	fragment@40 {
		target = <0xffffffff>;

		__overlay__ {
			status = "ok";

			ispv3_i2c@60 {
				compatible = "fcs,fan53526";
				reg = <0x60>;
				fcs,suspend-voltage-selector = <0x01>;
				regulator-name = "ispv3_vdd_08";
				regulator-min-microvolt = <0x927c0>;
				regulator-max-microvolt = <0x12c4b0>;
				regulator-ramp-delay = <0x3e8>;
				regulator-always-on;
				regulator-boot-on;
				status = "ok";
				phandle = <0x7a>;
			};
		};
	};

	fragment@41 {
		target = <0xffffffff>;

		__overlay__ {
			status = "ok";

			ispv3_spi@0 {
				compatible = "xiaomi,ispv3_spi";
				reg = <0x00>;
				qcom,ispv3-rc-index = <0x01>;
				spi-max-frequency = <0x2faf080>;
				ispv3_gpio_14 = <0xffffffff 0xaf 0x00>;
				ispv3_gpio_15 = <0xffffffff 0xb0 0x00>;
				ispv3_gpio_int0 = <0xffffffff 0xb1 0x00>;
				ispv3_gpio_int1 = <0xffffffff 0x76 0x00>;
				ispv3_gpio_reset = <0xffffffff 0xb2 0x00>;
				ispv3_gpio_fan_en = <0xffffffff 0x6d 0x00>;
				ispv3_vdd1-supply = <0x2c>;
				ispv3_l12c-supply = <0xffffffff>;
				ispv3_vdd2-supply = <0x2d>;
				ispv3_vdd-supply = <0x2e>;
				ispv3_vddr-supply = <0x2f>;
				ispv3_l10c-supply = <0xffffffff>;
				ispv3_mclk-supply = <0xffffffff>;
				regulator-names = "ispv3_vdd1\0ispv3_l12c\0ispv3_vdd2\0ispv3_vdd\0ispv3_vddr\0ispv3_l10c\0ispv3_mclk";
				rgltr-min-voltage = <0xc3500 0x1b7740 0xc3500 0x1b7740 0xc3500 0x124f80 0x00>;
				rgltr-max-voltage = <0xc3500 0x1b7740 0xc3500 0x1b7740 0xc3500 0x124f80 0x00>;
				pinctrl-names = "ispv3_default\0ispv3_suspend";
				pinctrl-0 = <0x30>;
				pinctrl-1 = <0x31>;
				clocks = <0xffffffff 0x52>;
				clock-names = "ispv3_clk";
				clock-rates = <0x124f800>;
				status = "ok";
			};
		};
	};

	fragment@42 {
		target = <0xffffffff>;

		__overlay__ {
			status = "ok";
			qcom,rt;

			fts@0 {
				status = "ok";
				compatible = "st,spi";
				reg = <0x00>;
				interrupt-parent = <0xffffffff>;
				interrupts = <0x15 0x2008>;
				pinctrl-names = "pmx_ts_active\0pmx_ts_suspend";
				pinctrl-0 = <0x32>;
				pinctrl-1 = <0xffffffff 0xffffffff>;
				avdd-supply = <0xffffffff>;
				vdd-supply = <0xffffffff>;
				fts,pwr-reg-name = "avdd";
				fts,bus-reg-name = "vdd";
				fts,irq-gpio = <0xffffffff 0x15 0x2008>;
				fts,irq-gpio-name = "fts_irq";
				fts,reset-gpio-enable;
				fts,reset-gpio = <0xffffffff 0x14 0x00>;
				fts,reset-gpio-name = "fts_rst";
				fts,irq-flags = <0x2008>;
				fts,x-max = <0x3840>;
				fts,y-max = <0x7d00>;
				fts,fod-lx = <0x16e4>;
				fts,fod-ly = <0x5ba4>;
				fts,fod-x-size = <0xa78>;
				fts,fod-y-size = <0xa64>;
				fts,support-fod;
				spi-max-frequency = <0xb71b00>;
				fts,support-super-resolution = <0x01>;
				fts,touch-gamemode-report-rate = <0x02>;
				fts,default-fw-name = "st_fts_l1.ftb";
				fts,thp-fw-name = "st_fts_l1_thp.ftb";
				fts,config-array-size = <0x01>;
				fts,touch-follow-performance-def = <0x03>;
				fts,touch-tap-sensitivity-def = <0x04>;
				fts,touch-aim-sensitivity-def = <0x03>;
				fts,touch-tap-stability-def = <0x03>;
				fts,cornerfilter-area-step1 = <0x96>;
				fts,cornerfilter-area-step2 = <0x118>;
				fts,cornerfilter-area-step3 = <0x190>;
				fts,touch-deadzone-filter-ver = <0x02 0x00 0x00 0x00 0x00 0x00 0x00 0x00 0x02 0x01 0x00 0x00 0x00 0x00 0x00 0x00 0x02 0x02 0x00 0x00 0x01 0xc7f 0x00 0x00 0x02 0x03 0x59e 0x00 0x59f 0xc7f 0x00 0x00>;
				fts,touch-deadzone-filter-hor = <0x02 0x00 0x00 0x00 0x00 0x00 0x00 0x00 0x02 0x01 0x00 0x00 0x00 0x00 0x00 0x00 0x02 0x02 0x00 0x00 0x00 0x00 0x00 0x00 0x02 0x03 0x00 0x00 0x00 0x00 0x00 0x00>;
				fts,touch-edgezone-filter-ver = <0x01 0x00 0x00 0x00 0x00 0x00 0x00 0x00 0x01 0x01 0x00 0x00 0x00 0x00 0x00 0x00 0x01 0x02 0x00 0x00 0x3c 0xc7f 0x00 0x00 0x01 0x03 0x563 0x00 0x59f 0xc7f 0x00 0x00>;
				fts,touch-edgezone-filter-hor = <0x01 0x00 0x00 0x00 0x59f 0x3c 0x00 0x00 0x01 0x01 0x00 0xc43 0x59f 0xc7f 0x00 0x00 0x01 0x02 0x00 0x00 0x3c 0xc7f 0x00 0x00 0x01 0x03 0x563 0x00 0x59f 0xc7f 0x00 0x00>;
				fts,touch-cornerzone-filter-ver = <0x00 0x00 0x00 0x00 0x00 0x00 0x00 0x00 0x00 0x01 0x00 0x00 0x00 0x00 0x00 0x00 0x00 0x02 0x00 0xaef 0xfa 0xc7f 0x00 0x00 0x00 0x03 0x4a5 0xaef 0x59f 0xc7f 0x00 0x00>;
				fts,touch-cornerzone-filter-hor1 = <0x00 0x00 0x00 0x00 0x118 0x118 0x00 0x00 0x00 0x01 0x00 0x00 0x00 0x00 0x00 0x00 0x00 0x02 0x00 0xb67 0x118 0xc7f 0x00 0x00 0x00 0x03 0x00 0x00 0x00 0x00 0x00 0x00>;
				fts,touch-cornerzone-filter-hor2 = <0x00 0x00 0x00 0x00 0x00 0x00 0x00 0x00 0x00 0x01 0x487 0x00 0x59f 0x118 0x00 0x00 0x00 0x02 0x00 0x00 0x00 0x00 0x00 0x00 0x00 0x03 0x487 0xb67 0x59f 0xc7f 0x00 0x00>;
				fts,touch-follow-performance = <0x0a 0x0f 0x01 0x08 0x0f 0x01 0x06 0x0f 0x01 0x04 0x0f 0x01 0x02 0x0f 0x01>;
				fts,touch-tap-sensitivity = <0xa0 0x96 0x8c 0x78 0x64>;
				fts,touch-aim-sensitivity = <0x0d 0x0b 0x08 0x05 0x03>;
				fts,touch-tap-stability = <0x0b 0x10 0x14 0x18 0x21>;
				fts,touch-expert-array = <0x06 0x0f 0x01 0x78 0x08 0x14 0x02 0x0f 0x01 0x78 0x05 0x14 0x04 0x0f 0x01 0x78 0x03 0x14>;

				fts,cfg_0 {
					fts,tp-vendor = <0x38>;
					fts,fw-name = "st_fts_l1.ftb";
					fts,limit-name = "stm_fts_production_limits.csv";
				};
			};
		};
	};

	fragment@43 {
		target = <0xffffffff>;

		__overlay__ {
			#address-cells = <0x01>;
			#size-cells = <0x00>;
			status = "ok";

			aw8697_haptic@5A {
				compatible = "awinic,aw8697_haptic";
				reg = <0x5a>;
				reset-gpio = <0xffffffff 0x59 0x00>;
				irq-gpio = <0xffffffff 0x5a 0x00>;
				vib_mode = <0x00>;
				vib_f0_pre = <0x6a4>;
				vib_f0_cali_percen = <0x07>;
				vib_cont_drv_lev = <0x45>;
				vib_cont_drv_lvl_ov = <0x45>;
				vib_cont_td = <0xf06c>;
				vib_cont_zc_thr = <0x8f8>;
				vib_cont_num_brk = <0x03>;
				vib_f0_coeff = <0x104>;
				vib_f0_trace_parameter = <0x09 0x03 0x01 0x1f>;
				vib_bemf_config = <0x00 0x08 0x03 0xf8>;
				vib_sw_brake = <0x2c>;
				vib_tset = <0x12>;
				vib_r_spare = <0x68>;
				vib_bstdbg = <0x30 0xeb 0xd4 0x00 0x00 0x00>;
				vib_effect_id_boundary = <0x0a>;
				vib_effect_max = <0xc0>;
				vib_trig_config = <0x00 0x01 0x00 0x01 0x02 0x00 0x01 0x00 0x01 0x02 0x00 0x01 0x00 0x01 0x02>;
				vib_bst_vol_default = <0x0e>;
				vib_bst_vol_ram = <0x0e>;
				vib_bst_vol_rtp = <0x0e>;
				vib_rtp_time = <0x14 0x14 0x14 0x14 0x14 0x14 0x14 0x14 0x4e20 0x3a98 0x3a98 0x4e20 0x61a8 0x3a98 0x7530 0x61a8 0x4e20 0x4e20 0x4e20 0x4e20 0x4e20 0x4e20 0x4e20 0x4e20 0x4e20 0x4e20 0x4e20 0x4e20 0x4e20 0x4e20 0x4e20 0x4e20 0x4e20 0x4e20 0x4e20 0x4e20 0x4e20 0x4e20 0x4e20 0x4e20 0x4e20 0x4e20 0x4e20 0x4e20 0x4e20 0x4e20 0x4e20 0x4e20 0x4e20 0x4e20 0x4e20 0x4e20 0x4e20 0x4e20 0x4e20 0x4e20 0x4e20 0x4e20 0x4e20 0x4e20 0x4e20 0x4e20 0x4e20 0x4e20 0x4e20 0x4e20 0x4e20 0x4e20 0x4e20 0x4e20 0x4e20 0x4e20 0x4e20 0x4e20 0x4e20 0x4e20 0x4e20 0x4e20 0x4e20 0x4e20 0x4e20 0x4e20 0x4e20 0x4e20 0x4e20 0x4e20 0x4e20 0x4e20 0x4e20 0x4e20 0x4e20 0x4e20 0x4e20 0x4e20 0x4e20 0x4e20 0x4e20 0x4e20 0x4e20 0x4e20 0x4e20 0x4e20 0x4e20 0x4e20 0x4e20 0x4e20 0x4e20 0x4e20 0x4e20 0x4e20 0x4e20 0x4e20 0x4e20 0x4e20 0x4e20 0x4e20 0x4e20 0x4e20 0x4e20 0x4e20 0x4e20 0x4e20 0x4e20 0x4e20 0x4e20 0x4e20 0x4e20 0x4e20 0x4e20 0x4e20 0x4e20 0x4e20 0x4e20 0x4e20 0x4e20 0x4e20 0x4e20 0x4e20 0x4e20 0x4e20 0x4e20 0x4e20 0x4e20 0x4e20 0x4e20 0x4e20 0x4e20 0x4e20 0x4e20 0x4e20 0x4e20 0x4e20 0x4e20 0x4e20 0x4e20 0x4e20 0x4e20 0x4e20 0x4e20 0x4e20 0x4e20 0x4e20 0x4e20 0x4e20 0x4e20 0x4e20 0x4e20 0x4e20 0x4e20 0x4e20 0x4e20 0x4e20 0x4e20 0x4e20 0x4e20>;
				pinctrl-names = "aw8697_reset_reset\0aw8697_reset_active\0aw8697_interrupt_active";
				pinctrl-0 = <0x33>;
				pinctrl-1 = <0x34>;
				pinctrl-2 = <0x35>;
				status = "ok";

				wf_0 {
					qcom,effect-id = <0x00>;
					qcom,wf-vmax-mv = <0xe10>;
					qcom,wf-pattern = [3e 3e];
					qcom,wf-brake-pattern = <0x2010000>;
					qcom,wf-play-rate-us = <0x4e20>;
				};

				wf_1 {
					qcom,effect-id = <0x01>;
					qcom,wf-vmax-mv = <0xe10>;
					qcom,wf-pattern = [7e 3e];
					qcom,wf-brake-pattern = <0x3010000>;
					qcom,wf-play-rate-us = <0x4e20>;
				};

				wf_2 {
					qcom,effect-id = <0x02>;
					qcom,wf-vmax-mv = <0xe10>;
					qcom,wf-pattern = [7e 3e];
					qcom,wf-brake-pattern = <0x2010000>;
					qcom,wf-play-rate-us = <0x4e20>;
				};

				wf_3 {
					qcom,effect-id = <0x03>;
					qcom,wf-vmax-mv = <0xe10>;
					qcom,wf-pattern = [3e 3e];
					qcom,wf-brake-pattern = <0x2010000>;
					qcom,wf-play-rate-us = <0x4e20>;
				};

				wf_4 {
					qcom,effect-id = <0x04>;
					qcom,wf-vmax-mv = <0xe10>;
					qcom,wf-pattern = [3e 3e];
					qcom,wf-brake-pattern = <0x2010000>;
					qcom,wf-play-rate-us = <0x6d60>;
				};

				wf_5 {
					qcom,effect-id = <0x05>;
					qcom,wf-vmax-mv = <0xe10>;
					qcom,wf-pattern = [7e 7e 7e];
					qcom,wf-brake-pattern = <0x3030100>;
					qcom,wf-play-rate-us = <0x4e20>;
				};

				wf_6 {
					qcom,effect-id = <0x06>;
					qcom,wf-vmax-mv = <0xe10>;
					qcom,wf-pattern = [3e 3e];
					qcom,wf-brake-pattern = <0x2010000>;
					qcom,wf-play-rate-us = <0x4e20>;
				};

				wf_7 {
					qcom,effect-id = <0x07>;
					qcom,wf-vmax-mv = <0xe10>;
					qcom,wf-pattern = [3e 3e];
					qcom,wf-brake-pattern = <0x2010000>;
					qcom,wf-play-rate-us = <0x4e20>;
				};

				wf_8 {
					qcom,effect-id = <0x08>;
					qcom,wf-vmax-mv = <0xe10>;
					qcom,wf-pattern = [3e 3e];
					qcom,wf-brake-pattern = <0x2010000>;
					qcom,wf-play-rate-us = <0x4e20>;
				};

				wf_9 {
					qcom,effect-id = <0x09>;
					qcom,wf-vmax-mv = <0xe10>;
					qcom,wf-pattern = [3e 3e];
					qcom,wf-brake-pattern = <0x2010000>;
					qcom,wf-play-rate-us = <0x4e20>;
				};
			};
		};
	};

	fragment@44 {
		target = <0xffffffff>;

		__overlay__ {

			cpu_therm {
				polling-delay-passive = <0x00>;
				polling-delay = <0x00>;
				thermal-governor = "user_space";
				thermal-sensors = <0x36 0x144>;
				wake-capable-sensor;

				trips {

					active-config0 {
						temperature = <0x1e848>;
						hysteresis = <0x3e8>;
						type = "passive";
					};
				};
			};

			flash_therm {
				polling-delay-passive = <0x00>;
				polling-delay = <0x00>;
				thermal-governor = "user_space";
				thermal-sensors = <0x36 0x145>;
				wake-capable-sensor;

				trips {

					active-config0 {
						temperature = <0x1e848>;
						hysteresis = <0x3e8>;
						type = "passive";
					};
				};
			};

			quiet_therm {
				polling-delay-passive = <0x00>;
				polling-delay = <0x00>;
				thermal-governor = "user_space";
				thermal-sensors = <0x36 0x146>;
				wake-capable-sensor;

				trips {

					active-config0 {
						temperature = <0x1e848>;
						hysteresis = <0x3e8>;
						type = "passive";
					};
				};
			};

			charger_therm0 {
				polling-delay-passive = <0x00>;
				polling-delay = <0x00>;
				thermal-governor = "user_space";
				thermal-sensors = <0x36 0x147>;
				wake-capable-sensor;

				trips {

					active-config0 {
						temperature = <0x1e848>;
						hysteresis = <0x3e8>;
						type = "passive";
					};
				};
			};

			wireless_therm {
				polling-delay-passive = <0x00>;
				polling-delay = <0x00>;
				thermal-governor = "user_space";
				thermal-sensors = <0x36 0x34b>;
				wake-capable-sensor;

				trips {

					active-config0 {
						temperature = <0x1e848>;
						hysteresis = <0x3e8>;
						type = "passive";
					};
				};
			};

			pa_therm0 {
				polling-delay-passive = <0x00>;
				polling-delay = <0x00>;
				thermal-governor = "user_space";
				thermal-sensors = <0x36 0x44a>;
				wake-capable-sensor;

				trips {

					active-config0 {
						temperature = <0x1e848>;
						hysteresis = <0x3e8>;
						type = "passive";
					};
				};
			};

			pa_therm1 {
				polling-delay-passive = <0x00>;
				polling-delay = <0x00>;
				thermal-governor = "user_space";
				thermal-sensors = <0x36 0x44b>;
				wake-capable-sensor;

				trips {

					active-config0 {
						temperature = <0x1e848>;
						hysteresis = <0x3e8>;
						type = "passive";
					};
				};
			};

			xo-therm-usr {
				polling-delay-passive = <0x00>;
				polling-delay = <0x00>;
				thermal-governor = "user_space";
				thermal-sensors = <0x36 0x44c>;
				wake-capable-sensor;

				trips {

					active-config0 {
						temperature = <0x1e848>;
						hysteresis = <0x3e8>;
						type = "passive";
					};
				};
			};
		};
	};

	fragment@45 {
		target = <0xffffffff>;

		__overlay__ {
			mi,support-soc-update;
			qcom,shutdown-voltage = <0xd16>;
		};
	};

	fragment@46 {
		target = <0xffffffff>;

		__overlay__ {
			size = <0x00 0x2000000>;
		};
	};

	fragment@47 {
		target = <0xffffffff>;

		__overlay__ {
			size = <0x00 0x2400000>;
		};
	};

	fragment@48 {
		target = <0xffffffff>;

		__overlay__ {
			qcom,critical-devices = <0xffffffff>;
		};
	};

	fragment@49 {
		target = <0xffffffff>;

		__overlay__ {

			pm8008i_active {
				phandle = <0x37>;

				mux {
					pins = "gpio6";
					function = "gpio";
				};

				config {
					pins = "gpio6";
					bias-disable;
					output-high;
					drive-strength = <0x02>;
				};
			};
		};
	};

	fragment@50 {
		target = <0xffffffff>;

		__overlay__ {
			#address-cells = <0x01>;
			#size-cells = <0x00>;
			status = "ok";

			pm8008i@8 {
				compatible = "qcom,i2c-pmic";
				reg = <0x08>;
				#address-cells = <0x01>;
				#size-cells = <0x00>;
				pinctrl-names = "default";
				pinctrl-0 = <0x37>;

				pm8008-chip@900 {
					compatible = "qcom,pm8008-chip";
					reg = <0x900>;

					qcom,pm8008-chip-en {
						regulator-name = "pm8008i-chip-en";
						phandle = <0x38>;
					};
				};

				qcom,revid@100 {
					compatible = "qcom,qpnp-revid";
					reg = <0x100>;
				};
			};

			pm8008i@9 {
				compatible = "qcom,i2c-pmic";
				reg = <0x09>;
				#address-cells = <0x01>;
				#size-cells = <0x00>;

				qcom,pm8008i-regulator {
					compatible = "qcom,pm8008-regulator";
					#address-cells = <0x01>;
					#size-cells = <0x00>;
					pm8008_en-supply = <0x38>;
					vdd_l1_l2-supply = <0xffffffff>;
					vdd_l3_l4-supply = <0xffffffff>;
					vdd_l5-supply = <0xffffffff>;
					vdd_l6-supply = <0xffffffff>;
					vdd_l7-supply = <0xffffffff>;

					regulator@4000 {
						reg = <0x4000>;
						regulator-name = "pm8008i_l1";
						regulator-min-microvolt = <0x10d880>;
						regulator-max-microvolt = <0x10d880>;
						qcom,min-dropout-voltage = <0x5dc0>;
						qcom,hpm-min-load = <0x7530>;
						phandle = <0x7b>;
					};

					regulator@4100 {
						reg = <0x4100>;
						regulator-name = "pm8008i_l2";
						regulator-min-microvolt = <0x10d880>;
						regulator-max-microvolt = <0x10d880>;
						qcom,min-dropout-voltage = <0x5dc0>;
						qcom,hpm-min-load = <0x7530>;
						phandle = <0x7c>;
					};

					regulator@4200 {
						reg = <0x4200>;
						regulator-name = "pm8008i_l3";
						regulator-min-microvolt = <0x1b7740>;
						regulator-max-microvolt = <0x1b7740>;
						qcom,min-dropout-voltage = <0xdac0>;
						phandle = <0x2e>;
					};

					regulator@4300 {
						reg = <0x4300>;
						regulator-name = "pm8008i_l4";
						regulator-min-microvolt = <0x1b7740>;
						regulator-max-microvolt = <0x1b7740>;
						qcom,min-dropout-voltage = <0xdac0>;
						phandle = <0x7d>;
					};

					regulator@4400 {
						reg = <0x4400>;
						regulator-name = "pm8008i_l5";
						regulator-min-microvolt = <0x2ad8c0>;
						regulator-max-microvolt = <0x2ad8c0>;
						qcom,min-dropout-voltage = <0x2ee00>;
						phandle = <0x7e>;
					};

					regulator@4500 {
						reg = <0x4500>;
						regulator-name = "pm8008i_l6";
						regulator-min-microvolt = <0x2ad8c0>;
						regulator-max-microvolt = <0x2ad8c0>;
						qcom,min-dropout-voltage = <0x2ee00>;
						phandle = <0x7f>;
					};

					regulator@4600 {
						reg = <0x4600>;
						regulator-name = "pm8008i_l7";
						regulator-min-microvolt = <0x2ad8c0>;
						regulator-max-microvolt = <0x2ad8c0>;
						qcom,min-dropout-voltage = <0x2ee00>;
						phandle = <0x80>;
					};
				};
			};
		};
	};

	fragment@51 {
		target = <0xffffffff>;

		__overlay__ {

			rpmh-regulator-ldoj1 {
				compatible = "qcom,rpmh-vrm-regulator";
				qcom,resource-name = "ldoj1";
				qcom,regulator-type = "pmic5-ldo";
				qcom,supported-modes = <0x02 0x04>;
				qcom,mode-threshold-currents = <0x00 0x7530>;

				regulator-pm8010j-l1 {
					regulator-name = "pm8010j_l1";
					qcom,set = <0x03>;
					regulator-min-microvolt = <0x119400>;
					regulator-max-microvolt = <0x119400>;
					qcom,init-voltage = <0x119400>;
					qcom,init-mode = <0x04>;
					phandle = <0x81>;
				};
			};

			rpmh-regulator-ldoj2 {
				compatible = "qcom,rpmh-vrm-regulator";
				qcom,resource-name = "ldoj2";
				qcom,regulator-type = "pmic5-ldo";
				qcom,supported-modes = <0x02 0x04>;
				qcom,mode-threshold-currents = <0x00 0x7530>;

				regulator-pm8010j-l2 {
					regulator-name = "pm8010j_l2";
					qcom,set = <0x03>;
					regulator-min-microvolt = <0x10d880>;
					regulator-max-microvolt = <0x10d880>;
					qcom,init-voltage = <0x10d880>;
					qcom,init-mode = <0x04>;
					phandle = <0x82>;
				};
			};

			rpmh-regulator-ldoj3 {
				compatible = "qcom,rpmh-vrm-regulator";
				qcom,resource-name = "ldoj3";
				qcom,regulator-type = "pmic5-ldo";
				qcom,supported-modes = <0x02 0x04>;
				qcom,mode-threshold-currents = <0x00 0x2710>;

				regulator-pm8010j-l3 {
					regulator-name = "pm8010j_l3";
					qcom,set = <0x03>;
					regulator-min-microvolt = <0x1b7740>;
					regulator-max-microvolt = <0x1b7740>;
					qcom,init-voltage = <0x1b7740>;
					qcom,init-mode = <0x04>;
					phandle = <0x83>;
				};
			};

			rpmh-regulator-ldoj4 {
				compatible = "qcom,rpmh-vrm-regulator";
				qcom,resource-name = "ldoj4";
				qcom,regulator-type = "pmic5-ldo";
				qcom,supported-modes = <0x02 0x04>;
				qcom,mode-threshold-currents = <0x00 0x2710>;

				regulator-pm8010j-l4 {
					regulator-name = "pm8010j_l4";
					qcom,set = <0x03>;
					regulator-min-microvolt = <0x1b7740>;
					regulator-max-microvolt = <0x1b7740>;
					qcom,init-voltage = <0x1b7740>;
					qcom,init-mode = <0x04>;
					phandle = <0x84>;
				};
			};

			rpmh-regulator-ldoj5 {
				compatible = "qcom,rpmh-vrm-regulator";
				qcom,resource-name = "ldoj5";
				qcom,regulator-type = "pmic5-ldo";
				qcom,supported-modes = <0x02 0x04>;
				qcom,mode-threshold-currents = <0x00 0x2710>;

				regulator-pm8010j-l5 {
					qcom,min-dropout-voltage = <0x2ee00>;
					regulator-name = "pm8010j_l5";
					qcom,set = <0x03>;
					regulator-min-microvolt = <0x2ad8c0>;
					regulator-max-microvolt = <0x2ad8c0>;
					qcom,init-voltage = <0x2c4fc0>;
					qcom,init-mode = <0x04>;
					phandle = <0x85>;
				};
			};

			rpmh-regulator-ldoj6 {
				compatible = "qcom,rpmh-vrm-regulator";
				qcom,resource-name = "ldoj6";
				qcom,regulator-type = "pmic5-ldo";
				qcom,supported-modes = <0x02 0x04>;
				qcom,mode-threshold-currents = <0x00 0x2710>;

				regulator-pm8010j-l6 {
					regulator-name = "pm8010j_l6";
					qcom,set = <0x03>;
					regulator-min-microvolt = "\0/]";
					regulator-max-microvolt = "\0/]";
					qcom,init-voltage = "\0/]";
					qcom,init-mode = <0x04>;
					phandle = <0x86>;
				};
			};

			rpmh-regulator-ldoj7 {
				compatible = "qcom,rpmh-vrm-regulator";
				qcom,resource-name = "ldoj7";
				qcom,regulator-type = "pmic5-ldo";
				qcom,supported-modes = <0x02 0x04>;
				qcom,mode-threshold-currents = <0x00 0x2710>;

				regulator-pm8010j-l7 {
					regulator-name = "pm8010j_l7";
					qcom,set = <0x03>;
					regulator-min-microvolt = "\0/]";
					regulator-max-microvolt = "\0/]";
					qcom,init-voltage = "\0/]";
					qcom,init-mode = <0x04>;
					phandle = <0x87>;
				};
			};
		};
	};

	fragment@52 {
		target = <0xffffffff>;

		__overlay__ {
			#address-cells = <0x02>;
			#size-cells = <0x00>;
			interrupt-controller;
			#interrupt-cells = <0x04>;

			qcom,pm8010@8 {
				compatible = "qcom,spmi-pmic";
				reg = <0x08 0x00>;
				#address-cells = <0x01>;
				#size-cells = <0x00>;

				qcom,temp-alarm@2400 {
					compatible = "qcom,spmi-temp-alarm";
					reg = <0x2400>;
					interrupts = <0x08 0x24 0x00 0x03>;
					#thermal-sensor-cells = <0x00>;
					phandle = <0x39>;
				};
			};

			qcom,pm8010@9 {
				compatible = "qcom,spmi-pmic";
				reg = <0x09 0x00>;
				#address-cells = <0x01>;
				#size-cells = <0x00>;

				qcom,temp-alarm@2400 {
					compatible = "qcom,spmi-temp-alarm";
					reg = <0x2400>;
					interrupts = <0x09 0x24 0x00 0x03>;
					#thermal-sensor-cells = <0x00>;
					phandle = <0x3a>;
				};
			};
		};
	};

	fragment@53 {
		target = <0xffffffff>;

		__overlay__ {

			pm8010i_tz {
				polling-delay-passive = <0x64>;
				polling-delay = <0x00>;
				thermal-governor = "step_wise";
				thermal-sensors = <0x39>;

				trips {

					trip0 {
						temperature = <0x17318>;
						hysteresis = <0x00>;
						type = "passive";
					};

					trip1 {
						temperature = <0x1c138>;
						hysteresis = <0x00>;
						type = "critical";
					};

					trip2 {
						temperature = <0x23668>;
						hysteresis = <0x00>;
						type = "critical";
					};
				};
			};

			pm8010j_tz {
				polling-delay-passive = <0x64>;
				polling-delay = <0x00>;
				thermal-governor = "step_wise";
				thermal-sensors = <0x3a>;

				trips {

					trip0 {
						temperature = <0x17318>;
						hysteresis = <0x00>;
						type = "passive";
					};

					trip1 {
						temperature = <0x1c138>;
						hysteresis = <0x00>;
						type = "critical";
					};

					trip2 {
						temperature = <0x23668>;
						hysteresis = <0x00>;
						type = "critical";
					};
				};
			};
		};
	};

	__symbols__ {
		actuator_tele = "/fragment@70/__overlay__/qcom,actuator3";
		ois_tele = "/fragment@70/__overlay__/qcom,ois3";
		eeprom_tele = "/fragment@70/__overlay__/qcom,eeprom3";
		eeprom_front = "/fragment@70/__overlay__/qcom,eeprom1";
		actuator_ultra = "/fragment@69/__overlay__/qcom,actuator2";
		eeprom_ultra = "/fragment@69/__overlay__/qcom,eeprom2";
		actuator_wide = "/fragment@69/__overlay__/qcom,actuator0";
		ois_wide = "/fragment@69/__overlay__/qcom,ois0";
		eeprom_wide = "/fragment@69/__overlay__/qcom,eeprom0";
		camera_wide_ois_vaf_ldo = "/fragment@68/__overlay__/gpio-regulator@3";
		camera_tele_avdd_ldo = "/fragment@68/__overlay__/gpio-regulator@2";
		camera_ultra_avdd_ldo = "/fragment@68/__overlay__/gpio-regulator@1";
		camera_wide_avdd_ldo = "/fragment@68/__overlay__/gpio-regulator@0";
		led_flash_tele = "/fragment@68/__overlay__/qcom,camera-flash@3";
		led_flash_ultra = "/fragment@68/__overlay__/qcom,camera-flash@2";
		led_flash_wide = "/fragment@68/__overlay__/qcom,camera-flash@1";
		cam_sensor_suspend_tele = "/fragment@62/__overlay__/cam_sensor_suspend_tele";
		cam_sensor_active_tele = "/fragment@62/__overlay__/cam_sensor_active_tele";
		cam_tele_suspend_mclk = "/fragment@62/__overlay__/cam_tele_suspend_mclk";
		cam_tele_active_mclk = "/fragment@62/__overlay__/cam_tele_active_mclk";
		cam_sensor_suspend_front = "/fragment@62/__overlay__/cam_sensor_suspend_front";
		cam_sensor_active_front = "/fragment@62/__overlay__/cam_sensor_active_front";
		cam_front_suspend_mclk = "/fragment@62/__overlay__/cam_front_suspend_mclk";
		cam_front_active_mclk = "/fragment@62/__overlay__/cam_front_active_mclk";
		cam_sensor_suspend_ultra = "/fragment@62/__overlay__/cam_sensor_suspend_ultra";
		cam_sensor_active_ultra = "/fragment@62/__overlay__/cam_sensor_active_ultra";
		cam_ultra_suspend_mclk = "/fragment@62/__overlay__/cam_ultra_suspend_mclk";
		cam_ultra_active_mclk = "/fragment@62/__overlay__/cam_ultra_active_mclk";
		cam_sensor_suspend_mipisel0 = "/fragment@62/__overlay__/cam_sensor_suspend_mipisel0";
		cam_sensor_active_mipisel0 = "/fragment@62/__overlay__/cam_sensor_active_mipisel0";
		cam_sensor_suspend_wide = "/fragment@62/__overlay__/cam_sensor_suspend_wide";
		cam_sensor_active_wide = "/fragment@62/__overlay__/cam_sensor_active_wide";
		cam_wide_suspend_mclk = "/fragment@62/__overlay__/cam_wide_suspend_mclk";
		cam_wide_active_mclk = "/fragment@62/__overlay__/cam_wide_active_mclk";
		cirrus_reset_default_0 = "/fragment@0/__overlay__/cirrus_reset_default_0";
		cirrus_reset_default_1 = "/fragment@0/__overlay__/cirrus_reset_default_1";
		cirrus_irq_default_0 = "/fragment@0/__overlay__/cirrus_irq_default/cirrus_irq_default_0";
		cirrus_irq_default_1 = "/fragment@0/__overlay__/cirrus_irq_default/cirrus_irq_default_1";
		cam_sensor_mclk3_active = "/fragment@0/__overlay__/cam_sensor_mclk3_active";
		cam_sensor_mclk3_suspend = "/fragment@0/__overlay__/cam_sensor_mclk3_suspend";
		ant4_ctrl_irq = "/fragment@0/__overlay__/md_mode_ctrl_irq/ant4_ctrl_irq";
		ant3_ctrl_irq = "/fragment@0/__overlay__/md_mode_ctrl_irq/ant3_ctrl_irq";
		pmk8350 = "/fragment@1/__overlay__/qcom,pmk8350@0";
		pmk8350_vadc = "/fragment@1/__overlay__/qcom,pmk8350@0/vadc@3100";
		pmk8350_adc_tm = "/fragment@1/__overlay__/qcom,pmk8350@0/adc_tm@3400";
		pmk8350_sdam_1 = "/fragment@1/__overlay__/qcom,pmk8350@0/sdam@7000";
		pmk8350_sdam_2 = "/fragment@1/__overlay__/qcom,pmk8350@0/sdam@7100";
		restart_reason = "/fragment@1/__overlay__/qcom,pmk8350@0/sdam@7100/restart@48";
		hap_cl_brake = "/fragment@1/__overlay__/qcom,pmk8350@0/sdam@7100/cl_brake@7c";
		pmk8350_sdam_5 = "/fragment@1/__overlay__/qcom,pmk8350@0/sdam@7400";
		pmk8350_sdam_13 = "/fragment@1/__overlay__/qcom,pmk8350@0/sdam@7c00";
		pmk8350_sdam_14 = "/fragment@1/__overlay__/qcom,pmk8350@0/sdam@7d00";
		pmk8350_sdam_21 = "/fragment@1/__overlay__/qcom,pmk8350@0/sdam@8400";
		pmk8350_sdam_22 = "/fragment@1/__overlay__/qcom,pmk8350@0/sdam@8500";
		pmk8350_sdam_23 = "/fragment@1/__overlay__/qcom,pmk8350@0/sdam@8600";
		pmk8350_sdam_41 = "/fragment@1/__overlay__/qcom,pmk8350@0/sdam@9800";
		pmk8350_sdam_46 = "/fragment@1/__overlay__/qcom,pmk8350@0/sdam@9d00";
		pmk8350_gpios = "/fragment@1/__overlay__/qcom,pmk8350@0/pinctrl@b000";
		pmk8350_rtc = "/fragment@1/__overlay__/qcom,pmk8350@0/rtc@6100";
		pm8350_tz = "/fragment@2/__overlay__/qcom,pm8350@1/qcom,temp-alarm@a00";
		pm8350_gpios = "/fragment@2/__overlay__/qcom,pm8350@1/pinctrl@8800";
		pm8350_rear_tof_therm_default = "/fragment@2/__overlay__/qcom,pm8350@1/pinctrl@8800/pm8350_rear_tof_therm/pm8350_rear_tof_therm_default";
		key_vol_up_default = "/fragment@2/__overlay__/qcom,pm8350@1/pinctrl@8800/key_vol_up/key_vol_up_default";
		pm8350_temp_alarm = "/fragment@3/__overlay__/pm8350_tz";
		pm8350_trip0 = "/fragment@3/__overlay__/pm8350_tz/trips/trip0";
		pm8350_trip1 = "/fragment@3/__overlay__/pm8350_tz/trips/trip1";
		pm8350_trip2 = "/fragment@3/__overlay__/pm8350_tz/trips/trip2";
		pm8350c_tz = "/fragment@4/__overlay__/qcom,pm8350c@2/qcom,temp-alarm@a00";
		pm8350c_gpios = "/fragment@4/__overlay__/qcom,pm8350c@2/pinctrl@8800";
		lcd_backlight_ctrl_default = "/fragment@4/__overlay__/qcom,pm8350c@2/pinctrl@8800/lcd_backlight_ctrl/lcd_backlight_ctrl_default";
		pm8350c_pwm_1 = "/fragment@4/__overlay__/qcom,pm8350c@2/pwms@e800";
		pm8350c_pwm_2 = "/fragment@4/__overlay__/qcom,pm8350c@2/pwms@eb00";
		pm8350c_rgb = "/fragment@4/__overlay__/qcom,pm8350c@2/qcom,leds@ef00";
		pm8350c_bcl = "/fragment@4/__overlay__/qcom,pm8350c@2/bcl@4700";
		pm8350c_flash = "/fragment@4/__overlay__/qcom,pm8350c@2/qcom,flash_led@ee00";
		pm8350c_flash0 = "/fragment@4/__overlay__/qcom,pm8350c@2/qcom,flash_led@ee00/qcom,flash_0";
		pm8350c_flash1 = "/fragment@4/__overlay__/qcom,pm8350c@2/qcom,flash_led@ee00/qcom,flash_1";
		pm8350c_flash2 = "/fragment@4/__overlay__/qcom,pm8350c@2/qcom,flash_led@ee00/qcom,flash_2";
		pm8350c_flash3 = "/fragment@4/__overlay__/qcom,pm8350c@2/qcom,flash_led@ee00/qcom,flash_3";
		pm8350c_torch0 = "/fragment@4/__overlay__/qcom,pm8350c@2/qcom,flash_led@ee00/qcom,torch_0";
		pm8350c_torch1 = "/fragment@4/__overlay__/qcom,pm8350c@2/qcom,flash_led@ee00/qcom,torch_1";
		pm8350c_torch2 = "/fragment@4/__overlay__/qcom,pm8350c@2/qcom,flash_led@ee00/qcom,torch_2";
		pm8350c_torch3 = "/fragment@4/__overlay__/qcom,pm8350c@2/qcom,flash_led@ee00/qcom,torch_3";
		pm8350c_switch0 = "/fragment@4/__overlay__/qcom,pm8350c@2/qcom,flash_led@ee00/qcom,led_switch_0";
		pm8350c_switch1 = "/fragment@4/__overlay__/qcom,pm8350c@2/qcom,flash_led@ee00/qcom,led_switch_1";
		pm8350c_switch2 = "/fragment@4/__overlay__/qcom,pm8350c@2/qcom,flash_led@ee00/qcom,led_switch_2";
		pm8350c_temp_alarm = "/fragment@5/__overlay__/pm8350c_tz";
		pm8350c_trip0 = "/fragment@5/__overlay__/pm8350c_tz/trips/trip0";
		pm8350c_trip1 = "/fragment@5/__overlay__/pm8350c_tz/trips/trip1";
		pm8350c_trip2 = "/fragment@5/__overlay__/pm8350c_tz/trips/trip2";
		c_bcl_lvl0 = "/fragment@5/__overlay__/pm8350c-bcl-lvl0/trips/c-bcl-lvl0";
		c_bcl_lvl1 = "/fragment@5/__overlay__/pm8350c-bcl-lvl1/trips/c-bcl-lvl1";
		c_bcl_lvl2 = "/fragment@5/__overlay__/pm8350c-bcl-lvl2/trips/c-bcl-lvl2";
		pm8350b_tz = "/fragment@6/__overlay__/qcom,pm8350b@3/qcom,temp-alarm@a00";
		pm8350b_pbs2 = "/fragment@6/__overlay__/qcom,pm8350b@3/qcom,pbs@1900";
		pm8350b_gpios = "/fragment@6/__overlay__/qcom,pm8350b@3/pinctrl@8800";
		pm8350b_rear_tof_therm_default = "/fragment@6/__overlay__/qcom,pm8350b@3/pinctrl@8800/pm8350b_rear_tof_therm/pm8350b_rear_tof_therm_default";
		pm8350b_bcl = "/fragment@6/__overlay__/qcom,pm8350b@3/bcl@4700";
		bcl_soc = "/fragment@6/__overlay__/qcom,pm8350b@3/bcl-soc";
		pm8350b_haptics = "/fragment@6/__overlay__/qcom,pm8350b@3/qcom,hv-haptics@f000";
		hap_swr_slave_reg = "/fragment@6/__overlay__/qcom,pm8350b@3/qcom,hv-haptics@f000/qcom,hap-swr-slave-reg";
		pm8350b_amoled = "/fragment@6/__overlay__/qcom,pm8350b@3/qcom,amoled";
		oledb_vreg = "/fragment@6/__overlay__/qcom,pm8350b@3/qcom,amoled/oledb@fa00";
		ab_vreg = "/fragment@6/__overlay__/qcom,pm8350b@3/qcom,amoled/ab@f900";
		ibb_vreg = "/fragment@6/__overlay__/qcom,pm8350b@3/qcom,amoled/ibb@f800";
		pm8350b_temp_alarm = "/fragment@7/__overlay__/pm8350b_tz";
		pm8350b_trip0 = "/fragment@7/__overlay__/pm8350b_tz/trips/trip0";
		pm8350b_trip1 = "/fragment@7/__overlay__/pm8350b_tz/trips/trip1";
		pm8350b_trip2 = "/fragment@7/__overlay__/pm8350b_tz/trips/trip2";
		ibat_lvl0 = "/fragment@7/__overlay__/pm8350b-ibat-lvl0/trips/ibat-lvl0";
		ibat_lvl1 = "/fragment@7/__overlay__/pm8350b-ibat-lvl1/trips/ibat-lvl1";
		b_bcl_lvl0 = "/fragment@7/__overlay__/pm8350b-bcl-lvl0/trips/b-bcl-lvl0";
		b_bcl_lvl1 = "/fragment@7/__overlay__/pm8350b-bcl-lvl1/trips/b-bcl-lvl1";
		b_bcl_lvl2 = "/fragment@7/__overlay__/pm8350b-bcl-lvl2/trips/b-bcl-lvl2";
		socd_trip = "/fragment@7/__overlay__/socd/trips/socd-trip";
		pmr735a_spmi = "/fragment@8/__overlay__/qcom,pmr735a@4";
		pmr735a_tz = "/fragment@8/__overlay__/qcom,pmr735a@4/qcom,temp-alarm@a00";
		pmr735a_gpios = "/fragment@8/__overlay__/qcom,pmr735a@4/pinctrl@8800";
		pmr735a_temp_alarm = "/fragment@9/__overlay__/pmr735a_tz";
		pmr735a_trip0 = "/fragment@9/__overlay__/pmr735a_tz/trips/trip0";
		pmr735a_trip1 = "/fragment@9/__overlay__/pmr735a_tz/trips/trip1";
		pmr735a_trip2 = "/fragment@9/__overlay__/pmr735a_tz/trips/trip2";
		pmr735b_tz = "/fragment@10/__overlay__/qcom,pmr735b@5/qcom,temp-alarm@a00";
		pmr735b_gpios = "/fragment@10/__overlay__/qcom,pmr735b@5/pinctrl@8800";
		pmr735b_temp_alarm = "/fragment@11/__overlay__/pmr735b_tz";
		pmr735b_trip0 = "/fragment@11/__overlay__/pmr735b_tz/trips/trip0";
		pmr735b_trip1 = "/fragment@11/__overlay__/pmr735b_tz/trips/trip1";
		pmr735b_trip2 = "/fragment@11/__overlay__/pmr735b_tz/trips/trip2";
		pm8450_tz = "/fragment@12/__overlay__/qcom,pm8450@7/qcom,temp-alarm@a00";
		pm8450_gpios = "/fragment@12/__overlay__/qcom,pm8450@7/pinctrl@8800";
		pm8450_temp_alarm = "/fragment@13/__overlay__/pm8450_tz";
		pm8450_trip0 = "/fragment@13/__overlay__/pm8450_tz/trips/trip0";
		pm8450_trip1 = "/fragment@13/__overlay__/pm8450_tz/trips/trip1";
		pm8450_trip2 = "/fragment@13/__overlay__/pm8450_tz/trips/trip2";
		usb_port0 = "/fragment@23/__overlay__/port/endpoint";
		usb_port0_connector = "/fragment@24/__overlay__/connector/port/endpoint";
		aw8697_gpio_reset = "/fragment@26/__overlay__/aw8697_gpio_reset";
		aw8697_gpio_reset_output_high = "/fragment@26/__overlay__/aw8697_gpio_reset_output_high";
		aw8697_gpio_int = "/fragment@26/__overlay__/aw8697_gpio_int";
		rcv_gpio_high = "/fragment@26/__overlay__/rcv_gpio_high";
		rcv_gpio_low = "/fragment@26/__overlay__/rcv_gpio_low";
		cs35l41_0 = "/fragment@27/__overlay__/cs35l41@42";
		cs35l41_1 = "/fragment@27/__overlay__/cs35l41@43";
		mi_ts_active = "/fragment@31/__overlay__/mi_ts_active";
		ispv3_vdd1_ldo = "/fragment@37/__overlay__/ispv3_vdd1_ldo";
		ispv3_vdd2_ldo = "/fragment@37/__overlay__/ispv3_vdd2_ldo";
		ispv3_vddr_ldo = "/fragment@37/__overlay__/ispv3_vddr_ldo";
		ispv3_pci = "/fragment@39/__overlay__/ispv3_pci";
		ispv3_pci_iommu_group = "/fragment@39/__overlay__/ispv3_pci/ispv3_pci_iommu_group";
		ispv3_i2c = "/fragment@40/__overlay__/ispv3_i2c@60";
		pm8008i_active = "/fragment@49/__overlay__/pm8008i_active";
		PM8008I_EN = "/fragment@50/__overlay__/pm8008i@8/pm8008-chip@900/qcom,pm8008-chip-en";
		L1I = "/fragment@50/__overlay__/pm8008i@9/qcom,pm8008i-regulator/regulator@4000";
		pm8008i_l1 = "/fragment@50/__overlay__/pm8008i@9/qcom,pm8008i-regulator/regulator@4000";
		L2I = "/fragment@50/__overlay__/pm8008i@9/qcom,pm8008i-regulator/regulator@4100";
		pm8008i_l2 = "/fragment@50/__overlay__/pm8008i@9/qcom,pm8008i-regulator/regulator@4100";
		L3I = "/fragment@50/__overlay__/pm8008i@9/qcom,pm8008i-regulator/regulator@4200";
		pm8008i_l3 = "/fragment@50/__overlay__/pm8008i@9/qcom,pm8008i-regulator/regulator@4200";
		L4I = "/fragment@50/__overlay__/pm8008i@9/qcom,pm8008i-regulator/regulator@4300";
		pm8008i_l4 = "/fragment@50/__overlay__/pm8008i@9/qcom,pm8008i-regulator/regulator@4300";
		L5I = "/fragment@50/__overlay__/pm8008i@9/qcom,pm8008i-regulator/regulator@4400";
		pm8008i_l5 = "/fragment@50/__overlay__/pm8008i@9/qcom,pm8008i-regulator/regulator@4400";
		L6I = "/fragment@50/__overlay__/pm8008i@9/qcom,pm8008i-regulator/regulator@4500";
		pm8008i_l6 = "/fragment@50/__overlay__/pm8008i@9/qcom,pm8008i-regulator/regulator@4500";
		L7I = "/fragment@50/__overlay__/pm8008i@9/qcom,pm8008i-regulator/regulator@4600";
		pm8008i_l7 = "/fragment@50/__overlay__/pm8008i@9/qcom,pm8008i-regulator/regulator@4600";
		L1J = "/fragment@51/__overlay__/rpmh-regulator-ldoj1/regulator-pm8010j-l1";
		pm8010j_l1 = "/fragment@51/__overlay__/rpmh-regulator-ldoj1/regulator-pm8010j-l1";
		L2J = "/fragment@51/__overlay__/rpmh-regulator-ldoj2/regulator-pm8010j-l2";
		pm8010j_l2 = "/fragment@51/__overlay__/rpmh-regulator-ldoj2/regulator-pm8010j-l2";
		L3J = "/fragment@51/__overlay__/rpmh-regulator-ldoj3/regulator-pm8010j-l3";
		pm8010j_l3 = "/fragment@51/__overlay__/rpmh-regulator-ldoj3/regulator-pm8010j-l3";
		L4J = "/fragment@51/__overlay__/rpmh-regulator-ldoj4/regulator-pm8010j-l4";
		pm8010j_l4 = "/fragment@51/__overlay__/rpmh-regulator-ldoj4/regulator-pm8010j-l4";
		L5J = "/fragment@51/__overlay__/rpmh-regulator-ldoj5/regulator-pm8010j-l5";
		pm8010j_l5 = "/fragment@51/__overlay__/rpmh-regulator-ldoj5/regulator-pm8010j-l5";
		L6J = "/fragment@51/__overlay__/rpmh-regulator-ldoj6/regulator-pm8010j-l6";
		pm8010j_l6 = "/fragment@51/__overlay__/rpmh-regulator-ldoj6/regulator-pm8010j-l6";
		L7J = "/fragment@51/__overlay__/rpmh-regulator-ldoj7/regulator-pm8010j-l7";
		pm8010j_l7 = "/fragment@51/__overlay__/rpmh-regulator-ldoj7/regulator-pm8010j-l7";
		pm8010i_tz = "/fragment@52/__overlay__/qcom,pm8010@8/qcom,temp-alarm@2400";
		pm8010j_tz = "/fragment@52/__overlay__/qcom,pm8010@9/qcom,temp-alarm@2400";
	};

	__fixups__ {
		cam_cci1 = "/fragment@70:target:0";
		cam_cci0 = "/fragment@69:target:0";
		i2c_freq_1Mhz_cci1 = "/fragment@66:target:0";
		cci3_suspend = "/fragment@61:target:0";
		cci3_active = "/fragment@60:target:0";
		cci2_suspend = "/fragment@59:target:0";
		cci2_active = "/fragment@58:target:0";
		cci1_suspend = "/fragment@57:target:0";
		cci1_active = "/fragment@56:target:0";
		cci0_suspend = "/fragment@55:target:0";
		cci0_active = "/fragment@54:target:0";
		tlmm = "/fragment@0:target:0\0/fragment@18/__overlay__:cd-gpios:0\0/fragment@22/__overlay__/nq@28:qcom,sn-irq:0\0/fragment@22/__overlay__/nq@28:qcom,sn-ven:0\0/fragment@22/__overlay__/nq@28:qcom,sn-firm:0\0/fragment@22/__overlay__/nq@28:qcom,sn-clkreq:0\0/fragment@22/__overlay__/nq@28:interrupt-parent:0\0/fragment@23/__overlay__/synaptics_tcm@20:interrupt-parent:0\0/fragment@23/__overlay__/synaptics_tcm@20:synaptics,irq-gpio:0\0/fragment@23/__overlay__/synaptics_tcm@20:synaptics,reset-gpio:0\0/fragment@26:target:0\0/fragment@27/__overlay__/cs35l41@42:reset-gpios:0\0/fragment@27/__overlay__/cs35l41@42:interrupt-parent:0\0/fragment@27/__overlay__/cs35l41@43:reset-gpios:0\0/fragment@27/__overlay__/cs35l41@43:spk-sw-gpios:0\0/fragment@27/__overlay__/cs35l41@43:interrupt-parent:0\0/fragment@28/__overlay__/fingerprint_goodix:goodix,gpio-reset:0\0/fragment@28/__overlay__/fingerprint_goodix:goodix,gpio-irq:0\0/fragment@28/__overlay__/md_testing_mode:status-gpio:0\0/fragment@28/__overlay__/md_testing_mode:status-gpio:12\0/fragment@28/__overlay__/gpio_keys/hall_key:gpios:0\0/fragment@31:target:0\0/fragment@37/__overlay__/ispv3_vdd1_ldo:gpio:0\0/fragment@37/__overlay__/ispv3_vdd2_ldo:gpio:0\0/fragment@37/__overlay__/ispv3_vddr_ldo:gpio:0\0/fragment@41/__overlay__/ispv3_spi@0:ispv3_gpio_14:0\0/fragment@41/__overlay__/ispv3_spi@0:ispv3_gpio_15:0\0/fragment@41/__overlay__/ispv3_spi@0:ispv3_gpio_int0:0\0/fragment@41/__overlay__/ispv3_spi@0:ispv3_gpio_int1:0\0/fragment@41/__overlay__/ispv3_spi@0:ispv3_gpio_reset:0\0/fragment@41/__overlay__/ispv3_spi@0:ispv3_gpio_fan_en:0\0/fragment@42/__overlay__/fts@0:interrupt-parent:0\0/fragment@42/__overlay__/fts@0:fts,irq-gpio:0\0/fragment@42/__overlay__/fts@0:fts,reset-gpio:0\0/fragment@43/__overlay__/aw8697_haptic@5A:reset-gpio:0\0/fragment@43/__overlay__/aw8697_haptic@5A:irq-gpio:0\0/fragment@49:target:0\0/fragment@62:target:0\0/fragment@68/__overlay__/gpio-regulator@0:gpio:0\0/fragment@68/__overlay__/gpio-regulator@1:gpio:0\0/fragment@68/__overlay__/gpio-regulator@2:gpio:0\0/fragment@68/__overlay__/gpio-regulator@3:gpio:0\0/fragment@69/__overlay__/qcom,eeprom0:gpios:0\0/fragment@69/__overlay__/qcom,eeprom0:gpios:12\0/fragment@69/__overlay__/qcom,eeprom0:gpios:24\0/fragment@69/__overlay__/qcom,ois0:gpios:0\0/fragment@69/__overlay__/qcom,ois0:gpios:12\0/fragment@69/__overlay__/qcom,ois0:gpios:24\0/fragment@69/__overlay__/qcom,cam-sensor0:gpios:0\0/fragment@69/__overlay__/qcom,cam-sensor0:gpios:12\0/fragment@69/__overlay__/qcom,cam-sensor0:gpios:24\0/fragment@69/__overlay__/qcom,eeprom2:gpios:0\0/fragment@69/__overlay__/qcom,eeprom2:gpios:12\0/fragment@69/__overlay__/qcom,cam-sensor2:gpios:0\0/fragment@69/__overlay__/qcom,cam-sensor2:gpios:12\0/fragment@70/__overlay__/qcom,eeprom1:gpios:0\0/fragment@70/__overlay__/qcom,eeprom1:gpios:12\0/fragment@70/__overlay__/qcom,cam-sensor1:gpios:0\0/fragment@70/__overlay__/qcom,cam-sensor1:gpios:12\0/fragment@70/__overlay__/qcom,eeprom3:gpios:0\0/fragment@70/__overlay__/qcom,eeprom3:gpios:12\0/fragment@70/__overlay__/qcom,ois3:gpios:0\0/fragment@70/__overlay__/qcom,ois3:gpios:12\0/fragment@70/__overlay__/qcom,cam-sensor3:gpios:0\0/fragment@70/__overlay__/qcom,cam-sensor3:gpios:12";
		spmi_bus = "/fragment@1:target:0\0/fragment@2:target:0\0/fragment@4:target:0\0/fragment@6:target:0\0/fragment@8:target:0\0/fragment@10:target:0\0/fragment@12:target:0\0/fragment@52:target:0";
		thermal_zones = "/fragment@3:target:0\0/fragment@5:target:0\0/fragment@7:target:0\0/fragment@9:target:0\0/fragment@11:target:0\0/fragment@13:target:0\0/fragment@15:target:0\0/fragment@44:target:0\0/fragment@53:target:0";
		soc = "/fragment@14:target:0\0/fragment@19:target:0\0/fragment@28:target:0\0/fragment@37:target:0\0/fragment@68:target:0";
		modem_lte_dsc = "/fragment@15/__overlay__/pm8350b-bcl-lvl0/cooling-maps/vbat_lte0:cooling-device:0\0/fragment@15/__overlay__/pm8350b-bcl-lvl1/cooling-maps/vbat_lte1:cooling-device:0\0/fragment@15/__overlay__/pm8350c-bcl-lvl0/cooling-maps/vph_lte0:cooling-device:0\0/fragment@15/__overlay__/pm8350c-bcl-lvl1/cooling-maps/vph_lte1:cooling-device:0\0/fragment@15/__overlay__/pm8350c_tz/cooling-maps/pm8350c_lte:cooling-device:0";
		modem_nr_scg_dsc = "/fragment@15/__overlay__/pm8350b-bcl-lvl0/cooling-maps/vbat_nr0_scg:cooling-device:0\0/fragment@15/__overlay__/pm8350b-bcl-lvl1/cooling-maps/vbat_nr1_scg:cooling-device:0\0/fragment@15/__overlay__/pm8350c-bcl-lvl0/cooling-maps/vph_nr0_scg:cooling-device:0\0/fragment@15/__overlay__/pm8350c-bcl-lvl1/cooling-maps/vph_nr1_scg:cooling-device:0\0/fragment@15/__overlay__/pm8350c_tz/cooling-maps/pm8350c_nr:cooling-device:0";
		modem_nr_dsc = "/fragment@15/__overlay__/pm8350b-bcl-lvl0/cooling-maps/vbat_nr0:cooling-device:0\0/fragment@15/__overlay__/pm8350b-bcl-lvl1/cooling-maps/vbat_nr1:cooling-device:0\0/fragment@15/__overlay__/pm8350c-bcl-lvl0/cooling-maps/vph_nr0:cooling-device:0\0/fragment@15/__overlay__/pm8350c-bcl-lvl1/cooling-maps/vph_nr1:cooling-device:0";
		cdsp_sw = "/fragment@15/__overlay__/pm8350b-bcl-lvl0/cooling-maps/vbat_cdsp0:cooling-device:0\0/fragment@15/__overlay__/pm8350b-bcl-lvl1/cooling-maps/vbat_cdsp1:cooling-device:0\0/fragment@15/__overlay__/pm8350b-bcl-lvl2/cooling-maps/vbat_cdsp2:cooling-device:0\0/fragment@15/__overlay__/pm8350c-bcl-lvl0/cooling-maps/vph_cdsp0:cooling-device:0\0/fragment@15/__overlay__/pm8350c-bcl-lvl1/cooling-maps/vph_cdsp1:cooling-device:0\0/fragment@15/__overlay__/pm8350c-bcl-lvl2/cooling-maps/vph_cdsp2:cooling-device:0\0/fragment@15/__overlay__/pm8350c_tz/cooling-maps/pm8350c_nsp:cooling-device:0";
		cpu5_pause = "/fragment@15/__overlay__/pm8350b-bcl-lvl0/cooling-maps/vbat_cpu_5:cooling-device:0\0/fragment@15/__overlay__/pm8350c-bcl-lvl0/cooling-maps/vph_cpu_5:cooling-device:0";
		msm_gpu = "/fragment@15/__overlay__/pm8350b-bcl-lvl0/cooling-maps/vbat_gpu0:cooling-device:0\0/fragment@15/__overlay__/pm8350b-bcl-lvl1/cooling-maps/vbat_gpu1:cooling-device:0\0/fragment@15/__overlay__/pm8350b-bcl-lvl2/cooling-maps/vbat_gpu2:cooling-device:0\0/fragment@15/__overlay__/pm8350c-bcl-lvl0/cooling-maps/vph_gpu0:cooling-device:0\0/fragment@15/__overlay__/pm8350c-bcl-lvl1/cooling-maps/vph_gpu1:cooling-device:0\0/fragment@15/__overlay__/pm8350c-bcl-lvl2/cooling-maps/vph_gpu2:cooling-device:0\0/fragment@15/__overlay__/pm8350_tz/cooling-maps/pm8350_gpu:cooling-device:0";
		cpu_6_7_pause = "/fragment@15/__overlay__/pm8350b-bcl-lvl1/cooling-maps/vbat_cpu_6_7:cooling-device:0\0/fragment@15/__overlay__/pm8350c-bcl-lvl1/cooling-maps/vph_cpu_6_7:cooling-device:0";
		CPU4 = "/fragment@15/__overlay__/pm8450_tz/cooling-maps/pm8450_cpu4_freq:cooling-device:0\0/fragment@15/__overlay__/pm8350_tz/cooling-maps/pm8350_cpu4_freq:cooling-device:0";
		CPU7 = "/fragment@15/__overlay__/pm8450_tz/cooling-maps/pm8450_cpu7_freq:cooling-device:0\0/fragment@15/__overlay__/pm8350_tz/cooling-maps/pm8350_cpu7_freq:cooling-device:0";
		APC1_pause = "/fragment@15/__overlay__/pm8450_tz/cooling-maps/pm8450_apc1:cooling-device:0\0/fragment@15/__overlay__/pm8350_tz/cooling-maps/pm8350_apc1:cooling-device:0";
		ufsphy_mem = "/fragment@16:target:0";
		pm8350_l5 = "/fragment@16/__overlay__:vdda-phy-supply:0";
		pm8350_l6 = "/fragment@16/__overlay__:vdda-pll-supply:0";
		ufshc_mem = "/fragment@17:target:0";
		gcc_ufs_phy_gdsc = "/fragment@17/__overlay__:vdd-hba-supply:0";
		pm8350_l7 = "/fragment@17/__overlay__:vcc-supply:0";
		pm8350_l9 = "/fragment@17/__overlay__:vccq-supply:0\0/fragment@17/__overlay__:qcom,vddp-ref-clk-supply:0";
		pm8350_s12 = "/fragment@17/__overlay__:qcom,vccq-parent-supply:0";
		sdhc_2 = "/fragment@18:target:0";
		pm8350c_l9 = "/fragment@18/__overlay__:vdd-supply:0";
		pm8350c_l6 = "/fragment@18/__overlay__:vdd-io-supply:0";
		sdc2_on = "/fragment@18/__overlay__:pinctrl-0:0";
		sdc2_off = "/fragment@18/__overlay__:pinctrl-1:0";
		qupv3_se13_spi = "/fragment@20:target:0";
		battery_charger = "/fragment@21:target:0\0/fragment@45:target:0";
		qupv3_se9_i2c = "/fragment@22:target:0";
		S10B = "/fragment@22/__overlay__/nq@28:qcom,sn-vdd-1p8-supply:0";
		nfc_int_active = "/fragment@22/__overlay__/nq@28:pinctrl-0:0";
		nfc_enable_active = "/fragment@22/__overlay__/nq@28:pinctrl-0:4";
		nfc_int_suspend = "/fragment@22/__overlay__/nq@28:pinctrl-1:0";
		nfc_enable_suspend = "/fragment@22/__overlay__/nq@28:pinctrl-1:4";
		usb0 = "/fragment@23:target:0";
		ts_active = "/fragment@23/__overlay__/synaptics_tcm@20:pinctrl-0:0";
		ts_int_suspend = "/fragment@23/__overlay__/synaptics_tcm@20:pinctrl-1:0\0/fragment@42/__overlay__/fts@0:pinctrl-1:0";
		ts_reset_suspend = "/fragment@23/__overlay__/synaptics_tcm@20:pinctrl-1:4\0/fragment@42/__overlay__/fts@0:pinctrl-1:4";
		ts_release = "/fragment@23/__overlay__/synaptics_tcm@20:pinctrl-2:0";
		L8C = "/fragment@23/__overlay__/synaptics_tcm@20:vdd-supply:0\0/fragment@33/__overlay__/stmvl53l5@0:_1P8_power-supply:0";
		L3C = "/fragment@23/__overlay__/synaptics_tcm@20:avdd-supply:0";
		ucsi = "/fragment@24:target:0";
		reserved_memory = "/fragment@25:target:0";
		qupv3_se15_i2c = "/fragment@27:target:0";
		L11C = "/fragment@28/__overlay__/fingerprint_goodix:l11c_vdd-supply:0\0/fragment@29:target:0";
		usb2_phy0 = "/fragment@30:target:0";
		L7C = "/fragment@32:target:0\0/fragment@33/__overlay__/stmvl53l5@0:_3P0_power-supply:0";
		qupv3_se0_spi = "/fragment@33:target:0";
		L9C = "/fragment@34:target:0\0/fragment@42/__overlay__/fts@0:avdd-supply:0";
		L12C = "/fragment@35:target:0\0/fragment@41/__overlay__/ispv3_spi@0:ispv3_l12c-supply:0";
		L10C = "/fragment@36:target:0\0/fragment@41/__overlay__/ispv3_spi@0:ispv3_l10c-supply:0";
		S11B = "/fragment@37/__overlay__/ispv3_vdd1_ldo:vin-supply:0\0/fragment@37/__overlay__/ispv3_vdd2_ldo:vin-supply:0\0/fragment@37/__overlay__/ispv3_vddr_ldo:vin-supply:0";
		pcie1 = "/fragment@38:target:0";
		pcie1_rp = "/fragment@39:target:0";
		qupv3_se5_i2c = "/fragment@40:target:0\0/fragment@48/__overlay__:qcom,critical-devices:0\0/fragment@50:target:0";
		qupv3_se18_spi = "/fragment@41:target:0";
		cam_cc_titan_top_gdsc = "/fragment@41/__overlay__/ispv3_spi@0:ispv3_mclk-supply:0\0/fragment@69/__overlay__/qcom,eeprom0:cam_clk-supply:0\0/fragment@69/__overlay__/qcom,ois0:cam_clk-supply:0\0/fragment@69/__overlay__/qcom,cam-sensor0:cam_clk-supply:0\0/fragment@69/__overlay__/qcom,eeprom2:cam_clk-supply:0\0/fragment@69/__overlay__/qcom,cam-sensor2:cam_clk-supply:0\0/fragment@70/__overlay__/qcom,eeprom1:cam_clk-supply:0\0/fragment@70/__overlay__/qcom,cam-sensor1:cam_clk-supply:0\0/fragment@70/__overlay__/qcom,eeprom3:cam_clk-supply:0\0/fragment@70/__overlay__/qcom,ois3:cam_clk-supply:0\0/fragment@70/__overlay__/qcom,cam-sensor3:cam_clk-supply:0";
		clock_camcc = "/fragment@41/__overlay__/ispv3_spi@0:clocks:0\0/fragment@69/__overlay__/qcom,eeprom0:clocks:0\0/fragment@69/__overlay__/qcom,ois0:clocks:0\0/fragment@69/__overlay__/qcom,cam-sensor0:clocks:0\0/fragment@69/__overlay__/qcom,eeprom2:clocks:0\0/fragment@69/__overlay__/qcom,cam-sensor2:clocks:0\0/fragment@70/__overlay__/qcom,eeprom1:clocks:0\0/fragment@70/__overlay__/qcom,cam-sensor1:clocks:0\0/fragment@70/__overlay__/qcom,eeprom3:clocks:0\0/fragment@70/__overlay__/qcom,ois3:clocks:0\0/fragment@70/__overlay__/qcom,cam-sensor3:clocks:0";
		qupv3_se4_spi = "/fragment@42:target:0";
		L2C = "/fragment@42/__overlay__/fts@0:vdd-supply:0";
		qupv3_se16_i2c = "/fragment@43:target:0";
		qseecom_ta_mem = "/fragment@46:target:0";
		qseecom_mem = "/fragment@47:target:0";
		clock_gcc = "/fragment@48:target:0";
		S12B = "/fragment@50/__overlay__/pm8008i@9/qcom,pm8008i-regulator:vdd_l1_l2-supply:0";
		S1C = "/fragment@50/__overlay__/pm8008i@9/qcom,pm8008i-regulator:vdd_l3_l4-supply:0";
		BOB = "/fragment@50/__overlay__/pm8008i@9/qcom,pm8008i-regulator:vdd_l5-supply:0\0/fragment@50/__overlay__/pm8008i@9/qcom,pm8008i-regulator:vdd_l6-supply:0\0/fragment@50/__overlay__/pm8008i@9/qcom,pm8008i-regulator:vdd_l7-supply:0";
		apps_rsc = "/fragment@51:target:0";
	};

	__local_fixups__ {

		fragment@1 {

			__overlay__ {

				qcom,pmk8350@0 {

					vadc@3100 {
						pinctrl-0 = <0x00>;
					};

					adc_tm@3400 {
						io-channels = <0x00 0x08 0x10 0x18 0x20 0x28 0x30 0x38>;
					};
				};
			};
		};

		fragment@2 {

			__overlay__ {

				qcom,pm8350@1 {

					qcom,temp-alarm@a00 {
						io-channels = <0x00>;
					};
				};
			};
		};

		fragment@3 {

			__overlay__ {

				pm8350_tz {
					thermal-sensors = <0x00>;
				};
			};
		};

		fragment@4 {

			__overlay__ {

				qcom,pm8350c@2 {

					pwms@e800 {
						nvmem = <0x00 0x04>;
					};

					qcom,leds@ef00 {

						red {
							pwms = <0x00>;
						};

						green {
							pwms = <0x00>;
						};

						blue {
							pwms = <0x00>;
						};
					};
				};
			};
		};

		fragment@5 {

			__overlay__ {

				pm8350c_tz {
					thermal-sensors = <0x00>;
				};

				pm8350c-bcl-lvl0 {
					thermal-sensors = <0x00>;
				};

				pm8350c-bcl-lvl1 {
					thermal-sensors = <0x00>;
				};

				pm8350c-bcl-lvl2 {
					thermal-sensors = <0x00>;
				};
			};
		};

		fragment@6 {

			__overlay__ {

				qcom,pm8350b@3 {

					qcom,temp-alarm@a00 {
						io-channels = <0x00>;
					};

					qcom,hv-haptics@f000 {
						nvmem-cells = <0x00>;
						nvmem = <0x00>;
						qcom,pbs-client = <0x00>;
					};

					qcom,amoled-ecm@f900 {
						nvmem = <0x00 0x04 0x08>;
					};
				};
			};
		};

		fragment@7 {

			__overlay__ {

				pm8350b_tz {
					thermal-sensors = <0x00>;
				};

				pm8350b-ibat-lvl0 {
					thermal-sensors = <0x00>;
				};

				pm8350b-ibat-lvl1 {
					thermal-sensors = <0x00>;
				};

				pm8350b-bcl-lvl0 {
					thermal-sensors = <0x00>;
				};

				pm8350b-bcl-lvl1 {
					thermal-sensors = <0x00>;
				};

				pm8350b-bcl-lvl2 {
					thermal-sensors = <0x00>;
				};
			};
		};

		fragment@9 {

			__overlay__ {

				pmr735a_tz {
					thermal-sensors = <0x00>;
				};
			};
		};

		fragment@11 {

			__overlay__ {

				pmr735b_tz {
					thermal-sensors = <0x00>;
				};
			};
		};

		fragment@13 {

			__overlay__ {

				pm8450_tz {
					thermal-sensors = <0x00>;
				};
			};
		};

		fragment@14 {

			__overlay__ {

				reboot_reason {
					nvmem-cells = <0x00>;
				};

				pmic-pon-log {
					nvmem = <0x00>;
				};
			};
		};

		fragment@15 {

			__overlay__ {

				pm8350b-bcl-lvl0 {

					cooling-maps {

						vbat_lte0 {
							trip = <0x00>;
						};

						vbat_nr0_scg {
							trip = <0x00>;
						};

						vbat_nr0 {
							trip = <0x00>;
						};

						vbat_cdsp0 {
							trip = <0x00>;
						};

						vbat_cpu_5 {
							trip = <0x00>;
						};

						vbat_gpu0 {
							trip = <0x00>;
						};
					};
				};

				pm8350b-bcl-lvl1 {

					cooling-maps {

						vbat_lte1 {
							trip = <0x00>;
						};

						vbat_nr1_scg {
							trip = <0x00>;
						};

						vbat_nr1 {
							trip = <0x00>;
						};

						vbat_cdsp1 {
							trip = <0x00>;
						};

						vbat_cpu_6_7 {
							trip = <0x00>;
						};

						vbat_gpu1 {
							trip = <0x00>;
						};
					};
				};

				pm8350b-bcl-lvl2 {

					cooling-maps {

						vbat_cdsp2 {
							trip = <0x00>;
						};

						vbat_gpu2 {
							trip = <0x00>;
						};
					};
				};

				pm8350c-bcl-lvl0 {

					cooling-maps {

						vph_lte0 {
							trip = <0x00>;
						};

						vph_nr0_scg {
							trip = <0x00>;
						};

						vph_nr0 {
							trip = <0x00>;
						};

						vph_cdsp0 {
							trip = <0x00>;
						};

						vph_cpu_5 {
							trip = <0x00>;
						};

						vph_gpu0 {
							trip = <0x00>;
						};
					};
				};

				pm8350c-bcl-lvl1 {

					cooling-maps {

						vph_lte1 {
							trip = <0x00>;
						};

						vph_nr1_scg {
							trip = <0x00>;
						};

						vph_nr1 {
							trip = <0x00>;
						};

						vph_cdsp1 {
							trip = <0x00>;
						};

						vph_cpu_6_7 {
							trip = <0x00>;
						};

						vph_gpu1 {
							trip = <0x00>;
						};
					};
				};

				pm8350c-bcl-lvl2 {

					cooling-maps {

						vph_cdsp2 {
							trip = <0x00>;
						};

						vph_gpu2 {
							trip = <0x00>;
						};
					};
				};

				pm8450_tz {

					cooling-maps {

						pm8450_cpu4_freq {
							trip = <0x00>;
						};

						pm8450_cpu7_freq {
							trip = <0x00>;
						};

						pm8450_apc1 {
							trip = <0x00>;
						};
					};
				};

				pm8350_tz {

					cooling-maps {

						pm8350_gpu {
							trip = <0x00>;
						};

						pm8350_cpu4_freq {
							trip = <0x00>;
						};

						pm8350_cpu7_freq {
							trip = <0x00>;
						};

						pm8350_apc1 {
							trip = <0x00>;
						};
					};
				};

				pm8350c_tz {

					cooling-maps {

						pm8350c_nsp {
							trip = <0x00>;
						};

						pm8350c_lte {
							trip = <0x00>;
						};

						pm8350c_nr {
							trip = <0x00>;
						};
					};
				};
			};
		};

		fragment@19 {

			__overlay__ {

				gpio_keys {
					pinctrl-0 = <0x00>;

					vol_up {
						gpios = <0x00>;
					};
				};
			};
		};

		fragment@23 {

			__overlay__ {

				port {

					endpoint {
						remote-endpoint = <0x00>;
					};
				};
			};
		};

		fragment@24 {

			__overlay__ {

				connector {

					port {

						endpoint {
							remote-endpoint = <0x00>;
						};
					};
				};
			};
		};

		fragment@27 {

			__overlay__ {

				cs35l41@42 {
					pinctrl-0 = <0x00 0x04>;
				};

				cs35l41@43 {
					pinctrl-0 = <0x00 0x04>;
					pinctrl-1 = <0x00>;
					pinctrl-2 = <0x00>;
				};
			};
		};

		fragment@28 {

			__overlay__ {

				md_testing_mode {
					pinctrl-0 = <0x00 0x04>;
				};
			};
		};

		fragment@39 {

			__overlay__ {

				ispv3_pci {
					qcom,iommu-group = <0x00>;
				};
			};
		};

		fragment@41 {

			__overlay__ {

				ispv3_spi@0 {
					ispv3_vdd1-supply = <0x00>;
					ispv3_vdd2-supply = <0x00>;
					ispv3_vdd-supply = <0x00>;
					ispv3_vddr-supply = <0x00>;
					pinctrl-0 = <0x00>;
					pinctrl-1 = <0x00>;
				};
			};
		};

		fragment@42 {

			__overlay__ {

				fts@0 {
					pinctrl-0 = <0x00>;
				};
			};
		};

		fragment@43 {

			__overlay__ {

				aw8697_haptic@5A {
					pinctrl-0 = <0x00>;
					pinctrl-1 = <0x00>;
					pinctrl-2 = <0x00>;
				};
			};
		};

		fragment@44 {

			__overlay__ {

				cpu_therm {
					thermal-sensors = <0x00>;
				};

				flash_therm {
					thermal-sensors = <0x00>;
				};

				quiet_therm {
					thermal-sensors = <0x00>;
				};

				charger_therm0 {
					thermal-sensors = <0x00>;
				};

				wireless_therm {
					thermal-sensors = <0x00>;
				};

				pa_therm0 {
					thermal-sensors = <0x00>;
				};

				pa_therm1 {
					thermal-sensors = <0x00>;
				};

				xo-therm-usr {
					thermal-sensors = <0x00>;
				};
			};
		};

		fragment@50 {

			__overlay__ {

				pm8008i@8 {
					pinctrl-0 = <0x00>;
				};

				pm8008i@9 {

					qcom,pm8008i-regulator {
						pm8008_en-supply = <0x00>;
					};
				};
			};
		};

		fragment@53 {

			__overlay__ {

				pm8010i_tz {
					thermal-sensors = <0x00>;
				};

				pm8010j_tz {
					thermal-sensors = <0x00>;
				};
			};
		};

		fragment@68 {

			__overlay__ {

				qcom,camera-flash@1 {
					torch-source = <0x00 0x04>;
					flash-source = <0x00 0x04>;
					switch-source = <0x00>;
				};

				qcom,camera-flash@2 {
					torch-source = <0x00 0x04>;
					flash-source = <0x00 0x04>;
					switch-source = <0x00>;
				};

				qcom,camera-flash@3 {
					torch-source = <0x00 0x04>;
					flash-source = <0x00 0x04>;
					switch-source = <0x00>;
				};

				qcom,cam-res-mgr {
					pinctrl-3 = <0x00 0x04>;
					pinctrl-2 = <0x00 0x04>;
					pinctrl-1 = <0x00 0x04 0x08>;
					pinctrl-0 = <0x00 0x04 0x08>;
				};
			};
		};

		fragment@69 {

			__overlay__ {

				qcom,eeprom0 {
					cam_v_custom2-supply = <0x00>;
					cam_vana-supply = <0x00>;
					cam_vaf-supply = <0x00>;
					cam_v_custom1-supply = <0x00>;
					cam_vdig-supply = <0x00>;
					cam_vio-supply = <0x00>;
				};

				qcom,ois0 {
					cam_v_custom2-supply = <0x00>;
					cam_vana-supply = <0x00>;
					cam_vaf-supply = <0x00>;
					cam_v_custom1-supply = <0x00>;
					cam_vdig-supply = <0x00>;
					cam_vio-supply = <0x00>;
				};

				qcom,actuator0 {
					cam_vaf-supply = <0x00>;
					cam_vio-supply = <0x00>;
				};

				qcom,cam-sensor0 {
					cam_v_custom2-supply = <0x00>;
					cam_vana-supply = <0x00>;
					ois-src = <0x00>;
					led-flash-src = <0x00>;
					actuator-src = <0x00>;
					eeprom-src = <0x00>;
					cam_vaf-supply = <0x00>;
					cam_v_custom1-supply = <0x00>;
					cam_vdig-supply = <0x00>;
					cam_vio-supply = <0x00>;
				};

				qcom,eeprom2 {
					pinctrl-1 = <0x00 0x04>;
					pinctrl-0 = <0x00 0x04>;
					cam_vana-supply = <0x00>;
					cam_vaf-supply = <0x00>;
					cam_vdig-supply = <0x00>;
					cam_vio-supply = <0x00>;
				};

				qcom,actuator2 {
					cam_vaf-supply = <0x00>;
					cam_vio-supply = <0x00>;
				};

				qcom,cam-sensor2 {
					pinctrl-1 = <0x00 0x04>;
					pinctrl-0 = <0x00 0x04>;
					cam_vana-supply = <0x00>;
					led-flash-src = <0x00>;
					actuator-src = <0x00>;
					eeprom-src = <0x00>;
					cam_vaf-supply = <0x00>;
					cam_vdig-supply = <0x00>;
					cam_vio-supply = <0x00>;
				};
			};
		};

		fragment@70 {

			__overlay__ {

				qcom,eeprom3 {
					cam_vana-supply = <0x00>;
					cam_v_custom1-supply = <0x00>;
					cam_vaf-supply = <0x00>;
					cam_vdig-supply = <0x00>;
					cam_vio-supply = <0x00>;
				};

				qcom,ois3 {
					cam_vana-supply = <0x00>;
					cam_v_custom1-supply = <0x00>;
					cam_vaf-supply = <0x00>;
					cam_vdig-supply = <0x00>;
					cam_vio-supply = <0x00>;
				};

				qcom,actuator3 {
					cam_v_custom1-supply = <0x00>;
					cam_vaf-supply = <0x00>;
					cam_vio-supply = <0x00>;
				};

				qcom,cam-sensor3 {
					cam_vana-supply = <0x00>;
					ois-src = <0x00>;
					led-flash-src = <0x00>;
					actuator-src = <0x00>;
					eeprom-src = <0x00>;
					cam_v_custom1-supply = <0x00>;
					cam_vaf-supply = <0x00>;
					cam_vdig-supply = <0x00>;
					cam_vio-supply = <0x00>;
				};

				qcom,eeprom1 {
					pinctrl-1 = <0x00 0x04>;
					pinctrl-0 = <0x00 0x04>;
					cam_vana-supply = <0x00>;
					cam_vdig-supply = <0x00>;
					cam_vio-supply = <0x00>;
				};

				qcom,cam-sensor1 {
					pinctrl-1 = <0x00 0x04>;
					pinctrl-0 = <0x00 0x04>;
					eeprom-src = <0x00>;
					cam_vana-supply = <0x00>;
					cam_vdig-supply = <0x00>;
					cam_vio-supply = <0x00>;
				};
			};
		};
	};

	fragment@54 {
		target = <0xffffffff>;

		__overlay__ {

			config {
				drive-strength = <0x04>;
				bias-pull-up;
				pins = "gpio110\0gpio111";
			};
		};
	};

	fragment@55 {
		target = <0xffffffff>;

		__overlay__ {

			config {
				drive-strength = <0x04>;
				bias-pull-down;
				pins = "gpio110\0gpio111";
			};
		};
	};

	fragment@56 {
		target = <0xffffffff>;

		__overlay__ {

			config {
				drive-strength = <0x04>;
				bias-pull-up;
				pins = "gpio112\0gpio113";
			};
		};
	};

	fragment@57 {
		target = <0xffffffff>;

		__overlay__ {

			config {
				drive-strength = <0x04>;
				bias-pull-down;
				pins = "gpio112\0gpio113";
			};
		};
	};

	fragment@58 {
		target = <0xffffffff>;

		__overlay__ {

			config {
				drive-strength = <0x04>;
				bias-pull-up;
				pins = "gpio114\0gpio115";
			};
		};
	};

	fragment@59 {
		target = <0xffffffff>;

		__overlay__ {

			config {
				drive-strength = <0x04>;
				bias-pull-down;
				pins = "gpio114\0gpio115";
			};
		};
	};

	fragment@60 {
		target = <0xffffffff>;

		__overlay__ {

			config {
				qcom,apps;
				drive-strength = <0x04>;
				bias-pull-up;
				pins = "gpio208\0gpio209";
			};
		};
	};

	fragment@61 {
		target = <0xffffffff>;

		__overlay__ {

			config {
				qcom,remote;
				drive-strength = <0x04>;
				bias-pull-down;
				pins = "gpio208\0gpio209";
			};
		};
	};

	fragment@62 {
		target = <0xffffffff>;

		__overlay__ {

			cam_wide_active_mclk {
				phandle = <0x89>;

				mux {
					function = "cam_mclk";
					pins = "gpio102";
				};

				config {
					drive-strength = <0x04>;
					bias-disable;
					pins = "gpio102";
				};
			};

			cam_wide_suspend_mclk {
				phandle = <0x8c>;

				mux {
					function = "cam_mclk";
					pins = "gpio102";
				};

				config {
					drive-strength = <0x04>;
					bias-pull-down;
					pins = "gpio102";
				};
			};

			cam_sensor_active_wide {
				phandle = <0x88>;

				mux {
					function = "gpio";
					pins = "gpio126\0gpio171\0gpio183";
				};

				config {
					drive-strength = <0x02>;
					bias-disable;
					pins = "gpio126\0gpio171\0gpio183";
				};
			};

			cam_sensor_suspend_wide {
				phandle = <0x8b>;

				mux {
					function = "gpio";
					pins = "gpio126\0gpio171\0gpio183";
				};

				config {
					output-low;
					drive-strength = <0x02>;
					bias-pull-down;
					pins = "gpio126\0gpio171\0gpio183";
				};
			};

			cam_sensor_active_mipisel0 {
				phandle = <0x8a>;

				mux {
					function = "gpio";
					pins = "gpio180";
				};

				config {
					drive-strength = <0x02>;
					bias-disable;
					pins = "gpio180";
				};
			};

			cam_sensor_suspend_mipisel0 {
				phandle = <0x8d>;

				mux {
					function = "gpio";
					pins = "gpio180";
				};

				config {
					output-low;
					drive-strength = <0x02>;
					bias-pull-down;
					pins = "gpio180";
				};
			};

			cam_ultra_active_mclk {
				phandle = <0x9a>;

				mux {
					function = "cam_mclk";
					pins = "gpio101";
				};

				config {
					drive-strength = <0x04>;
					bias-disable;
					pins = "gpio101";
				};
			};

			cam_ultra_suspend_mclk {
				phandle = <0x9c>;

				mux {
					function = "cam_mclk";
					pins = "gpio101";
				};

				config {
					drive-strength = <0x04>;
					bias-pull-down;
					pins = "gpio101";
				};
			};

			cam_sensor_active_ultra {
				phandle = <0x99>;

				mux {
					function = "gpio";
					pins = "gpio24\0gpio107";
				};

				config {
					drive-strength = <0x02>;
					bias-disable;
					pins = "gpio24\0gpio107";
				};
			};

			cam_sensor_suspend_ultra {
				phandle = <0x9b>;

				mux {
					function = "gpio";
					pins = "gpio24\0gpio107";
				};

				config {
					output-low;
					drive-strength = <0x02>;
					bias-pull-down;
					pins = "gpio24\0gpio107";
				};
			};

			cam_front_active_mclk {
				phandle = <0xa1>;

				mux {
					function = "cam_mclk";
					pins = "gpio104";
				};

				config {
					drive-strength = <0x04>;
					bias-disable;
					pins = "gpio104";
				};
			};

			cam_front_suspend_mclk {
				phandle = <0xa3>;

				mux {
					function = "cam_mclk";
					pins = "gpio104";
				};

				config {
					drive-strength = <0x04>;
					bias-pull-down;
					pins = "gpio104";
				};
			};

			cam_sensor_active_front {
				phandle = <0xa0>;

				mux {
					function = "gpio";
					pins = "gpio108";
				};

				config {
					drive-strength = <0x02>;
					bias-disable;
					pins = "gpio108";
				};
			};

			cam_sensor_suspend_front {
				phandle = <0xa2>;

				mux {
					function = "gpio";
					pins = "gpio108";
				};

				config {
					output-low;
					drive-strength = <0x02>;
					bias-pull-down;
					pins = "gpio108";
				};
			};

			cam_tele_active_mclk {
				phandle = <0x8f>;

				mux {
					function = "cam_mclk";
					pins = "gpio100";
				};

				config {
					drive-strength = <0x04>;
					bias-disable;
					pins = "gpio100";
				};
			};

			cam_tele_suspend_mclk {
				phandle = <0x91>;

				mux {
					function = "cam_mclk";
					pins = "gpio100";
				};

				config {
					drive-strength = <0x04>;
					bias-pull-down;
					pins = "gpio100";
				};
			};

			cam_sensor_active_tele {
				phandle = <0x8e>;

				mux {
					function = "gpio";
					pins = "gpio128\0gpio174";
				};

				config {
					drive-strength = <0x02>;
					bias-disable;
					pins = "gpio128\0gpio174";
				};
			};

			cam_sensor_suspend_tele {
				phandle = <0x90>;

				mux {
					function = "gpio";
					pins = "gpio128\0gpio174";
				};

				config {
					output-low;
					drive-strength = <0x02>;
					bias-pull-down;
					pins = "gpio128\0gpio174";
				};
			};
		};
	};

	fragment@66 {
		target = <0xffffffff>;

		__overlay__ {
			status = "ok";
			cci-clk-src = <0x23c3460>;
			hw-tsp = <0x03>;
			hw-trdhld = <0x03>;
			hw-scl-stretch-en = <0x01>;
			hw-tbuf = <0x18>;
			hw-thd-sta = <0x0f>;
			hw-thd-dat = <0x10>;
			hw-tsu-sta = <0x12>;
			hw-tsu-sto = <0x11>;
			hw-tlow = <0x16>;
			hw-thigh = <0x10>;
		};
	};

	fragment@68 {
		target = <0xffffffff>;

		__overlay__ {

			qcom,camera-flash@1 {
				phandle = <0x96>;
				status = "ok";
				switch-source = <0x55>;
				torch-source = <0x4f 0x50>;
				flash-source = <0x4b 0x4c>;
				compatible = "qcom,camera-flash";
				cell-index = <0x01>;
			};

			qcom,camera-flash@2 {
				phandle = <0x9f>;
				status = "ok";
				switch-source = <0x55>;
				torch-source = <0x4f 0x50>;
				flash-source = <0x4b 0x4c>;
				compatible = "qcom,camera-flash";
				cell-index = <0x02>;
			};

			qcom,camera-flash@3 {
				phandle = <0xa8>;
				status = "ok";
				switch-source = <0x55>;
				torch-source = <0x4f 0x50>;
				flash-source = <0x4b 0x4c>;
				compatible = "qcom,camera-flash";
				cell-index = <0x03>;
			};

			gpio-regulator@0 {
				phandle = <0x92>;
				gpio = <0xffffffff 0xab 0x00>;
				enable-active-high;
				regulator-enable-ramp-delay = <0x64>;
				regulator-max-microvolt = <0x2ab980>;
				regulator-min-microvolt = <0x2ab980>;
				regulator-name = "camera_wide_avdd_ldo";
				reg = <0x00 0x00>;
				compatible = "regulator-fixed";
			};

			gpio-regulator@1 {
				phandle = <0x98>;
				gpio = <0xffffffff 0x6b 0x00>;
				enable-active-high;
				regulator-enable-ramp-delay = <0x64>;
				regulator-max-microvolt = <0x2ab980>;
				regulator-min-microvolt = <0x2ab980>;
				regulator-name = "camera_ultra_avdd_ldo";
				reg = <0x01 0x00>;
				compatible = "regulator-fixed";
			};

			gpio-regulator@2 {
				phandle = <0xa5>;
				gpio = <0xffffffff 0xae 0x00>;
				enable-active-high;
				regulator-enable-ramp-delay = <0x64>;
				regulator-max-microvolt = <0x2c4fc0>;
				regulator-min-microvolt = <0x2c4fc0>;
				regulator-name = "camera_tele_avdd_ldo";
				reg = <0x02 0x00>;
				compatible = "regulator-fixed";
			};

			gpio-regulator@3 {
				phandle = <0x93>;
				gpio = <0xffffffff 0xb7 0x00>;
				enable-active-high;
				regulator-enable-ramp-delay = <0x64>;
				regulator-max-microvolt = "\0/]";
				regulator-min-microvolt = "\0/]";
				regulator-name = "camera_wide_ois_vaf_ldo";
				reg = <0x03 0x00>;
				compatible = "regulator-fixed";
			};

			qcom,cam-res-mgr {
				status = "ok";
				pinctrl-3 = <0x90 0x91>;
				pinctrl-2 = <0x8e 0x8f>;
				pinctrl-1 = <0x8b 0x8c 0x8d>;
				pinctrl-0 = <0x88 0x89 0x8a>;
				pinctrl-names = "cam_wide_active\0cam_wide_suspend\0cam_tele_active\0cam_tele_suspend";
				shared-pctrl-gpio-names = "cam_wide\0cam_wide\0cam_wide\0cam_wide\0cam_wide\0cam_tele\0cam_tele\0cam_tele";
				gpios-shared-pinctrl = <0x1ab 0x193 0x1d8 0x1e4 0x1e1 0x191 0x1ad 0x1db>;
				compatible = "qcom,cam-res-mgr";
			};
		};
	};

	fragment@69 {
		target = <0xffffffff>;

		__overlay__ {

			qcom,eeprom0 {
				phandle = <0x94>;
				status = "ok";
				clock-rates = <0x124f800>;
				clock-cntl-level = "nominal";
				clock-names = "cam_clk";
				clocks = <0xffffffff 0x50>;
				cci-master = <0x01>;
				gpio-req-tbl-label = "CAMIF_MCLK0\0CAM_RESET0\0CAM_MIPISEL0";
				gpio-req-tbl-flags = <0x01 0x00 0x00>;
				gpio-req-tbl-num = <0x00 0x01 0x02>;
				gpio-custom1 = <0x02>;
				gpio-reset = <0x01>;
				gpios = <0xffffffff 0x66 0x00 0xffffffff 0x7e 0x00 0xffffffff 0xb4 0x00>;
				gpio-no-mux = <0x00>;
				use-shared-clk;
				rgltr-load-current = <0x4e20 0xc350 0x00 0xc350 0xc350 0xc350 0xc350>;
				rgltr-max-voltage = <0x1b7740 0x119400 0x00 0x2ab980 0x1b7740 0x2f5d00 0x2f5d00>;
				rgltr-min-voltage = <0x1b7740 0x119400 0x00 0x2ab980 0x1b7740 0x2f5d00 0x2f5d00>;
				rgltr-cntrl-support;
				regulator-names = "cam_vio\0cam_vdig\0cam_clk\0cam_vana\0cam_v_custom1\0cam_vaf\0cam_v_custom2";
				cam_v_custom2-supply = <0x93>;
				cam_vaf-supply = <0x86>;
				cam_v_custom1-supply = <0x84>;
				cam_vana-supply = <0x92>;
				cam_clk-supply = <0xffffffff>;
				cam_vdig-supply = <0x81>;
				cam_vio-supply = <0x7d>;
				compatible = "qcom,eeprom";
				cell-index = <0x00>;
			};

			qcom,ois0 {
				phandle = <0x97>;
				status = "ok";
				clock-rates = <0x124f800>;
				clock-cntl-level = "nominal";
				clock-names = "cam_clk";
				clocks = <0xffffffff 0x50>;
				cci-master = <0x01>;
				gpio-req-tbl-label = "CAMIF_MCLK0\0CAM_RESET0\0CAM_MIPISEL0";
				gpio-req-tbl-flags = <0x01 0x00 0x00>;
				gpio-req-tbl-num = <0x00 0x01 0x02>;
				gpio-custom1 = <0x02>;
				gpio-reset = <0x01>;
				gpios = <0xffffffff 0x66 0x00 0xffffffff 0x7e 0x00 0xffffffff 0xb4 0x00>;
				gpio-no-mux = <0x00>;
				use-shared-clk;
				rgltr-load-current = <0x4e20 0xc350 0x00 0xc350 0xc350 0x19258 0x19258>;
				rgltr-max-voltage = <0x1b7740 0x119400 0x00 0x2ab980 0x1b7740 0x2f5d00 0x2f5d00>;
				rgltr-min-voltage = <0x1b7740 0x119400 0x00 0x2ab980 0x1b7740 0x2f5d00 0x2f5d00>;
				rgltr-cntrl-support;
				regulator-names = "cam_vio\0cam_vdig\0cam_clk\0cam_vana\0cam_v_custom1\0cam_vaf\0cam_v_custom2";
				cam_v_custom2-supply = <0x93>;
				cam_vaf-supply = <0x86>;
				cam_v_custom1-supply = <0x84>;
				cam_vana-supply = <0x92>;
				cam_clk-supply = <0xffffffff>;
				cam_vdig-supply = <0x81>;
				cam_vio-supply = <0x7d>;
				compatible = "qcom,ois";
				reg = <0x00>;
				cell-index = <0x00>;
			};

			qcom,actuator0 {
				phandle = <0x95>;
				rgltr-load-current = <0x19258 0x4e20>;
				rgltr-max-voltage = <0x2f5d00 0x1b7740>;
				rgltr-min-voltage = <0x2f5d00 0x1b7740>;
				rgltr-cntrl-support;
				regulator-names = "cam_vaf\0cam_vio";
				cam_vio-supply = <0x7d>;
				cam_vaf-supply = <0x86>;
				cci-master = <0x01>;
				compatible = "qcom,actuator";
				cell-index = <0x00>;
			};

			qcom,cam-sensor0 {
				status = "ok";
				clock-rates = <0x124f800>;
				clock-cntl-level = "nominal";
				clock-names = "cam_clk";
				clocks = <0xffffffff 0x50>;
				cci-master = <0x01>;
				gpio-req-tbl-label = "CAMIF_MCLK0\0CAM_RESET0\0CAM_MIPISEL0";
				gpio-req-tbl-flags = <0x01 0x00 0x00>;
				gpio-req-tbl-num = <0x00 0x01 0x02>;
				gpio-custom1 = <0x02>;
				gpio-reset = <0x01>;
				gpios = <0xffffffff 0x66 0x00 0xffffffff 0x7e 0x00 0xffffffff 0xb4 0x00>;
				gpio-no-mux = <0x00>;
				use-shared-clk;
				rgltr-load-current = <0x4e20 0xc350 0x00 0xc350 0xc350 0x19258 0x19258>;
				rgltr-max-voltage = <0x1b7740 0x119400 0x00 0x2ab980 0x1b7740 0x2f5d00 0x2f5d00>;
				rgltr-min-voltage = <0x1b7740 0x119400 0x00 0x2ab980 0x1b7740 0x2f5d00 0x2f5d00>;
				rgltr-cntrl-support;
				regulator-names = "cam_vio\0cam_vdig\0cam_clk\0cam_vana\0cam_v_custom1\0cam_vaf\0cam_v_custom2";
				cam_v_custom2-supply = <0x93>;
				cam_vaf-supply = <0x86>;
				cam_v_custom1-supply = <0x84>;
				cam_vana-supply = <0x92>;
				cam_clk-supply = <0xffffffff>;
				cam_vdig-supply = <0x81>;
				cam_vio-supply = <0x7d>;
				sensor-position-yaw = <0xb4>;
				sensor-position-pitch = <0x00>;
				sensor-position-roll = <0x5a>;
				ois-src = <0x97>;
				led-flash-src = <0x96>;
				actuator-src = <0x95>;
				eeprom-src = <0x94>;
				csiphy-sd-index = <0x01>;
				compatible = "qcom,cam-sensor";
				cell-index = <0x00>;
			};

			qcom,eeprom2 {
				phandle = <0x9d>;
				status = "ok";
				clock-rates = <0x124f800>;
				clock-cntl-level = "nominal";
				clock-names = "cam_clk";
				clocks = <0xffffffff 0x4e>;
				cci-master = <0x00>;
				gpio-req-tbl-label = "CAMIF_MCLK2\0CAM_RESET2";
				gpio-req-tbl-flags = <0x01 0x00>;
				gpio-req-tbl-num = <0x00 0x01>;
				gpio-reset = <0x01>;
				gpios = <0xffffffff 0x65 0x00 0xffffffff 0x18 0x00>;
				pinctrl-1 = <0x9b 0x9c>;
				pinctrl-0 = <0x99 0x9a>;
				pinctrl-names = "cam_default\0cam_suspend";
				gpio-no-mux = <0x00>;
				rgltr-load-current = <0x4e20 0xc350 0x19258 0x00 0xc350>;
				rgltr-max-voltage = <0x1b7740 0x10d880 0x2ad8c0 0x00 0x2ab980>;
				rgltr-min-voltage = <0x1b7740 0x10d880 0x2ad8c0 0x00 0x2ab980>;
				rgltr-cntrl-support;
				regulator-names = "cam_vio\0cam_vdig\0cam_vaf\0cam_clk\0cam_vana";
				cam_vana-supply = <0x98>;
				cam_clk-supply = <0xffffffff>;
				cam_vaf-supply = <0x7e>;
				cam_vdig-supply = <0x7b>;
				cam_vio-supply = <0x7d>;
				compatible = "qcom,eeprom";
				cell-index = <0x02>;
			};

			qcom,actuator2 {
				phandle = <0x9e>;
				rgltr-load-current = <0x19258 0x4e20>;
				rgltr-max-voltage = <0x2ad8c0 0x1b7740>;
				rgltr-min-voltage = <0x2ad8c0 0x1b7740>;
				rgltr-cntrl-support;
				regulator-names = "cam_vaf\0cam_vio";
				cam_vio-supply = <0x7d>;
				cam_vaf-supply = <0x7e>;
				cci-master = <0x00>;
				compatible = "qcom,actuator";
				cell-index = <0x02>;
			};

			qcom,cam-sensor2 {
				status = "ok";
				clock-rates = <0x124f800>;
				clock-cntl-level = "nominal";
				clock-names = "cam_clk";
				clocks = <0xffffffff 0x4e>;
				cci-master = <0x00>;
				gpio-req-tbl-label = "CAMIF_MCLK2\0CAM_RESET2";
				gpio-req-tbl-flags = <0x01 0x00>;
				gpio-req-tbl-num = <0x00 0x01>;
				gpio-reset = <0x01>;
				gpios = <0xffffffff 0x65 0x00 0xffffffff 0x18 0x00>;
				pinctrl-1 = <0x9b 0x9c>;
				pinctrl-0 = <0x99 0x9a>;
				pinctrl-names = "cam_default\0cam_suspend";
				gpio-no-mux = <0x00>;
				rgltr-load-current = <0x4e20 0xc350 0x19258 0x00 0xc350>;
				rgltr-max-voltage = <0x1b7740 0x10d880 0x2ad8c0 0x00 0x2ab980>;
				rgltr-min-voltage = <0x1b7740 0x10d880 0x2ad8c0 0x00 0x2ab980>;
				rgltr-cntrl-support;
				regulator-names = "cam_vio\0cam_vdig\0cam_vaf\0cam_clk\0cam_vana";
				cam_vana-supply = <0x98>;
				cam_clk-supply = <0xffffffff>;
				cam_vaf-supply = <0x7e>;
				cam_vdig-supply = <0x7b>;
				cam_vio-supply = <0x7d>;
				sensor-position-yaw = <0xb4>;
				sensor-position-pitch = <0x00>;
				sensor-position-roll = <0x5a>;
				led-flash-src = <0x9f>;
				actuator-src = <0x9e>;
				eeprom-src = <0x9d>;
				csiphy-sd-index = <0x02>;
				compatible = "qcom,cam-sensor";
				cell-index = <0x02>;
			};
		};
	};

	fragment@70 {
		target = <0xffffffff>;

		__overlay__ {

			qcom,eeprom1 {
				phandle = <0xa4>;
				status = "ok";
				clock-rates = <0x124f800>;
				clock-cntl-level = "nominal";
				clock-names = "cam_clk";
				clocks = <0xffffffff 0x54>;
				cci-master = <0x01>;
				gpio-req-tbl-label = "CAMIF_MCLK1\0CAM_RESET1";
				gpio-req-tbl-flags = <0x01 0x00>;
				gpio-req-tbl-num = <0x00 0x01>;
				gpio-reset = <0x01>;
				gpios = <0xffffffff 0x68 0x00 0xffffffff 0x6c 0x00>;
				pinctrl-1 = <0xa2 0xa3>;
				pinctrl-0 = <0xa0 0xa1>;
				pinctrl-names = "cam_default\0cam_suspend";
				gpio-no-mux = <0x00>;
				rgltr-load-current = <0x4e20 0x2710 0x00 0x19258>;
				rgltr-max-voltage = <0x1b7740 0x10d880 0x00 0x2ad8c0>;
				rgltr-min-voltage = <0x1b7740 0x10d880 0x00 0x2ad8c0>;
				rgltr-cntrl-support;
				regulator-names = "cam_vio\0cam_vdig\0cam_clk\0cam_vana";
				cam_vana-supply = <0x85>;
				cam_clk-supply = <0xffffffff>;
				cam_vdig-supply = <0x82>;
				cam_vio-supply = <0x83>;
				compatible = "qcom,eeprom";
				cell-index = <0x01>;
			};

			qcom,cam-sensor1 {
				status = "ok";
				clock-rates = <0x124f800>;
				clock-cntl-level = "nominal";
				clock-names = "cam_clk";
				clocks = <0xffffffff 0x54>;
				cci-master = <0x01>;
				gpio-req-tbl-label = "CAMIF_MCLK1\0CAM_RESET1";
				gpio-req-tbl-flags = <0x01 0x00>;
				gpio-req-tbl-num = <0x00 0x01>;
				gpio-reset = <0x01>;
				gpios = <0xffffffff 0x68 0x00 0xffffffff 0x6c 0x00>;
				pinctrl-1 = <0xa2 0xa3>;
				pinctrl-0 = <0xa0 0xa1>;
				pinctrl-names = "cam_default\0cam_suspend";
				gpio-no-mux = <0x00>;
				rgltr-load-current = <0x4e20 0x2710 0x00 0x19258>;
				rgltr-max-voltage = <0x1b7740 0x10d880 0x00 0x2ad8c0>;
				rgltr-min-voltage = <0x1b7740 0x10d880 0x00 0x2ad8c0>;
				aon-user;
				rgltr-cntrl-support;
				regulator-names = "cam_vio\0cam_vdig\0cam_clk\0cam_vana";
				cam_vana-supply = <0x85>;
				cam_clk-supply = <0xffffffff>;
				cam_vdig-supply = <0x82>;
				cam_vio-supply = <0x83>;
				sensor-position-yaw = <0x00>;
				sensor-position-pitch = <0x00>;
				sensor-position-roll = <0x10e>;
				eeprom-src = <0xa4>;
				csiphy-sd-index = <0x04>;
				compatible = "qcom,cam-sensor";
				cell-index = <0x01>;
			};

			qcom,eeprom3 {
				phandle = <0xa6>;
				status = "ok";
				clock-rates = <0x124f800>;
				clock-cntl-level = "nominal";
				clock-names = "cam_clk";
				clocks = <0xffffffff 0x4c>;
				cci-master = <0x00>;
				gpio-req-tbl-label = "CAMIF_MCLK3\0CAM_RESET3";
				gpio-req-tbl-flags = <0x01 0x00>;
				gpio-req-tbl-num = <0x00 0x01>;
				gpio-reset = <0x01>;
				gpios = <0xffffffff 0x64 0x00 0xffffffff 0x80 0x00>;
				gpio-no-mux = <0x00>;
				rgltr-load-current = <0x2710 0xc350 0x00 0x88b8 0x19258 0x19258>;
				rgltr-max-voltage = <0x1b7740 0x10d880 0x00 0x2c4fc0 0x2ad8c0 0x2ad8c0>;
				rgltr-min-voltage = <0x1b7740 0x10d880 0x00 0x2c4fc0 0x2ad8c0 0x2ad8c0>;
				rgltr-cntrl-support;
				regulator-names = "cam_vio\0cam_vdig\0cam_clk\0cam_vana\0cam_vaf\0cam_v_custom1";
				cam_v_custom1-supply = <0x80>;
				cam_vaf-supply = <0x7f>;
				cam_vana-supply = <0xa5>;
				cam_clk-supply = <0xffffffff>;
				cam_vdig-supply = <0x7c>;
				cam_vio-supply = <0x7d>;
				compatible = "qcom,eeprom";
				cell-index = <0x03>;
			};

			qcom,ois3 {
				phandle = <0xa9>;
				status = "ok";
				clock-rates = <0x124f800>;
				clock-cntl-level = "nominal";
				clock-names = "cam_clk";
				clocks = <0xffffffff 0x4c>;
				cci-master = <0x00>;
				gpio-req-tbl-label = "CAMIF_MCLK3\0CAM_RESET3";
				gpio-req-tbl-flags = <0x01 0x00>;
				gpio-req-tbl-num = <0x00 0x01>;
				gpio-reset = <0x01>;
				gpios = <0xffffffff 0x64 0x00 0xffffffff 0x80 0x00>;
				gpio-no-mux = <0x00>;
				rgltr-load-current = <0x2710 0xc350 0x00 0x88b8 0x19258 0x19258>;
				rgltr-max-voltage = <0x1b7740 0x10d880 0x00 0x2c4fc0 0x2ad8c0 0x2ad8c0>;
				rgltr-min-voltage = <0x1b7740 0x10d880 0x00 0x2c4fc0 0x2ad8c0 0x2ad8c0>;
				rgltr-cntrl-support;
				regulator-names = "cam_vio\0cam_vdig\0cam_clk\0cam_vana\0cam_vaf\0cam_v_custom1";
				cam_v_custom1-supply = <0x80>;
				cam_vaf-supply = <0x7f>;
				cam_vana-supply = <0xa5>;
				cam_clk-supply = <0xffffffff>;
				cam_vdig-supply = <0x7c>;
				cam_vio-supply = <0x7d>;
				compatible = "qcom,ois";
				reg = <0x00>;
				cell-index = <0x03>;
			};

			qcom,actuator3 {
				phandle = <0xa7>;
				rgltr-load-current = <0x19258 0x4e20 0x19258>;
				rgltr-max-voltage = <0x2ad8c0 0x1b7740 0x2ad8c0>;
				rgltr-min-voltage = <0x2ad8c0 0x1b7740 0x2ad8c0>;
				rgltr-cntrl-support;
				regulator-names = "cam_vaf\0cam_vio\0cam_v_custom1";
				cam_v_custom1-supply = <0x80>;
				cam_vio-supply = <0x7d>;
				cam_vaf-supply = <0x7f>;
				cci-master = <0x00>;
				compatible = "qcom,actuator";
				cell-index = <0x03>;
			};

			qcom,cam-sensor3 {
				status = "ok";
				clock-rates = <0x124f800>;
				clock-cntl-level = "nominal";
				clock-names = "cam_clk";
				clocks = <0xffffffff 0x4c>;
				cci-master = <0x00>;
				gpio-req-tbl-label = "CAMIF_MCLK3\0CAM_RESET3";
				gpio-req-tbl-flags = <0x01 0x00>;
				gpio-req-tbl-num = <0x00 0x01>;
				gpio-reset = <0x01>;
				gpios = <0xffffffff 0x64 0x00 0xffffffff 0x80 0x00>;
				gpio-no-mux = <0x00>;
				rgltr-load-current = <0x2710 0xc350 0x00 0x88b8 0x19258 0x19258>;
				rgltr-max-voltage = <0x1b7740 0x10d880 0x00 0x2c4fc0 0x2ad8c0 0x2ad8c0>;
				rgltr-min-voltage = <0x1b7740 0x10d880 0x00 0x2c4fc0 0x2ad8c0 0x2ad8c0>;
				rgltr-cntrl-support;
				regulator-names = "cam_vio\0cam_vdig\0cam_clk\0cam_vana\0cam_vaf\0cam_v_custom1";
				cam_v_custom1-supply = <0x80>;
				cam_vaf-supply = <0x7f>;
				cam_vana-supply = <0xa5>;
				cam_clk-supply = <0xffffffff>;
				cam_vdig-supply = <0x7c>;
				cam_vio-supply = <0x7d>;
				sensor-position-yaw = <0xb4>;
				sensor-position-pitch = <0x00>;
				sensor-position-roll = <0x5a>;
				ois-src = <0xa9>;
				led-flash-src = <0xa8>;
				actuator-src = <0xa7>;
				eeprom-src = <0xa6>;
				csiphy-sd-index = <0x03>;
				compatible = "qcom,cam-sensor";
				cell-index = <0x03>;
			};
		};
	};
};
